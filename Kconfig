## boards/atmosic/atm34evk/Kconfig.defconfig
```kconfig
# Copyright (c) 2021-2025 Atmosic
#
# SPDX-License-Identifier: Apache-2.0

if SOC_ATM34XX_5

config CORTEX_M_SYSTICK
	bool
	default y

config CORTEX_M_SYSTICK_EXTERNAL_REF
	bool
	default y

config RUNTIME_NMI
	bool
	default y

config USE_DT_CODE_PARTITION
	bool
	default y

# Enable MPU
config ARM_MPU
	bool
	default y

# Enable hardware stack protection
config HW_STACK_PROTECTION
	bool
	default y

# Enable TrustZone-M
config ARM_TRUSTZONE_M
	bool
	default y

config TRUSTED_EXECUTION_SECURE
	bool
	default y
	depends on !$(dt_nodelabel_bool_prop,sec_tz,ns_app)

config TRUSTED_EXECUTION_NONSECURE
	bool
	default y
	depends on $(dt_nodelabel_bool_prop,sec_tz,ns_app)

# enable uart driver
config SERIAL
	bool
	default y

# enable console
config CONSOLE
	bool
	default y

config UART_CONSOLE
	bool
	default y

# GPIOs
config GPIO
	bool
	default y

# Watchdog
config WATCHDOG
	bool
	default y if DT_HAS_ARM_CMSDK_WATCHDOG_ENABLED

# the image header needs a minimum of 512 bytes but must be aligned to
# the MPC boundary of 2K to be accessible by image management services
MCUBOOT_IMG_HDR_SZ := 0x800

config ROM_START_OFFSET
	default 0 if MERGE_SPE_NSPE && BOOTLOADER_MCUBOOT && !ATM_SPLIT_IMG
	default $(MCUBOOT_IMG_HDR_SZ) if BOOTLOADER_MCUBOOT

config BUILD_OUTPUT_HEX
	default y

if PM

config IDLE_STACK_SIZE
	int
	default 1024

endif # PM

config ATM_NO_SPE
	bool
	help
	  Application will operate a single secure image without the SPE. This promptless
	  setting is selected by ATM_NO_TZ option which implies that no SPE will be used.

config ATM_NO_TZ
	bool
	default y
	select ATM_NO_SPE
	depends on !DT_HAS_ATMOSIC_SEC_TZ_ENABLED
	depends on !MCUBOOT
	depends on !TRUSTED_EXECUTION_NONSECURE
	help
	  This setting is configured through a device tree configuration to
	  remove both the SPE partition as well as the use of Trustzone application
	  isolation features. This configuration runs the single application as a
	  secure image without the Atmosic sample SPE. TrustZone protection mechanisms
	  on the platform will not be enabled and Trustzone will be minimally initialized.

DT_CHOSEN_ATM_APP_FLASH_XIP := zephyr,atm-app-flash-xip

config ATM_APP_FLASH_XIP
	bool
	default "$(dt_chosen_enabled,$(DT_CHOSEN_ATM_APP_FLASH_XIP))"

if ATM_APP_FLASH_XIP

config FLASH
	bool
	default y if TRUSTED_EXECUTION_NONSECURE  || ((TRUSTED_EXECUTION_SECURE || ATM_NO_SPE) && !BOOTLOADER_MCUBOOT)

config FLASH_BASE_ADDRESS
	hex
	default 0x10200000 if ATM_NO_SPE
	default 0x00200000 if TRUSTED_EXECUTION_NONSECURE

config ATM_SPLIT_IMG
	bool "NSPE Image split across multiple memory regions"
	default $(dt_nodelabel_has_prop,fast_code_partition,reg)

config ATM_SNIPPETS_FAST_CODE
	bool "Enable fast code snippets"
	depends on ATM_SPLIT_IMG

if (TRUSTED_EXECUTION_NONSECURE || ATM_NO_SPE) && ATM_SPLIT_IMG

# split images relocate the vector table to fast code
config ROMSTART_RELOCATION_ROM
	bool
	default y

_FAST_CODE_PART_ADDR_SLOT0_NESTED := $(dt_node_reg_addr_hex,$(dt_node_parent,$(dt_node_parent,$(dt_node_parent,$(dt_node_parent,$(dt_nodelabel_path,fast_code_partition))))))
_FAST_CODE_PART_ADDR := $(dt_node_reg_addr_hex,$(dt_node_parent,$(dt_node_parent,$(dt_nodelabel_path,fast_code_partition))))
_FAST_CODE_PART_OFFSET := $(dt_node_reg_addr_hex,$(dt_nodelabel_path,fast_code_partition))

config ROMSTART_REGION_ADDRESS
	hex
	default $(add_hex,$(_FAST_CODE_PART_ADDR_SLOT0_NESTED),$(_FAST_CODE_PART_OFFSET)) if BOOTLOADER_MCUBOOT
	default $(add_hex,$(_FAST_CODE_PART_ADDR),$(_FAST_CODE_PART_OFFSET))

# The relocated ROM region size in 1KB increments.
# Minimally this needs to fit the vector table (576 bytes).
# For MCUBOOT we set ROM_START_OFFSET=$(MCUBOOT_IMG_HDR_SZ) in order to
# use this offset in the regular signing task of the merged SPE+fastcode (IMG0).
# For NO-SPE images the fast-code partition will have the image header for signing.
# This has the consequence of requiring a larger reservation for the relocated ROM start.
config ROMSTART_REGION_SIZE
	hex
	default 3 if BOOTLOADER_MCUBOOT
	default 1

if BOOTLOADER_MCUBOOT

# For split images the ROM start section has been moved to RRAM for vector
# placement.  The ROM start section however, provided the MCUBOOT image header
# reservation via ROM_START_OFFSET and is no longer in the flash image.
# We now have to:
#
#   -) Explicitly offset the flash image past the image header using FLASH_LOAD_OFFSET/FLASH_LOAD_SIZE.
#   -) Have imgtool prepend the binary/hex image with a header using the --pad-header option.

DT_CHOSEN_Z_CODE_PARTITION := zephyr,code-partition

config FLASH_LOAD_OFFSET
	hex
	default $(add_hex,$(dt_chosen_reg_addr_hex,$(DT_CHOSEN_Z_CODE_PARTITION)),$(MCUBOOT_IMG_HDR_SZ))

config FLASH_LOAD_SIZE
	hex
	default $(sub_hex,$(dt_chosen_reg_size_hex,$(DT_CHOSEN_Z_CODE_PARTITION)),$(MCUBOOT_IMG_HDR_SZ))

endif

endif # (TRUSTED_EXECUTION_NONSECURE || ATM_NO_SPE) && ATM_SPLIT_IMG

# note: MCUMGR_GRP_IMG_UPDATABLE_IMAGE_NUMBER defaults to UPDATEABLE_IMAGE_NUMBER
config UPDATEABLE_IMAGE_NUMBER
	int
	default 2 if IMG_MANAGER || MCUBOOT

config BOOT_VERSION_CMP_USE_BUILD_NUMBER
	bool
	default y if MCUBOOT

config MULTI_IMAGE_VERSIONS_MUST_MATCH
	bool
	default y if MCUBOOT

endif # ATM_APP_FLASH_XIP

# MCUBOOT uses BOOT_MAX_IMG_SECTORS to size the sector swap map for both
# SLOT1 and SLOT3 in a multi-image swap (a known limitation).
# The value needs to be sufficiently large to handle the largest number of sectors
# in either slot. Since the trailer must have a minimum size and alignment of 4K
# to flash memory we can use a conservative value of 512 image sectors for the
# non-volatile and in-memory swap maps.
# The default value results in:
#  -) slot2/slot3 (FLASH/FLASH) can have up to a 2MB slot size
#  -) slot0/slot1 (RRAM/FLASH) can be up to 512KB slot sizes

config BOOT_MAX_IMG_SECTORS
	int
	default 512
	depends on MCUBOOT || BOOTLOADER_MCUBOOT

if TRUSTED_EXECUTION_NONSECURE

config SPE_PATH
	string "Path to SPE build directory"

config ATM_ARM_FIRMWARE_USES_SECURE_ENTRY_FUNCS
	bool "ATM Non-Secure Firmware uses Secure Entry functions"
	default y if SPE_PATH != ""
	help
	  Option as ARM_FIRMWARE_USES_SECURE_ENTRY_FUNCS.

config ATM_ARM_ENTRY_VENEERS_LIB_NAME
	string "ATM Entry Veneers symbol file"
	depends on SPE_PATH != ""
	default "libentryveneers.a"
	help
	  Library file as ARM_ENTRY_VENEERS_LIB_NAME.

config MERGE_SPE_NSPE
	bool
	depends on SPE_PATH != ""
	default y if BOOTLOADER_MCUBOOT
	help
	  Option to merge SPE and NSPE to a single image. This config must
	  be set if building with MCUboot as the merged image is signed.
	  However, it can also be set to allow a single `west flash` to flash
	  both the spe and nspe.

endif # TRUSTED_EXECUTION_NONSECURE

if TRUSTED_EXECUTION_NONSECURE || ATM_NO_SPE

config ATM_PAD_SIGNED_IMAGE
	bool "Pad the signed image to the slot size"
	help
	  Padding the image will form the trailer that can identify
	  the image as a valid upgrade.  This however will make the
	  upgrade image the size of the slot.

# Need to override header-size for image tool to the SPE header allocation
# The header-size override is applied when signing a merged SPE/NSPE (image 0).
# The NSPE ROM_START_OFFSET is 0 for the merged image 0.
# This override however is not required when the NSPE is in flash as image 1.
# In a NO SPE build, signing the fast-code partition is handled
# in the in-tree MCUBOOT signing flow.  The override is not required.
if !ATM_NO_SPE && !ATM_SPLIT_IMG
ATM_EXTRA_IMGTOOL_ARGS_IMG0 := --header-size=$(MCUBOOT_IMG_HDR_SZ)
endif

if ATM_PAD_SIGNED_IMAGE
ATM_EXTRA_IMGTOOL_ARGS_IMG0 := $(ATM_EXTRA_IMGTOOL_ARGS_IMG0) --pad
ATM_EXTRA_IMGTOOL_ARGS_IMG1 := --pad
endif

config MCUBOOT_EXTRA_IMGTOOL_ARGS
	default "$(ATM_EXTRA_IMGTOOL_ARGS_IMG0)" if MERGE_SPE_NSPE || ATM_PAD_SIGNED_IMAGE
	depends on BOOTLOADER_MCUBOOT

config ATM_MCUBOOT_EXTRA_IMGTOOL_ARGS_IMG1
	string "Extra IMGTOOL signing args for image 1"
	default "$(ATM_EXTRA_IMGTOOL_ARGS_IMG1)"
	depends on BOOTLOADER_MCUBOOT && ATM_SPLIT_IMG
	help
	   A split image configuration uses different arguments when signing
	   image 1.

config ATM_MCUBOOT_IMGTOOL_SIGN_VERSION_IMG1
	string "Version to pass to imgtool when signing image 1"
	default MCUBOOT_IMGTOOL_SIGN_VERSION
	depends on BOOTLOADER_MCUBOOT && ATM_SPLIT_IMG
	help
	  The signing version should match image 0 which uses MCUBOOT_IMGTOOL_SIGN_VERSION.
	  Use this to override the image 1 version.

endif # TRUSTED_EXECUTION_NONSECURE || ATM_NO_SPE

if BT

# Controller provides random numbers via HCI_LE_RAND; host-side PRNG not needed.
# Disabling avoids redundant HMAC-based PRNG in host and reduces memory footprint.
config BT_HOST_CRYPTO_PRNG
	default n

config HEAP_MEM_POOL_SIZE
	default 32768

config ENTROPY_GENERATOR
	default y

config BT_HCI_ACL_FLOW_CONTROL
	default n

endif # BT

if SERIAL

config UART_INTERRUPT_DRIVEN
	default y

endif # SERIAL

if BATTERY_UPD

choice BATTERY_TYPE
	prompt "Battery type"
	default BATTERY_TYPE_COIN

config BATTERY_TYPE_COIN
	bool "Battery is coin"

config BATTERY_TYPE_HSC_LIION
	bool "Battery is hsc liion"
endchoice

endif # BATTERY_UPD

endif # SOC_ATM34XX_5
```

## drivers/batt_model_coin/Kconfig
```kconfig
# Copyright (c) 2024 Atmosic
#
# SPDX-License-Identifier: Apache-2.0

config BATT_MODEL_COIN
	bool "Coin Cell Battery support"
	depends on ADC
	select BATT_MODEL
```

## drivers/dma/Kconfig
```kconfig
# Copyright (c) 2024 Atmosic
#
# SPDX-License-Identifier: Apache-2.0

config ATM_DMA
	bool "Atmosic DMA module"
	depends on !SOC_SERIES_ATMX2
	default y if TRUSTED_EXECUTION_NONSECURE || MCUBOOT

config ATM_DMA_MINIMAL
	bool
	depends on ATM_DMA
	default y if MCUBOOT
	default y if !BT && !ATM_ATLC && !ENTROPY_ATM_TRNG
```
