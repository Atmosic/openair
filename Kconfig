## dts/bindings/net/wireless/atmosic,antenna.yaml
```yaml
# Copyright (c) 2025 Atmosic
# SPDX-License-Identifier: Apache-2.0

description: atmosic antenna

compatible: "atmosic,antenna"

include: [base.yaml]

properties:
  ant-out0-pin:
    type: int
    description: Pin for antenna out 0

  ant-out1-pin:
    type: int
    description: Pin for antenna out 1

  ant-out2-pin:
    type: int
    description: Pin for antenna out 2

  ant-out3-pin:
    type: int
    description: Pin for antenna out 3

  ant-out4-pin:
    type: int
    description: Pin for antenna out 4

  ant-out5-pin:
    type: int
    description: Pin for antenna out 5

  ant-out6-pin:
    type: int
    description: Pin for antenna out 6

  ant-out7-pin:
    type: int
    description: Pin for antenna out 7

  power-source-gpios:
    type: phandle-array
    description: GPIO for power source control

  mdm-ant-rx-3to0:
    type: int
    description: Antenna 3 to 0 table when RX

  mdm-ant-tx-3to0:
    type: int
    description: Antenna 3 to 0 table when TX

  mdm-ant-rx-7to4:
    type: int
    description: Antenna 7 to 4 table when RX

  mdm-ant-tx-7to4:
    type: int
    description: Antenna 7 to 4 table when TX

  mdm-ant-idle:
    type: int
    description: Antenna table when Idle

  rf-delay-one-eighth-ns:
    type: int
    description: RF delay with a unit of 1/8 ns
    default: 30
```

## dts/bindings/pinctrl/atmosic,atm-pinctrl.yaml
```yaml
# Copyright (c) 2024-2025 Atmosic
#
# SPDX-License-Identifier: Apache-2.0

description: |
    The Atmosic pin controller is a node used for configuring pin selections
    and related properties such as pull-up and pull-down.

    You can modify this node by using the 'pinctrl' node label in the boards
    devictree as shown below:

      &pinctrl {
        /* Pin configuration */
      };

    Each pin that makes up a pin configuration should be a child node of the
    pinctrl node. These child nodes contain a 'pinmux' element which is a
    2-element array of the pin number, and the signal for the pin. They may
    optionally have pull-up and pull-down information added as well. An example
    for I2C is shown below.

      /* include signal macros */
      #include <atm33_pinmux.h>

      &pinctrl {
        i2c1_sda_default: i2c1_sda_default {
            /* configure P7 as I2C1 SDA with pull-up
            pinmux = <7 PINMUX_I2C1_SDA>;
            bias-pull-up;
        };

        i2c1_scl_default: i2c1_scl_default {
            /* configure P6 as I2C1 SCL */
            pinmux = <6 PINMUX_I2C1_SCL>;
        };
      };


    The above node defines a configuration called 'i2c1_sda_default' which
    configures P7 as I2C1 SDA with a pull-up and 'i2c1_scl_default' which
    condigures P6 as I2C1 SCL. Finally a peripheral can use this configuration
    by adding a pinctrl-N and pinctrl-names property to the peripherals node.
    An example is as follows:

      &i2c1 {
        ...
        pinctrl-0 = <&i2c1_sda_default &i2c1_scl_default>;
        pinctrl-names = "default";
        ...
      };

    Each pin configuration for a specific peripheral should have its own
    "pinctrl-N" with a unique number, starting with 0, however numbers are
    expected to be reset and be reused between different peripherals. Typically
    only a 'pinctrl-0' is necessary. The names for each configuration should be
    comma seperated.

compatible: "atmosic,atm-pinctrl"

include: base.yaml

properties:
  num-pins:
    required: true
    type: int
    description: |
      The max number of pins available for the given SOC Series.

child-binding:

  include:
    - name: pincfg-node.yaml
      property-allowlist:
        - bias-disable
        - bias-pull-down
        - bias-pull-up

  properties:
    pinmux:
      required: true
      type: array
      description: |
          Each pinmux entry should be an array of two values, the first value
          is the pin, and the second value is the signal it should be configured
          to.
```
