## Kconfig
```kconfig
# Copyright (c) 2024 Atmosic
#
# SPDX-License-Identifier: Apache-2.0

rsource "lib/Kconfig"
rsource "modules/hal_atmosic/Kconfig"
rsource "tools/Kconfig"
rsource "subsys/Kconfig"

config UU_TEST_OPENAIR
	string "Add files in openair for code coverage"
	depends on AUTO_TEST && COVERAGE && !NATIVE_BUILD
	help
	  Target "app" is automatically added coverage in compile options
	  Set files for example:
	    "app_batt.c;atm_settings.c"
```

## boards/atmosic/atm33evk/ATMEVK-3325-QK-5_no_TZ_defconfig
```kconfig
# Copyright (c) 2025 Atmosic
#
# SPDX-License-Identifier: Apache-2.0

CONFIG_CORTEX_M_SYSTICK=y
CONFIG_RUNTIME_NMI=y
CONFIG_USE_DT_CODE_PARTITION=y

# Enable MPU
CONFIG_ARM_MPU=y

# Enable hardware stack protection
CONFIG_HW_STACK_PROTECTION=y

# Enable secure CPU usage without a non-secure image.
# This configuration runs the single application as a single secure image.
CONFIG_ARM_TRUSTZONE_M=y
CONFIG_TRUSTED_EXECUTION_SECURE=y
# Not running an actual SPE/NSPE TrustZone split.
CONFIG_ATM_NO_TZ=y

# enable uart driver
CONFIG_SERIAL=y

# enable console
CONFIG_CONSOLE=y
CONFIG_UART_CONSOLE=y

# GPIOs
CONFIG_GPIO=y

# Watchdog
CONFIG_WATCHDOG=y
```

## boards/atmosic/atm33evk/Kconfig.defconfig
```kconfig
# Copyright (c) 2021-2024 Atmosic
#
# SPDX-License-Identifier: Apache-2.0

if SOC_ATM33XX_5

config CORTEX_M_SYSTICK
	bool
	default y

config RUNTIME_NMI
	bool
	default y

config USE_DT_CODE_PARTITION
	bool
	default y

# Enable MPU
config ARM_MPU
	bool
	default y

# Enable hardware stack protection
config HW_STACK_PROTECTION
	bool
	default y

# Enable TrustZone-M
config ARM_TRUSTZONE_M
	bool
	default y

config TRUSTED_EXECUTION_SECURE
	bool
	default y
	depends on !$(dt_nodelabel_bool_prop,sec_tz,ns_app)

config TRUSTED_EXECUTION_NONSECURE
	bool
	default y
	depends on $(dt_nodelabel_bool_prop,sec_tz,ns_app)

# enable uart driver
config SERIAL
	bool
	default y

# enable console
config CONSOLE
	bool
	default y

config UART_CONSOLE
	bool
	default y

# GPIOs
config GPIO
	bool
	default y

# Watchdog
config WATCHDOG
	bool
	default y if DT_HAS_ARM_CMSDK_WATCHDOG_ENABLED

config ROM_START_OFFSET
	default 0 if MERGE_SPE_NSPE && BOOTLOADER_MCUBOOT
	default 0x800 if BOOTLOADER_MCUBOOT

config BUILD_OUTPUT_HEX
	default y

if ENTROPY_ATM_TRNG

# entropy driver needs additional support (i.e. BLE driver)
config HEAP_MEM_POOL_SIZE
       default 32768

endif # ENTROPY_ATM_TRNG

if PM

config IDLE_STACK_SIZE
	int
	default 1024

endif # PM

config ATM_NO_SPE
	bool
	help
	  Application will operate a single secure image without the SPE. This promptless
	  setting is selected by ATM_NO_TZ option which implies that no SPE will be used.

config ATM_NO_TZ
	bool
	default y
	select ATM_NO_SPE
	depends on !DT_HAS_ATMOSIC_SEC_TZ_ENABLED
	depends on !MCUBOOT
	depends on !TRUSTED_EXECUTION_NONSECURE
	help
	  This setting is configured through a device tree configuration to
	  remove both the SPE partition as well as the use of Trustzone application
	  isolation features. This configuration runs the single application as a
	  secure image without the Atmosic sample SPE. TrustZone protection mechanisms
	  on the platform will not be enabled and Trustzone will be minimally initialized.

# MCUBOOT uses BOOT_MAX_IMG_SECTORS to size the sector swap map for SLOT1. The
# value needs to be sufficiently large to handle the largest number of sectors
# in the slot. Since the trailer must have a minimum size and alignment of 2K in
# RRAM-only configurations and 4K when flash memory is used, we can use a
# conservative value of 512 image sectors for the non-volatile swap map.
# The default value results in:
#  -) slot0/slot1 (RRAM/RRAM) can be up to 512KB slot sizes if the RRAM has a
#     large enough capacity
#  -) slot0/slot1 (RRAM/FLASH) can be up to 2MB slot sizes if RRAM capacity
#     allows it

config BOOT_MAX_IMG_SECTORS
	int
	default 512
	depends on MCUBOOT || BOOTLOADER_MCUBOOT

if TRUSTED_EXECUTION_NONSECURE

config SPE_PATH
	string "Path to SPE build directory"

config ATM_ARM_FIRMWARE_USES_SECURE_ENTRY_FUNCS
	bool "ATM Non-Secure Firmware uses Secure Entry functions"
	default y if SPE_PATH != ""
	help
	  Option as ARM_FIRMWARE_USES_SECURE_ENTRY_FUNCS.

config ATM_ARM_ENTRY_VENEERS_LIB_NAME
	string "ATM Entry Veneers symbol file"
	depends on SPE_PATH != ""
	default "libentryveneers.a"
	help
	  Library file as ARM_ENTRY_VENEERS_LIB_NAME.

config MERGE_SPE_NSPE
	bool
	depends on SPE_PATH != ""
	default y if BOOTLOADER_MCUBOOT
	help
	  Option to merge SPE and NSPE to a single image. This config must
	  be set if building with MCUboot as the merged image is signed.

if BOOTLOADER_MCUBOOT

config MCUBOOT_EXTRA_IMGTOOL_ARGS
	# Need to override header-size for image tool to the SPE header allocation
	default "--header-size=0x800" if MERGE_SPE_NSPE

endif # BOOTLOADER_MCUBOOT

endif # TRUSTED_EXECUTION_NONSECURE

if BT

# Controller provides random numbers via HCI_LE_RAND; host-side PRNG not needed.
# Disabling avoids redundant HMAC-based PRNG in host and reduces memory footprint.
config BT_HOST_CRYPTO_PRNG
	default n

config HEAP_MEM_POOL_SIZE
	default 32768

config ENTROPY_GENERATOR
	default y

config BT_HCI_ACL_FLOW_CONTROL
	default n

endif # BT

if SERIAL

config UART_INTERRUPT_DRIVEN
	default y

endif # SERIAL

if BATTERY_UPD

choice BATTERY_TYPE
	prompt "Battery type"
	default BATTERY_TYPE_COIN

config BATTERY_TYPE_COIN
	bool "Battery is coin"

config BATTERY_TYPE_HSC_LIION
	bool "Battery is hsc liion"
endchoice

endif # BATTERY_UPD

if MCUMGR_TRANSPORT_BT

config IMG_ERASE_PROGRESSIVELY
	default y

endif # MCUMGR_TRANSPORT_BT

endif # SOC_ATM33XX_5
```

## boards/atmosic/atm33evk/board.yml
```yaml
boards:
- name: ATMEVK-3330-QN-6
  vendor: atmosic
  revision:
    format: custom
    default: normal
    revisions:
    - name: mcuboot
    - name: mcuboot_bl
    - name: normal
  socs:
    - name: ATM33xx-5

- name: ATMEVK-3330e-QN-6
  vendor: atmosic
  revision:
    format: custom
    default: normal
    revisions:
    - name: mcuboot
    - name: mcuboot_bl
    - name: normal
  socs:
    - name: ATM33xx-5

- name: ATMEVK-3330e-QN-7
  vendor: atmosic
  revision:
    format: custom
    default: normal
    revisions:
    - name: mcuboot
    - name: mcuboot_bl
    - name: normal
  socs:
    - name: ATM33xx-5

- name: ATMEVK-3325-CM-6
  vendor: atmosic
  revision:
    format: custom
    default: normal
    revisions:
    - name: mcuboot
    - name: mcuboot_bl
    - name: normal
  socs:
    - name: ATM33xx-5

- name: ATMEVK-3325-QK-6
  vendor: atmosic
  revision:
    format: custom
    default: normal
    revisions:
    - name: mcuboot
    - name: mcuboot_bl
    - name: normal
  socs:
    - name: ATM33xx-5

- name: ATMEVK-3325-LQK-6
  vendor: atmosic
  revision:
    format: custom
    default: normal
    revisions:
    - name: mcuboot
    - name: mcuboot_bl
    - name: normal
  socs:
    - name: ATM33xx-5
```

## boards/atmosic/atm34evk/ATMBTCSTAG-3405_no_TZ_mcuboot_bl_defconfig
```kconfig
CONFIG_BOOT_SIGNATURE_TYPE_ECDSA_P256=y
CONFIG_BOOT_ECDSA_MICRO_ECC=y
CONFIG_BOOT_SHA2_ATM=y
CONFIG_BOOT_MAX_IMG_SECTORS=512
```
