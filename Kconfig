## drivers/flash/Kconfig.atm
```kconfig
# Copyright (c) 2023-2025 Atmosic
#
# SPDX-License-Identifier: Apache-2.0

config FLASH_ATM_RUID
	bool "Read Unique API"
	depends on SOC_FLASH_ATM
	depends on !MCUBOOT
	select FLASH_HAS_EX_OP
	select FLASH_EX_OP_ENABLED

choice FLASH_ATM_ABNORMAL_TEST_MODE
	prompt "Flash abnormal test mode"
	depends on SOC_FLASH_ATM
	depends on !MCUBOOT
	optional
	help
	  Select when to trigger reboot during flash erase operation
	  to test recovery from abnormal states.

config FLASH_ATM_ABNORMAL_TEST_BEFORE_ERASE
	bool "Reboot before erase loop"
	help
	  Trigger reboot before entering the erase loop to test recovery
	  from abnormal state before flash operation starts.

config FLASH_ATM_ABNORMAL_TEST_DURING_ERASE
	bool "Reboot during erase loop"
	help
	  Trigger reboot during the erase loop to test recovery from
	  abnormal state in the middle of flash erase operation.

endchoice

config SOC_FLASH_ATM
	bool "Atmosic external flash driver"
	depends on DT_HAS_ATMOSIC_EXTERNAL_FLASH_CONTROLLER_ENABLED
	select FLASH_HAS_DRIVER_ENABLED
	select FLASH_HAS_PAGE_LAYOUT
	select FLASH_HAS_EXPLICIT_ERASE
	select MPU_ALLOW_FLASH_WRITE if ARM_MPU
	default y if !(BOOTLOADER_MCUBOOT && TRUSTED_EXECUTION_SECURE) || ATM_NO_SPE
	help
	  Enable Atmosic external flash driver.

config SOC_FLASH_ATM_USE_BREAK_IN
	bool "Allow the use of Atmosic flash break-in HW support if available"
	default y
	depends on SOC_FLASH_ATM
	depends on MULTITHREADING
	depends on !MCUBOOT
	depends on !SOC_FLASH_ATM_USE_SW_MANAGED_ERASE
	help
	  Break-in reduces the impact of long running flash operations such as erase
	  from impacting system responsiveness.

config SOC_FLASH_ATM_RRAM
	bool "Atmosic RRAM driver"
	depends on DT_HAS_ATMOSIC_RRAM_CONTROLLER_ENABLED
	select FLASH_HAS_DRIVER_ENABLED
	select FLASH_HAS_PAGE_LAYOUT
	select FLASH_HAS_NO_EXPLICIT_ERASE
	select MPU_ALLOW_FLASH_WRITE if ARM_MPU
	default y
	help
	  Enable Atmosic RRAM driver.

config SOC_FLASH_ATM_USE_SW_MANAGED_ERASE
	bool "Manage external flash erase with software"
	default y if ATM_APP_FLASH_XIP && ATM_SPLIT_IMG
	depends on SOC_FLASH_ATM
	depends on MULTITHREADING
	help
	  Use software managed flash erase instead of the QSPI accelerator. This feature can
	  mitigate the impact of long erase times for platforms that do not support erase breakin
	  by offering software managed erase suspend/resume duty cycles.

if SOC_FLASH_ATM_USE_SW_MANAGED_ERASE

config SOC_FLASH_ATM_SW_SECTOR_ERASE_DURATION_US
	int "Software sector erase active period duration in microseconds"
	range 50 10000
	default 1000
	help
	  Duration of the erase period before suspending the erase to allow other processing.
	  Shorter durations provide better responsiveness but may increase total erase time due
	  to suspend/resume overhead. Interrupts are disabled during the erase duration. When
	  the duration expires the driver will yield to the system but maintain the suspended
	  erase state of the flash device. The system is not allowed to enter deep low power
	  states while erase is suspended.

config SOC_FLASH_ATM_SW_ERASE_POLL_DELAY_US
	int "Software erase status polling delay in microseconds"
	range 10 1000
	default 100
	help
	  Delay between status register polls during the erase operation. Smaller values
	  provide faster erase completion detection but increases SPI bus activity. Larger
	  values reduce SPI bus activity but may delay erase completion detection.

config SOC_FLASH_ATM_SW_SECTOR_ERASE_SUSPEND_SLEEP_US
	int "Sleep time while sector erase is suspended in microseconds"
	range 0 10000
	default 0
	help
	  When a sector erase is suspended the driver will sleep (yield) to the system using this
	  sleep duration. For flash devices this can reduce average current draw during this long
	  operation. While erase is suspended, however, the system cannot go into deeper low power
	  modes. A value of 0 will fall back to yielding rather than sleeping that can result in a
	  faster sector erase time. Adjusting SOC_FLASH_ATM_SW_SECTOR_ERASE_DURATION_US with this
	  configuration can set the effective duty cycle of the sector erase operation using erase
	  suspend/resume.

config SOC_FLASH_ATM_SW_SEC_ERASE_TIMEOUT_MS
	int "Software sector erase timeout in milliseconds"
	range 100 3000
	default 200
	help
	  The maximum duration of a single sector erase operation before a timeout is detected.
	  The timeout only applies to the periods in which erase is active and not suspended.
	  This is only an overall timeout value and can be set conservatively to cover most SPI
	  NOR flash devices.

config SOC_FLASH_ATM_SW_ALLOW_32K_BLK_ERASE
	bool "Software can use the 32K block erase commands"
	default y
	help
	  If the requested erase size and offset is aligned to 32KB, the more optimal block erase
	  will be used. Disable this feature if only 4KB sector erases should be used.

if SOC_FLASH_ATM_SW_ALLOW_32K_BLK_ERASE

config SOC_FLASH_ATM_SW_32K_ERASE_DURATION_US
	int "Software 32K block erase active period duration in microseconds"
	range 50 10000
	default SOC_FLASH_ATM_SW_SECTOR_ERASE_DURATION_US
	help
	  This configuration is similar to SOC_FLASH_ATM_SW_SECTOR_ERASE_DURATION_US but is
	  applied during a 32K block erase operation.

config SOC_FLASH_ATM_SW_32K_ERASE_SUSPEND_SLEEP_US
	int "Sleep time while 32KB erase operation is suspended in microseconds"
	range 0 10000
	default 1000
	help
	  This configuration behaves the same as SOC_FLASH_ATM_SW_SECTOR_ERASE_SUSPEND_SLEEP_US but
	  the value is used during a 32KB block erase. This can reduce average sustained current
	  draw during this very long erase operation. This value can be adjusted with
	  SOC_FLASH_ATM_SW_32K_ERASE_DURATION_US to adjust the duty cycle of the erase. A sleep
	  time of 1000us and an erase duration of 1000us results in ~50% duty cycle.

config SOC_FLASH_ATM_SW_32K_BLK_ERASE_TIMEOUT_MULT
	int "32KB block erase timeout multiplier"
	range 1 8
	default 6
	help
	  This multiplier is applied to SOC_FLASH_ATM_SW_SEC_ERASE_TIMEOUT_MS when 32KB block erase
	  is used to compute the timeout. Blk erase is more efficient than sector erase and typically
	  ranges from 1x to 6x the sector erase time. This is only an overall timeout value and can
	  be set conservatively to support most SPI NOR flash devices.

endif # SOC_FLASH_ATM_SW_ALLOW_32K_BLK_ERASE

endif # SOC_FLASH_ATM_USE_SW_MANAGED_ERASE

config SOC_FLASH_ATM_LOWER_RADIO_PWR_DURING_WRITE
	bool "Reduce Radio Transmit Power during flash write"
	default y if BT
	help
	  Reduces peak current consumption by lowering radio
	  transmit power (set lowest gain index) during flash
	  write operation

config SOC_FLASH_ATM_LOWER_RADIO_PWR_DURING_ERASE
	bool "Reduce Radio Transmit Power during flash erase"
	default y if BT
	help
	  Reduces peak current consumption by lowering radio
	  transmit power (set lowest gain index) during flash
	  erase operation
```

## drivers/i2s/Kconfig.atm
```kconfig
# I2S driver configuration options

# Copyright (c) 2025 Atmosic
# SPDX-License-Identifier: Apache-2.0

menuconfig I2S_ATM
	bool "Atmosic I2S driver"
	default y
	depends on DT_HAS_ATMOSIC_ATM_I2S_ENABLED
	select ATM_DMA
	select RING_BUFFER
	help
	  Enable I2S support on the ATM family of processors.

if I2S_ATM

config ATM_FIFO_TX_ISR
	bool "Enable very high IRQ on TX DMA"

config I2S_WSCNT
	int "force I2S word select count"
	default 0
	help
	  Force the number of word select count. 0 means no force.

config I2S_TX_BLOCK_NUM
	int "Maximum number of TX blocks"
	default 20
	help
	  Number of blocks in the TX buffer.

config I2S_BLOCK_SIZE
	int "Size of each block in bytes"
	default 128
	depends on ATM_FIFO_TX_ISR
	help
	  Size of a single TX block in bytes.

endif # I2S_ATM
```

## drivers/input/Kconfig.atm
```kconfig
# SPDX-License-Identifier: Apache-2.0

config INPUT_ATM_KBD_MATRIX
	bool "ATM keyboard matrix input driver"
	default y
	depends on DT_HAS_ATMOSIC_INPUT_KBD_MATRIX_ENABLED
	help
	  Enable keyboard matrix input driver for ATM.

config INPUT_ATM_KBD_MATRIX_THREAD_STACK_SIZE
	int "thread stack size"
	default 1024
	depends on INPUT_ATM_KBD_MATRIX
	help
	  Input keyboard matrix thread stack size.
```

## drivers/kscan/Kconfig
```kconfig
# SPDX-License-Identifier: Apache-2.0

if KSCAN

rsource "Kconfig.atm"

endif # KSCAN
```

## drivers/pwm/Kconfig.atm
```kconfig
# PWM configuration options

# Copyright (c) 2021-2025 Atmosic
# SPDX-License-Identifier: Apache-2.0

config PWM_ATM
	bool "Atmosic PWM driver"
	default y
	depends on DT_HAS_ATMOSIC_ATM3X_PWM_ENABLED
	help
	  This option enables the PWM driver for Atmosic family of
	  processors.

config PWM_ATM_FIFO
	bool "Atmosic PWM FIFO mode support"
	default y
	depends on PWM_ATM
	select CONFIG_ATM_DMA
	help
	  This option enables FIFO mode support for Atmosic PWM driver.
	  FIFO mode allows complex waveform generation with two carrier
	  frequencies and automatic pattern sequencing, useful for
	  applications like ringtones and IR signal generation.
	  Applicable on all Atmosic chipsets except ATMx2 series.
```

## drivers/spi/Kconfig.atm
```kconfig
# ATM SPI configuration options

# Copyright (c) 2021-2023 Atmosic
# SPDX-License-Identifier: Apache-2.0

menuconfig SPI_ATM
	bool "Atmosic SPI driver"
	default y
	depends on DT_HAS_ATMOSIC_ATM_SPI_ENABLED
	help
	  Enables the ATM SPI driver

if SPI_ATM

config SPI_ATM_WATCHDOG
	bool "Enable sw watchdog for SPI transactions"

config SPI_ATM_DMA
	bool "When possible, use DMA for SPI transfers"
	depends on ATM_DMA && !ATM_DMA_MINIMAL

endif # SPI_ATM
```

## drivers/wurx/Kconfig.atm
```kconfig
# Copyright (c) 2025 Atmosic
# SPDX-License-Identifier: Apache-2.0

config WURX
	bool "Atmosic WuRx driver"
	depends on DT_HAS_ATMOSIC_WURX_ENABLED
	select PM
	select SETTINGS
	help
	  This driver provides wake-up radio functionality with configurable
	  dual-channel detection and power management integration.

module = WURX
module-str = wurx
source "subsys/logging/Kconfig.template.log_config"
```

## dts/bindings/atmosic,atm-i2c.yaml
```yaml
description: Atmosic I2C

compatible: "atmosic,atm-i2c"

include: [i2c-controller.yaml, pinctrl-device.yaml]

properties:
    reg:
      required: true

    interrupts:
      required: true

    instance:
      type: int
      required: true
      description: I2C instance

    clk-stretch:
      type: boolean
      required: false
      description: Set clock stretching

    pinctrl-0:
      required: true

    pinctrl-names:
      required: true
```

## dts/bindings/atmosic,fixed_atmwstk.yaml
```yaml
description: Atmosic fixed wireless stack image partition

compatible: "atmosic,fixed_atmwstk"

include: atmosic,tz-fixed-partitions.yaml

child-binding:
  properties:
    variant:
      type: string
      description: Fixed wireless stack flavor/variant identifier
```

## dts/bindings/atmosic,retained-hib.yaml
```yaml
# Copyright (c) 2025 Atmosic Technologies
# SPDX-License-Identifier: Apache-2.0

description: |
  Atmosic hibernation retained memory driver.

  This driver provides retained memory functionality using Atmosic SOC's
  SHUB (Sensor Hub) registers and PSEQ (Power Sequencer) persistent registers
  that retain their values during hibernation and low power modes.

  The driver automatically determines the available storage capacity based on
  the SOC variant:
  - With PERSISTENT6: 222 bytes
  - With PERSISTENT5: 218 bytes
  - Base configuration: 198 bytes

  Example usage:

  retained_mem_hib: retained-memory {
    compatible = "atmosic,retained-hib";
    status = "okay";
  };

compatible: "atmosic,retained-hib"

include: base.yaml

properties:
  status:
    default: "okay"
```

## dts/bindings/atmosic,wurx.yaml
```yaml
# Copyright (c) 2025 Atmosic
# SPDX-License-Identifier: Apache-2.0

description: |
  Atmosic WuRx (Wake upon receive) driver

  The WuRx driver provides wake-up radio functionality for Atmosic ATM33x and ATM34x chips.
  It supports dual-algorithm wake-up detection with configurable timing parameters
  and power management integration.

  Example usage:

  wurx: wurx {
      compatible = "atmosic,wurx";
      wurx0-enabled;
      wurx1-enabled;
      wake-timeout-ms = <500>;
      consecutive-signals = <4>;
      signal-spacing-ms = <250>;
      status = "okay";
  };

compatible: "atmosic,wurx"

include: base.yaml

properties:
  wurx0-enabled:
    type: boolean
    description: |
      Enable WuRx algorithm 0. When enabled, this algorithm will participate
      in wake-up detection.

  wurx1-enabled:
    type: boolean
    description: |
      Enable WuRx algorithm 1. When enabled, this algorithm will participate
      in wake-up detection.

  wake-timeout-ms:
    type: int
    default: 500
    description: |
      Wake-up detection timeout in milliseconds. This defines how long the
      WuRx hardware will wait for a valid wake-up signal before timing out.

  consecutive-signals:
    type: int
    default: 4
    description: |
      Number of consecutive signals required for wake-up detection.
      Higher values provide better noise immunity but may increase latency.

  signal-spacing-ms:
    type: int
    default: 250
    description: |
      Expected spacing between consecutive signals in milliseconds.
      This helps the algorithm distinguish between valid wake-up patterns
      and random noise.

  # PMU WURX register default values
  wurx-general-default:
    type: int
    default: 0x00202600
    description: |
      Default value for PMU WURX_GENERAL register.
      This corresponds to the first 32-bit value in the WuRx configuration.

  wurx-general2-default:
    type: int
    default: 0x000320c8
    description: |
      Default value for PMU WURX_GENERAL2 register.
      This corresponds to the second 32-bit value in the WuRx configuration.

  wurx0-regs-default:
    type: array
    default: [0x0000aaaa, 0x0000aaaa, 0x0a0f78d0, 0x20100c04, 0x08802013]
    description: |
      Default values for PMU WURX0 registers (wurx0_0 through wurx0_4).
      Array of 5 32-bit values corresponding to the WuRx0 configuration.

  wurx1-regs-default:
    type: array
    default: [0xaaaaaaaa, 0xffffffff, 0x0c0a515f, 0x20100c04, 0x0880200f]
    description: |
      Default values for PMU WURX1 registers (wurx1_0 through wurx1_4).
      Array of 5 32-bit values corresponding to the WuRx1 configuration.
```

## dts/bindings/memory/atmosic,spe-fault-storage.yaml
```yaml
# Copyright (c) 2025 Atmosic
# SPDX-License-Identifier: Apache-2.0

description: Atmosic SPE Secure Fault Storage Memory Region

compatible: "atmosic,spe-fault-storage"

include: base.yaml

properties:
  reg:
    required: true
    description: |
      Memory region for storing secure fault data.
      This region should be in secure memory and persist across warm resets.
```
