/*
 * Copyright (c) 2025-2026 Atmosic
 *
 * SPDX-License-Identifier: LicenseRef-Atmosic
 */

/ {
    resources {
	compatible = "test-gpio-basic-api";
	status = "okay";
	out-gpios = <&gpio0 6 GPIO_ACTIVE_HIGH>;
	in-gpios = <&gpio0 7 GPIO_ACTIVE_HIGH>;
    };
};
