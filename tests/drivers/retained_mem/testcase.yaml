## tests/drivers/retained_mem/testcase.yaml
```yaml
# Copyright (c) 2026 Atmosic
#
# SPDX-License-Identifier: LicenseRef-Atmosic

common:
  sysbuild: true
  tags:
    - retained_mem
tests:
  tests.drivers.retained_mem.atm:
    {}
  tests.drivers.retained_mem.atm.gcov:
    tags:
      - gcov
    depends_on:
      - gcov_capable
    timeout: 180
    extra_configs:
      - CONFIG_UU_TEST_OPENAIR="retained_mem_hib.c;retained_mem_hib_expansion.c;retained_mem_hib_shub.c"
  tests.drivers.retained_mem.atm.fixed_offset_0_no_mutex.gcov:
    tags:
      - gcov
    depends_on:
      - gcov_capable
    timeout: 180
    extra_configs:
      - CONFIG_RETAINED_MEM_ATM_FIXED_OFFSET_0=y
      - CONFIG_RETAINED_MEM_MUTEX_FORCE_DISABLE=y
      - CONFIG_UU_TEST_OPENAIR="retained_mem_hib.c;retained_mem_hib_expansion.c;retained_mem_hib_shub.c"
```

## tests/drivers/spi/spi_loopback/testcase.yaml
```yaml
# Copyright (c) 2026 Atmosic
#
# SPDX-License-Identifier: LicenseRef-Atmosic

common:
  sysbuild: true
  harness: ztest
  extra_configs:
    - CONFIG_SPI_LOOPBACK_MODE_LOOP=y
    - CONFIG_SPI_IDEAL_TRANSFER_DURATION_SCALING=30

tests:
  tests.drivers.spi.spi_loopback.atm.gcov:
    tags:
      - gcov
    depends_on:
      - gcov_capable
    extra_configs:
      - CONFIG_UU_TEST_OPENAIR="spi_atm.c;pinctrl_atm.c"
  tests.drivers.spi.spi_loopback.atm.clk_gate.gcov:
    tags:
      - gcov
    depends_on:
      - gcov_capable
    extra_configs:
      - CONFIG_SPI_ATM_AUTO_CLK_GATE=y
      - CONFIG_UU_TEST_OPENAIR="spi_atm.c;pinctrl_atm.c"
```

## tests/drivers/watchdog/wdt_basic_api/testcase.yaml
```yaml
# Copyright (c) 2026 Atmosic
#
# SPDX-License-Identifier: LicenseRef-Atmosic

common:
  tags:
    - drivers
    - watchdog

tests:
  tests.drivers.watchdog.wdt_basic_api.atm:
    sysbuild: true
```

## tests/drivers/watchdog/wdt_basic_reset_none/testcase.yaml
```yaml
# Copyright (c) 2026 Atmosic
#
# SPDX-License-Identifier: LicenseRef-Atmosic

common:
  tags:
    - drivers
    - watchdog

tests:
  tests.drivers.watchdog.wdt_basic_reset_none.atm:
    sysbuild: true
```

## tests/drivers/watchdog/wdt_unified_api/testcase.yaml
```yaml
# Copyright (c) 2026 Atmosic
#
# SPDX-License-Identifier: LicenseRef-Atmosic

common:
  tags:
    - drivers
    - watchdog
  depends_on:
    - wdt
tests:
  tests.drivers.watchdog.wdt_unified_api.atm:
    sysbuild: true
    tags:
      - wdt_unified_api
  tests.drivers.watchdog.wdt_unified_api.atm.gcov:
    sysbuild: true
    tags:
      - gcov
    depends_on:
      - gcov_capable
    timeout: 180
    extra_configs:
      - CONFIG_UU_TEST_OPENAIR="wdt_atm_unified.c"
```

## tests/drivers/wurx/testcase.yaml
```yaml
# SPDX-License-Identifier: LicenseRef-Atmosic
# Copyright (c) 2025-2026 Atmosic

common:
  sysbuild: true
  harness: ztest
  tags:
    - drivers
    - wurx
  depends_on:
    - wurx
tests:
  tests.drivers.wurx.atm: &base_config {}

  tests.drivers.wurx.atm.gcov:
    <<: *base_config
    tags:
      - gcov
    depends_on:
      - gcov_capable
    timeout: 180
    extra_configs:
      - CONFIG_UU_TEST_OPENAIR="wurx_atm.c"
```

## tests/lib/atm_bthci_utils/testcase.yaml
```yaml
# Copyright (c) 2026 Atmosic
#
# SPDX-License-Identifier: LicenseRef-Atmosic

tests:
  tests.lib.atm_bthci_utils.atm: &base_config
    sysbuild: true
    harness: ztest
    tags:
      - atm_bthci_utils
    timeout: 60
  tests.lib.atm_bthci_utils.atm.gcov:
    <<: *base_config
    tags:
      - gcov
    depends_on:
      - gcov_capable
    timeout: 180
    extra_configs:
      - CONFIG_UU_TEST_OPENAIR="atm_bthci_utils_dump.c"
```

## tests/lib/atm_shell/testcase.yaml
```yaml
# Copyright (c) 2026 Atmosic
#
# SPDX-License-Identifier: LicenseRef-Atmosic

tests:
  tests.lib.atm_shell.atm: &base_config
    sysbuild: true
    harness: console
    harness_config:
      type: one_line
      regex:
        - "atm shell test! (.*)"
    extra_configs:
      - CONFIG_LOG_BACKEND_UART=y
      - CONFIG_SHELL_LOG_BACKEND=n
  tests.lib.atm_shell.atm.gcov:
    <<: *base_config
    tags:
      - gcov
    depends_on:
      - gcov_capable
    timeout: 180
    extra_configs:
      - CONFIG_LOG_BACKEND_UART=y
      - CONFIG_SHELL_LOG_BACKEND=n
      - CONFIG_UU_TEST_OPENAIR="atm_shell.c"
```

## tests/lib/atm_vendor_dfu/testcase.yaml
```yaml
# Copyright (c) 2026 Atmosic
#
# SPDX-License-Identifier: LicenseRef-Atmosic

common:
  sysbuild: true
  harness: ztest
  tags:
    - dfu
    - mcuboot
    - atm_vendor_dfu
  depends_on:
    - flash
    - rram
  extra_args:
    - SB_CONFIG_BOOTLOADER_MCUBOOT=y
    - SB_CONFIG_BOOT_SIGNATURE_TYPE_ECDSA_P256=y
    - SB_CONFIG_DTS_EXTRA_SELECT_CPD200_HINT=y
  timeout: 60

tests:
  tests.lib.atm_vendor_dfu.atm.mcuboot.single_image: &single_image
    extra_args:
      - SB_CONFIG_MCUBOOT_MODE_SWAP_SCRATCH=y
      - SB_ATM_DTS_EXTRA_CPPFLAGS="-DATM_MCUBOOT_SWAP_WITH_OFFSET=0"
  tests.lib.atm_vendor_dfu.atm.mcuboot.flash_xip.dual_image: &flash_xip_dual_image
    tags:
      - flash_xip
    depends_on:
      - xip
    extra_args:
      - SB_CONFIG_MCUBOOT_MODE_SWAP_USING_OFFSET=y
      - SB_ATM_DTS_EXTRA_CPPFLAGS="-DATM_APP_FLASH_XIP;-DATM_STORAGE_SIZE=0x1000;-DATM_MCUBOOT_SCRATCH_SIZE=0"
      - mcuboot_CONFIG_UPDATEABLE_IMAGE_NUMBER=2

  tests.lib.atm_vendor_dfu.atm.mcuboot.single_image.gcov:
    <<: *single_image
    tags:
      - gcov
    depends_on:
      - gcov_capable
    timeout: 180
    extra_configs:
      - CONFIG_COVERAGE=y
      - CONFIG_MAIN_STACK_SIZE=8192
      - CONFIG_UART_ATM_PM_WQ_STACK_SIZE=2048
      - CONFIG_UU_TEST_OPENAIR="atm_vendor_dfu.c"
  tests.lib.atm_vendor_dfu.atm.mcuboot.flash_xip.dual_image.gcov:
    <<: *flash_xip_dual_image
    tags:
      - gcov
      - flash_xip
    depends_on:
      - gcov_capable
      - xip
    timeout: 180
    extra_configs:
      - CONFIG_COVERAGE=y
      - CONFIG_MAIN_STACK_SIZE=8192
      - CONFIG_UU_TEST_OPENAIR="atm_vendor_dfu.c"

  tests.lib.atm_vendor_dfu.atm.mcuboot.pytest.single_image:
    harness: pytest
    timeout: 600
    extra_args:
      - SB_CONFIG_MCUBOOT_MODE_SWAP_SCRATCH=y
      - SB_ATM_DTS_EXTRA_CPPFLAGS="-DATM_MCUBOOT_SWAP_WITH_OFFSET=0"
      - DTC_OVERLAY_FILE=app_pytest.overlay
    extra_configs:
      - CONFIG_ZTEST=n
      - CONFIG_SERIAL=y
      - CONFIG_REBOOT=y
    harness_config:
      pytest_root: ["pytest/test_dfu_swap.py"]
      pytest_args:
        - "-v"
        - "--dfu-mode=single"
  tests.lib.atm_vendor_dfu.atm.mcuboot.pytest.flash_xip.dual_image:
    harness: pytest
    timeout: 600
    tags:
      - flash_xip
    depends_on:
      - xip
    extra_args:
      - SB_CONFIG_MCUBOOT_MODE_SWAP_USING_OFFSET=y
      - SB_ATM_DTS_EXTRA_CPPFLAGS="-DATM_APP_FLASH_XIP;-DATM_STORAGE_SIZE=0x1000;-DATM_MCUBOOT_SCRATCH_SIZE=0"
      - mcuboot_CONFIG_UPDATEABLE_IMAGE_NUMBER=2
      - DTC_OVERLAY_FILE=app_pytest.overlay
    extra_configs:
      - CONFIG_ZTEST=n
      - CONFIG_SERIAL=y
      - CONFIG_REBOOT=y
    harness_config:
      pytest_root: ["pytest/test_dfu_swap.py"]
      pytest_args:
        - "-v"
        - "--dfu-mode=dual"
```

## tests/lib/dtm_2wire/testcase.yaml
```yaml
# Copyright (c) 2026 Atmosic
#
# SPDX-License-Identifier: LicenseRef-Atmosic

tests:
  tests.lib.dtm_2wire.atm: &base_config
    sysbuild: true
    harness: ztest
    tags:
      - bluetooth
      - dtm
    timeout: 60
  tests.lib.dtm_2wire.atm.gcov:
    <<: *base_config
    tags:
      - gcov
    depends_on:
      - gcov_capable
    timeout: 180
    extra_configs:
      - CONFIG_UU_TEST_OPENAIR="dtm_hci_bridge.c;dtm_mgr.c;dtm_mgr_proc.c"
  tests.lib.dtm_2wire.atm.simulated_rx:
    <<: *base_config
    extra_configs:
      - CONFIG_DTM_2WIRE_RX_TESTING_SIMULATED=y
```

## tests/subsys/audio/stream/i2s_stress/testcase.yaml
```yaml
# Copyright (c) 2026 Atmosic
#
## SPDX-License-Identifier: LicenseRef-Atmosic
#
common:
  # boards/common.overlay dereferences &i2s, so the overlay only compiles on a
  # SoC declaring that node.
  depends_on:
    - i2s
tests:
  tests.subsys.audio.stream.i2s_stress.atm: &base_config
    sysbuild: true
    timeout: 100
    tags:
      - audio
  tests.subsys.audio.stream.i2s_stress.atm.gcov:
    <<: *base_config
    tags:
      - gcov
    depends_on:
      - gcov_capable
    timeout: 180
    extra_configs:
      - CONFIG_UU_TEST_OPENAIR="audio_stream.c"
```

## tests/subsys/audio/stream/state_machine/testcase.yaml
```yaml
# Copyright (c) 2026 Atmosic
#
## SPDX-License-Identifier: LicenseRef-Atmosic
#
common:
  # boards/common.overlay dereferences &i2s, so the overlay only compiles on a
  # SoC declaring that node.
  depends_on:
    - i2s
tests:
  tests.subsys.audio.stream.state_machine.atm: &base_config
    sysbuild: true
    tags:
      - audio
  tests.subsys.audio.stream.state_machine.atm.gcov:
    <<: *base_config
    tags:
      - gcov
    depends_on:
      - gcov_capable
    timeout: 180
    extra_configs:
      - CONFIG_UU_TEST_OPENAIR="audio_stream.c"
```

## tests/subsys/debug/assert_thread_dump/testcase.yaml
```yaml
# Copyright (c) 2026 Atmosic
#
# SPDX-License-Identifier: LicenseRef-Atmosic

common:
  tags:
    - debug
    - assert_thread_dump
  sysbuild: true
  timeout: 60
  harness: console
  harness_config:
    type: multi_line
    ordered: true
    regex:
      - "=== ASSERT: Thread Dump ==="
      - "pender"
      - "PC=0x[0-9a-f]{8} LR=0x[0-9a-f]{8} SP=0x[0-9a-f]{8}"
      - "IPSR: 0x[0-9a-f]{8}"
      - "=== END Thread Dump ==="

tests:
  tests.subsys.debug.assert_thread_dump.atm: {}
  tests.subsys.debug.assert_thread_dump.atm.assert_info:
    extra_configs:
      - CONFIG_TEST_TRIGGER_ASSERT_INFO=y
  tests.subsys.debug.assert_thread_dump.atm.k_panic:
    extra_configs:
      - CONFIG_TEST_TRIGGER_K_PANIC=y
```

## tests/subsys/debug/coredump_backends/testcase.yaml
```yaml
# Copyright (c) 2026 Atmosic
#
# SPDX-License-Identifier: LicenseRef-Atmosic

common:
  tags:
    - coredump
  sysbuild: true
tests:
  tests.subsys.debug.coredump_backends.atm:
    harness: console
    harness_config:
      type: one_line
      regex:
        - "PASS - test_coredump_0_ready"
  tests.subsys.debug.coredump_backends.atm.flash:
    tags:
      - flash
    extra_configs:
      - CONFIG_TEST_STORED_COREDUMP=y
```

## tests/subsys/dfu/at_cmd_dfu/testcase.yaml
```yaml
# Copyright (c) 2026 Atmosic
#
# SPDX-License-Identifier: LicenseRef-Atmosic

common:
  sysbuild: true
  tags:
    - dfu
    - mcuboot
    - at_cmd
    - at_cmd_dfu
  depends_on:
    - flash
    - rram
  extra_args:
    - SB_CONFIG_BOOTLOADER_MCUBOOT=y
    - SB_CONFIG_BOOT_SIGNATURE_TYPE_ECDSA_P256=y
    - SB_CONFIG_DTS_EXTRA_SELECT_CPD200_HINT=y
  timeout: 600

tests:
  tests.subsys.dfu.at_cmd_dfu.atm.mcuboot.pytest.single_image:
    harness: pytest
    extra_args:
      - SB_CONFIG_MCUBOOT_MODE_SWAP_SCRATCH=y
      - SB_ATM_DTS_EXTRA_CPPFLAGS="-DATM_MCUBOOT_SWAP_WITH_OFFSET=0"
      - DTC_OVERLAY_FILE=app_pytest.overlay
    extra_configs:
      - CONFIG_SERIAL=y
      - CONFIG_REBOOT=y
    harness_config:
      pytest_root: ["pytest/test_at_cmd_dfu_swap.py"]
      pytest_args:
        - "-v"
        - "--dfu-mode=single"

  tests.subsys.dfu.at_cmd_dfu.atm.mcuboot.pytest.flash_xip.dual_image:
    harness: pytest
    tags:
      - flash_xip
    depends_on:
      - xip
    extra_args:
      - SB_CONFIG_MCUBOOT_MODE_SWAP_USING_OFFSET=y
      - SB_ATM_DTS_EXTRA_CPPFLAGS="-DATM_APP_FLASH_XIP;-DATM_STORAGE_SIZE=0x1000;-DATM_MCUBOOT_SCRATCH_SIZE=0"
      - mcuboot_CONFIG_UPDATEABLE_IMAGE_NUMBER=2
      - DTC_OVERLAY_FILE=app_pytest.overlay
    extra_configs:
      - CONFIG_SERIAL=y
      - CONFIG_REBOOT=y
    harness_config:
      pytest_root: ["pytest/test_at_cmd_dfu_swap.py"]
      pytest_args:
        - "-v"
        - "--dfu-mode=dual"
```

## tests/subsys/dfu/img_util/testcase.yaml
```yaml
# Copyright (c) 2026 Atmosic
#
# SPDX-License-Identifier: LicenseRef-Atmosic

common:
  sysbuild: true
  tags:
    - mcuboot
    - flash
    - atm_test_with_spe
tests:
  tests.subsys.dfu.img_util.atm.mcuboot:
    extra_args:
      - SB_CONFIG_BOOTLOADER_MCUBOOT=y
      - SB_CONFIG_BOOT_SIGNATURE_TYPE_ECDSA_P256=y
      - SB_CONFIG_MCUBOOT_MODE_SWAP_SCRATCH=y
      - SB_ATM_DTS_EXTRA_CPPFLAGS="-DATM_MCUBOOT_SWAP_WITH_OFFSET=0"
      - SB_CONFIG_DTS_EXTRA_SELECT_CPD200_HINT=y
  tests.subsys.dfu.img_util.atm.mcuboot.overwrite:
    extra_args:
      - SB_CONFIG_BOOTLOADER_MCUBOOT=y
      - SB_CONFIG_BOOT_SIGNATURE_TYPE_ECDSA_P256=y
      - SB_CONFIG_MCUBOOT_MODE_OVERWRITE_ONLY=y
      - SB_CONFIG_DTS_EXTRA_SELECT_CPD200_HINT=y
```

## tests/subsys/dfu/mcuboot_multi/testcase.yaml
```yaml
# Copyright (c) 2026 Atmosic
#
# SPDX-License-Identifier: LicenseRef-Atmosic

common:
  sysbuild: true
  tags:
    - mcuboot
    - flash
    - dfu_mcuboot
    - flash_xip
  depends_on:
    - flash
    - rram
    - xip
  extra_args:
    - SB_CONFIG_BOOTLOADER_MCUBOOT=y
    - SB_CONFIG_BOOT_SIGNATURE_TYPE_ECDSA_P256=y
    - SB_CONFIG_MCUBOOT_MODE_SWAP_SCRATCH=y
    - SB_CONFIG_DTS_EXTRA_SELECT_CPD200_HINT=y
    - SB_ATM_DTS_EXTRA_CPPFLAGS="-DATM_APP_FLASH_XIP"
    - mcuboot_CONFIG_UPDATEABLE_IMAGE_NUMBER=2
tests:
  tests.subsys.dfu.mcuboot_multi.atm.mcuboot.flash_xip: {}
  tests.subsys.dfu.mcuboot_multi.atm.mcuboot.flash_xip.overwrite:
    tags:
      - overwrite
    extra_args:
      - SB_CONFIG_MCUBOOT_MODE_OVERWRITE_ONLY=y
  tests.subsys.dfu.mcuboot_multi.atm.mcuboot.flash_xip.sec_debug:
    tags:
      - sec_debug
    extra_args:
      - SB_ATM_DTS_EXTRA_CPPFLAGS='-DUSE_ATM_SECURE_DEBUG;-DATM_APP_FLASH_XIP'
      - mcuboot_CONFIG_ATM_MCUBOOT_SECURE_DEBUG=y
      - mcuboot_CONFIG_ATM_MCUBOOT_UART_DEBUG_AUTH_TIMEOUT_MS=50000
  tests.subsys.dfu.mcuboot_multi.atm.mcuboot.flash_xip.sec_debug.overwrite:
    tags:
      - sec_debug
      - overwrite
    extra_args:
      - SB_CONFIG_MCUBOOT_MODE_OVERWRITE_ONLY=y
      - SB_ATM_DTS_EXTRA_CPPFLAGS='-DUSE_ATM_SECURE_DEBUG;-DATM_APP_FLASH_XIP'
      - mcuboot_CONFIG_ATM_MCUBOOT_SECURE_DEBUG=y
      - mcuboot_CONFIG_ATM_MCUBOOT_UART_DEBUG_AUTH_TIMEOUT_MS=50000
  tests.subsys.dfu.mcuboot_multi.atm.mcuboot.flash_xip.skip_validate:
    extra_args:
      - mcuboot_CONFIG_ATM_MCUBOOT_SKIP_PRIMARY_VALIDATE_HIBER=y
  tests.subsys.dfu.mcuboot_multi.atm.mcuboot.flash_xip.skip_validate.overwrite:
    tags:
      - overwrite
    extra_args:
      - mcuboot_CONFIG_ATM_MCUBOOT_SKIP_PRIMARY_VALIDATE_HIBER=y
      - SB_CONFIG_MCUBOOT_MODE_OVERWRITE_ONLY=y
  tests.subsys.dfu.mcuboot_multi.atm.mcuboot.flash_xip.skip_validate.sec_debug:
    tags:
      - sec_debug
    extra_args:
      - mcuboot_CONFIG_ATM_MCUBOOT_SKIP_PRIMARY_VALIDATE_HIBER=y
      - SB_ATM_DTS_EXTRA_CPPFLAGS='-DUSE_ATM_SECURE_DEBUG;-DATM_APP_FLASH_XIP'
      - mcuboot_CONFIG_ATM_MCUBOOT_SECURE_DEBUG=y
      - mcuboot_CONFIG_ATM_MCUBOOT_UART_DEBUG_AUTH_TIMEOUT_MS=50000
  tests.subsys.dfu.mcuboot_multi.atm.mcuboot.flash_xip.skip_validate.overwrite.sec_debug:
    tags:
      - sec_debug
      - overwrite
    extra_args:
      - mcuboot_CONFIG_ATM_MCUBOOT_SKIP_PRIMARY_VALIDATE_HIBER=y
      - SB_CONFIG_MCUBOOT_MODE_OVERWRITE_ONLY=y
      - SB_ATM_DTS_EXTRA_CPPFLAGS='-DUSE_ATM_SECURE_DEBUG;-DATM_APP_FLASH_XIP'
      - mcuboot_CONFIG_ATM_MCUBOOT_SECURE_DEBUG=y
      - mcuboot_CONFIG_ATM_MCUBOOT_UART_DEBUG_AUTH_TIMEOUT_MS=50000
```

## tests/subsys/logging/log_backend_fs/testcase.yaml
```yaml
# Copyright (c) 2026 Atmosic
#
# SPDX-License-Identifier: LicenseRef-Atmosic

tests:
  tests.subsys.logging.log_backend_fs.atm:
    sysbuild: true
```

## tests/subsys/pm/power_mgmt_soc/testcase.yaml
```yaml
# Copyright (c) 2026 Atmosic
#
# SPDX-License-Identifier: LicenseRef-Atmosic

common:
  tags:
    - power_management
tests:
  tests.subsys.pm.power_mgmt_soc.atm:
    sysbuild: true
```
