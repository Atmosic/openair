## west.yml
```yaml
manifest:
  group-filter:
  - -babblesim
  - -optional
  - -testing
  projects:
  - name: hal_atmosic_lib
    url: https://github.com/Atmosic/hal_atmosic_lib
    revision: 33c79bae9891bb3cea46266a3a84bda9b4fd24e5
    path: modules/hal/atmosic_lib
  - name: mcuboot
    url: https://github.com/Atmosic/mcuboot
    revision: e591e57a5cd00de12b414bae49d2f1d03d056ee4
    path: bootloader/mcuboot
  - name: micro-ecc
    url: https://github.com/Atmosic/micro-ecc
    revision: 70898ab9a98d5f650f8d4d13b1ff01f3f35f0181
    path: modules/crypto/micro-ecc
  - name: zephyr
    url: https://github.com/Atmosic/zephyr
    revision: 60ec8234fb113b281247ed2c69f4d53e6ad7d7b7
    west-commands: scripts/west-commands.yml
  - name: cmsis
    url: https://github.com/zephyrproject-rtos/cmsis
    revision: 512cc7e895e8491696b61f7ba8066b4a182569b8
    path: modules/hal/cmsis
    groups:
    - hal
  - name: cmsis_6
    url: https://github.com/zephyrproject-rtos/CMSIS_6
    revision: 30a859f44ef8ab4dc8f84b03ed586fd16ccf9d74
    path: modules/hal/cmsis_6
    groups:
    - hal
  - name: littlefs
    url: https://github.com/zephyrproject-rtos/littlefs
    revision: 8f5ca347843363882619d8f96c00d8dbd88a8e79
    path: modules/fs/littlefs
    groups:
    - fs
  - name: mbedtls
    url: https://github.com/zephyrproject-rtos/mbedtls
    revision: a3e190fe44c78d1ba67f55979e1257328cc7d0d8
    path: modules/crypto/mbedtls
    groups:
    - crypto
  - name: tf-psa-crypto
    url: https://github.com/zephyrproject-rtos/tf-psa-crypto
    revision: dc575a2ddcc8cb16275d24c42a52eaf79ebe2231
    path: modules/crypto/tf-psa-crypto
    groups:
    - crypto
  - name: zcbor
    url: https://github.com/zephyrproject-rtos/zcbor
    revision: 9164bd18dcd88ff9d9ef98279501fc1093571017
    path: modules/lib/zcbor
  self:
    path: openair
    west-commands: west/west-commands.yml
```
