## CMakeLists.txt
```
# Copyright (c) 2025-2026 Atmosic
#
# SPDX-License-Identifier: LicenseRef-Atmosic

cmake_minimum_required(VERSION 3.20.0)
find_package(Zephyr REQUIRED HINTS $ENV{ZEPHYR_BASE})
project(test_atm_spe_sec_fault_storage)

target_sources(app PRIVATE
  src/main.c
)

zephyr_sources_ifdef(CONFIG_TEST_LOG_PANIC src/test_log_backend.c)
```

## Kconfig
```
# Copyright (c) 2025-2026 Atmosic
#
# SPDX-License-Identifier: LicenseRef-Atmosic

source "Kconfig.zephyr"

config TEST_LOG_PANIC
	bool "Test with LOG_PANIC when SPE secure fault detected"
```

## prj.conf
```kconfig
# Copyright (c) 2026 Atmosic
#
# SPDX-License-Identifier: LicenseRef-Atmosic

CONFIG_ZTEST=y
```

## src/main.c
```c
/*
 * Copyright (c) 2025-2026 Atmosic
 *
 * SPDX-License-Identifier: LicenseRef-Atmosic
 */

#include <zephyr/ztest.h>
#include <zephyr/kernel.h>
#include <zephyr/sys/printk.h>
#include "atm_spe_sec_fault_ns.h"
#include <inttypes.h>

#ifdef CONFIG_TEST_LOG_PANIC
#include <zephyr/logging/log_ctrl.h>
#endif

static void nsc_process_debug_data(const atm_spe_secure_fault_data_t *data)
{
	printk("***** SPE SECURE FAULT *****\n");
	printk("  xpsr: 0x%" PRIx32 "\n", data->basic_sf.xpsr);
	printk("  lr  : 0x%" PRIx32 "\n", data->basic_sf.lr);
	printk("  pc  : 0x%" PRIx32 "\n", data->basic_sf.pc);
	printk("Fault Reason: %d\n", data->fault_reason);
}

void atm_ns_spe_fault_handler(atm_spe_secure_fault_data_t const *fault_data)
{
	printk("=== SPE SECURE FAULT DETECTED ===\n");
	nsc_process_debug_data(fault_data);
#ifdef CONFIG_TEST_LOG_PANIC
	LOG_PANIC();
#endif
	k_fatal_halt(K_ERR_CPU_EXCEPTION);
}

/**
 * @brief Test actual null pointer access (will cause system reset)
 */
ZTEST(atm_spe_sec_fault_storage, test_actual_null_access)
{
	printk("TESTING NULL POINTER ACCESS\n");

	// check if there is any secure fault data stored
	atm_spe_secure_fault_data_t fault_data;
	if (atm_nsc_spe_get_secure_fault_data(&fault_data, true)) {
		atm_ns_spe_fault_handler(&fault_data);
	}

	/* This will cause a memory fault and trigger the SPE fault handler */
	volatile uint32_t *null_ptr = NULL;
	*null_ptr = 0xDEADBEEF;

	/* We should never reach this point */
	printk("ERROR: Should not reach this point after null access!\n");
	zassert_true(false, "System should have reset after null pointer access");
}

/**
 * @brief Test NSC API with invalid parameters
 */
ZTEST(atm_spe_sec_fault_storage, test_nsc_invalid_params)
{
	bool result;

	/* Test with NULL pointer */
	result = atm_nsc_spe_get_secure_fault_data(NULL, false);
	zassert_false(result, "Should fail with NULL pointer");

	result = atm_nsc_spe_get_secure_fault_data(NULL, true);
	zassert_false(result, "Should fail with NULL pointer when clearing");
}

/* Test suite definition */
ZTEST_SUITE(atm_spe_sec_fault_storage, NULL, NULL, NULL, NULL, NULL);
```

## src/test_log_backend.c
```c
/*
 * Copyright (c) 2025-2026 Atmosic
 *
 * SPDX-License-Identifier: LicenseRef-Atmosic
 */

#include <zephyr/kernel.h>
#include <zephyr/logging/log_backend.h>
#include <zephyr/logging/log_ctrl.h>
#include <zephyr/sys/printk.h>
#include <inttypes.h>

/* Backend API implementation - simplified */
static void test_log_process(const struct log_backend *const backend, union log_msg_generic *msg)
{
	/* Simplified - we only care about panic functionality */
	ARG_UNUSED(backend);
	ARG_UNUSED(msg);
}

static void test_log_dropped(const struct log_backend *const backend, uint32_t cnt)
{
	ARG_UNUSED(backend);
	printk("[TEST_LOG_BACKEND] Dropped %" PRIu32 " log messages\n", cnt);
}

void test_log_panic(const struct log_backend *const backend)
{
	ARG_UNUSED(backend);
	printk("*** TEST LOG PANIC SAVE COMPLETE ***\n");
}

static void test_log_init(const struct log_backend *const backend)
{
	ARG_UNUSED(backend);
}

static int test_log_is_ready(const struct log_backend *const backend)
{
	ARG_UNUSED(backend);
	return 0;
}

/* Backend API structure */
static const struct log_backend_api test_log_backend_api = {
	.process = test_log_process,
	.dropped = test_log_dropped,
	.panic = test_log_panic,
	.init = test_log_init,
	.is_ready = test_log_is_ready,
};

/* Define the backend - autostart enabled */
LOG_BACKEND_DEFINE(test_log_backend, test_log_backend_api, true);

/* Force backend activation during initialization */
static int test_log_backend_init(void)
{
	/* Enable the backend with DEBUG level to capture all logs */
	log_backend_enable(&test_log_backend, NULL, LOG_LEVEL_DBG);
	return 0;
}

/* Initialize at POST_KERNEL level to ensure logging is ready */
SYS_INIT(test_log_backend_init, POST_KERNEL, CONFIG_KERNEL_INIT_PRIORITY_DEFAULT);
```
