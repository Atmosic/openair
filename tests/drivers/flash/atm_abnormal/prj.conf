## CMakeLists.txt
```
# Copyright (c) 2025-2026 Atmosic
#
# SPDX-License-Identifier: LicenseRef-Atmosic

cmake_minimum_required(VERSION 3.20.0)

set(DTC_OVERLAY_FILE boards/common.overlay)

find_package(Zephyr REQUIRED HINTS $ENV{ZEPHYR_BASE})
project(test_flash_atm_abnormal)

target_sources(app PRIVATE
  src/main.c
)
```

## prj.conf
```kconfig
# Copyright (c) 2026 Atmosic
#
# SPDX-License-Identifier: LicenseRef-Atmosic

CONFIG_ZTEST=y
CONFIG_FLASH=y
CONFIG_FLASH_PAGE_LAYOUT=y
CONFIG_NVS=y
CONFIG_LOG=y
```

## boards/common.overlay
```dts
/*
 * Copyright (c) 2025-2026 Atmosic
 *
 * SPDX-License-Identifier: LicenseRef-Atmosic
 */

#include <arm/atmosic/ATM34xx_partition_defs.h>

#ifdef ATM_STORAGE_SIZE
#undef ATM_STORAGE_SIZE
#define ATM_STORAGE_SIZE 0x1000 // 4k
#endif

#define ATM_T_STORAGE_NODE_ID cece00F0
#define T_STORAGE_SIZE 0x4000 //16KB

#ifdef ATM_SLOT1_SIZE
#define T_STORAGE_OFFSET (ATM_SLOT1_OFFSET + ATM_SLOT1_SIZE - T_STORAGE_SIZE)
#else
#define T_STORAGE_OFFSET (FLASH_SIZE - T_STORAGE_SIZE)
#endif

#if ((T_STORAGE_OFFSET+T_STORAGE_SIZE) > FLASH_SIZE)
#error "Test storage size does not fit in specified FLASH_SIZE"
#endif
&flash0 {
	partitions {
		compatible = "atmosic,tz-fixed-partitions", "fixed-partitions";
		#address-cells = <1>;
		#size-cells = <1>;
		t_storage0: partition@ATM_T_STORAGE_NODE_ID {
			label = "t_storage0";
			reg = <T_STORAGE_OFFSET T_STORAGE_SIZE>;
		};
	};
};
```

## src/main.c
```c
/*
 * Copyright (C) Atmosic 2025-2026
 *
 * SPDX-License-Identifier: LicenseRef-Atmosic
 */

#include <zephyr/kernel.h>
#include <zephyr/ztest.h>
#include <zephyr/device.h>
#include <zephyr/drivers/flash.h>
#include <zephyr/devicetree.h>
#include <zephyr/storage/flash_map.h>
#include <zephyr/kvss/nvs.h>
#include <zephyr/linker/section_tags.h>

#define RESET_TEST_MAGIC 0x5AA5C33C

static uint32_t __noinit reset_magic;
static uint8_t __noinit reset_flag;

ZTEST(flash_atm_abnormal, test_flash_abnormal)
{
	static struct nvs_fs nvs = {
		.flash_device = PARTITION_DEVICE(t_storage0),
		.offset = PARTITION_OFFSET(t_storage0),
	};

	/* Check if partition exist */
	if (!device_is_ready(PARTITION_DEVICE(t_storage0))) {
		printk("Flash device %s is not ready\n", PARTITION_DEVICE(t_storage0)->name);
		ztest_test_fail();
	}

	/* Mount t_storage0 partition */
	struct flash_pages_info info;
	int ret = flash_get_page_info_by_offs(PARTITION_DEVICE(t_storage0),
					      PARTITION_OFFSET(t_storage0), &info);
	if (ret) {
		printk("Unable to get page info, rc=%d\n", ret);
		ztest_test_fail();
	}

	nvs.sector_size = info.size;
	nvs.sector_count = PARTITION_SIZE(t_storage0) / info.size;

	TC_PRINT("Doing nvs_mount\n");
	ret = nvs_mount(&nvs);
	if (ret) {
		printk("nvs_mount failed: %d\n", ret);
		ztest_test_fail();
	}

	/* Check if this is a reset after test started */
	if (reset_magic == RESET_TEST_MAGIC && reset_flag == 1) {
		/* Reset occurred - mark test as completed */
		TC_PRINT("nvs_mount success after reset\n");
		reset_flag = 0;
		return;
	}

	/* First run - set flag and trigger abnormal operation */
	reset_magic = RESET_TEST_MAGIC;
	reset_flag = 1;

	// Test abnormal operation - trigger reset during flash operation
	ret = nvs_clear(&nvs);
	if (ret) {
		printk("Failed to nvs_clear: %d\n", ret);
		ztest_test_fail();
	}
}

/* Test suite definition */
ZTEST_SUITE(flash_atm_abnormal, NULL, NULL, NULL, NULL, NULL);
```
