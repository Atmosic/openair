## CMakeLists.txt
```
# Copyright (c) 2026 Atmosic
#
# SPDX-License-Identifier: LicenseRef-Atmosic

cmake_minimum_required(VERSION 3.20.0)

# common overlay file
set(DTC_OVERLAY_FILE boards/common.overlay)

find_package(Zephyr REQUIRED HINTS $ENV{ZEPHYR_BASE})
project(atm_vendor_test)

target_sources(app PRIVATE
  src/main.c
  src/test_atm_vendor_psm.c
  src/test_atm_vendor.c
  src/test_atm_vendor_gpio.c
  src/test_atm_hci_uart.c
)
```

## prj.conf
```kconfig
# Copyright (c) 2026 Atmosic
#
# SPDX-License-Identifier: LicenseRef-Atmosic

CONFIG_ZTEST=y
CONFIG_ZTEST_STACK_SIZE=4096
CONFIG_ZTEST_NO_YIELD=n

CONFIG_SERIAL=y
CONFIG_UART_INTERRUPT_DRIVEN=y

CONFIG_BT=y
CONFIG_BT_HCI_RAW=y
CONFIG_BT_HCI_RAW_H4=y
CONFIG_BT_HCI_RAW_H4_ENABLE=y
CONFIG_BT_HCI_RAW_CMD_EXT=y
CONFIG_BT_BUF_CMD_TX_SIZE=140

CONFIG_ATM_VENDOR=y
CONFIG_VND_PSM=y
CONFIG_VND_GPIO_TEST=y

# Keep the radio settings across sleeps for deterministic testing
CONFIG_ATM_BLE_DRIVER_SLEEP=n

# Match the sample - avoid PM RX thread stack overflow when logging is heavy
CONFIG_UART_ATM_PM_RX_THREAD_STACK_SIZE=2048

# Required so vendor_psm_config exists (guarded by #if CONFIG_PM)
CONFIG_PM=y
CONFIG_PM_DEVICE=y

CONFIG_LOG=y
CONFIG_ATM_VENDOR_LOG_LEVEL_DBG=y
CONFIG_ATM_HCI_UART_LOG_LEVEL_DBG=y
```

## boards/common.overlay
```dts
/*
 * Copyright (c) 2026 Atmosic
 *
 * SPDX-License-Identifier: LicenseRef-Atmosic
 */

&soc_off {
	status = "okay";
};

&uart0 {
	status = "okay";
	current-speed = <2000000>;
	/delete-property/ hw-flow-control;
};

&uart1 {
	status = "okay";
	current-speed = <115200>;
	/delete-property/ hw-flow-control;
};
```

## src/main.c
```c
/*
 * Copyright (c) 2026 Atmosic
 *
 * SPDX-License-Identifier: LicenseRef-Atmosic
 */

#include <stddef.h>

#include <zephyr/kernel.h>
#include <zephyr/ztest.h>

#include "atm_vendor.h"
#include "atm_vendor_internal.h"

/* atm_hci_uart.c publishes the registered vendor handler table pointer.
 * The paired size is intentionally file-static in atm_hci_uart.c, so the
 * tests locate individual entries with a bounded, self-validating scan.
 */
extern struct vendor_handler const *vendor_hdlr;

/* Upper bound on the number of vendor_handler_tab entries in atm_vendor.c
 * under any supported CONFIG_VND_* combination. Kept generous so future
 * additions do not silently fail lookup, but bounded so a lookup for a
 * missing entry cannot walk off the array indefinitely.
 */
#define TEST_HANDLER_SCAN_MAX 64

static bool init_done;

static void *atm_vendor_test_setup(void)
{
	if (!init_done) {
		/* Registers vendor_handler_tab via atm_vendor_handler_register()
		 * and spawns the HCI TX/RX threads (which call bt_enable_raw()).
		 */
		atm_vendor_init();
		init_done = true;

		/* Give the RX thread time to open the HCI raw driver so
		 * subsequent tests operate against a fully initialized stack.
		 */
		k_msleep(200);
	}

	return NULL;
}

/* Lookup helper shared by all test source files.
 *
 * Scans up to TEST_HANDLER_SCAN_MAX entries. The (ocf, ogf) equality plus
 * non-NULL callback checks make a false-positive match on memory past the
 * table effectively impossible for the specific opcodes the tests query.
 */
struct vendor_handler const *test_find_handler(uint8_t ocf, uint8_t ogf)
{
	if (!vendor_hdlr) {
		return NULL;
	}

	for (size_t i = 0; i < TEST_HANDLER_SCAN_MAX; i++) {
		struct vendor_handler const *h = &vendor_hdlr[i];

		if (h->ocf == ocf && h->ogf == ogf && h->cmd_hdlr != NULL &&
		    h->cmd_cmp_hdlr != NULL) {
			return h;
		}
	}

	return NULL;
}

ZTEST_SUITE(atm_vendor_psm, NULL, atm_vendor_test_setup, NULL, NULL, NULL);
ZTEST_SUITE(atm_vendor, NULL, atm_vendor_test_setup, NULL, NULL, NULL);
ZTEST_SUITE(atm_vendor_gpio, NULL, atm_vendor_test_setup, NULL, NULL, NULL);
ZTEST_SUITE(atm_hci_uart, NULL, atm_vendor_test_setup, NULL, NULL, NULL);
```

## src/test_atm_hci_uart.c
```c
/*
 * Copyright (c) 2026 Atmosic
 *
 * SPDX-License-Identifier: LicenseRef-Atmosic
 */

#include <stddef.h>
#include <stdint.h>

#include <zephyr/kernel.h>
#include <zephyr/ztest.h>

#include "atm_vendor_internal.h"

extern struct vendor_handler const *vendor_hdlr;
extern struct vendor_handler const *test_find_handler(uint8_t ocf, uint8_t ogf);

/**
 * @brief After atm_vendor_init() the vendor handler table pointer is set.
 * atm_hci_init() (called from atm_vendor_init) invokes
 * atm_vendor_handler_register() with the atm_vendor.c static table.
 */
ZTEST(atm_hci_uart, test_vendor_handler_pointer_set)
{
	zassert_not_null(vendor_hdlr,
			 "atm_hci_uart's vendor_hdlr must be set after atm_vendor_init()");
}

/**
 * @brief A handler lookup by (ocf, ogf) via the shared test_find_handler
 * helper returns the corresponding entry from the atm_vendor table.
 */
ZTEST(atm_hci_uart, test_find_handler_lookup)
{
	struct vendor_handler const *hdlr = test_find_handler(PSM_CMD_OCF, PSM_CMD_OGF);

	zassert_not_null(hdlr, "PSM handler must be discoverable via test_find_handler");
	zassert_equal(hdlr->ocf, PSM_CMD_OCF, "OCF mismatch");
	zassert_equal(hdlr->ogf, PSM_CMD_OGF, "OGF mismatch");
}
```

## src/test_atm_vendor.c
```c
/*
 * Copyright (c) 2026 Atmosic
 *
 * SPDX-License-Identifier: LicenseRef-Atmosic
 */

#include <stddef.h>
#include <stdint.h>

#include <zephyr/kernel.h>
#include <zephyr/ztest.h>

#include "atm_vendor.h"
#include "atm_vendor_internal.h"

extern struct vendor_handler const *test_find_handler(uint8_t ocf, uint8_t ogf);
extern struct vendor_handler const *vendor_hdlr;

/**
 * @brief atm_vendor_init() has run in setup and must have registered a
 * vendor handler table with atm_hci_uart.
 */
ZTEST(atm_vendor, test_init_registers_handlers)
{
	zassert_not_null(vendor_hdlr, "vendor_hdlr must be non-NULL after atm_vendor_init()");
}

/**
 * @brief The mandatory EXIT_VENDOR handler is always present regardless of the
 * enabled CFG_VND_* set.
 */
ZTEST(atm_vendor, test_exit_vendor_handler_registered)
{
	struct vendor_handler const *hdlr =
		test_find_handler(EXIT_VENDOR_CMD_OCF, EXIT_VENDOR_CMD_OGF);

	zassert_not_null(hdlr, "EXIT_VENDOR handler must be registered");
	zassert_equal(hdlr->cmd_len, EXIT_VENDOR_CMD_LEN, "EXIT_VENDOR cmd_len mismatch");
}

/**
 * @brief PSM handler is registered when CONFIG_VND_PSM is on.
 */
ZTEST(atm_vendor, test_psm_handler_registered)
{
	struct vendor_handler const *hdlr = test_find_handler(PSM_CMD_OCF, PSM_CMD_OGF);

	zassert_not_null(hdlr, "PSM handler must be registered with CONFIG_VND_PSM=y");
	zassert_true(hdlr->check_cmd_len, "PSM entry must validate cmd_len");
	zassert_equal(hdlr->cmd_len, PSM_CMD_LEN, "PSM cmd_len mismatch");
}

/**
 * @brief atm_vendor_get_hci_vendor_en() returns a bool without side effects.
 *
 * The underlying flag is __UNINIT, so its value is not asserted; the API just
 * has to be callable and consistent across successive reads.
 */
ZTEST(atm_vendor, test_get_hci_vendor_en_stable)
{
	bool a = atm_vendor_get_hci_vendor_en();
	bool b = atm_vendor_get_hci_vendor_en();

	zassert_equal(a, b, "atm_vendor_get_hci_vendor_en() must be idempotent");
}
```

## src/test_atm_vendor_gpio.c
```c
/*
 * Copyright (c) 2026 Atmosic
 *
 * SPDX-License-Identifier: LicenseRef-Atmosic
 */

#include <stddef.h>
#include <stdint.h>

#include <zephyr/kernel.h>
#include <zephyr/ztest.h>

#include "atm_vendor_internal.h"

extern struct vendor_handler const *test_find_handler(uint8_t ocf, uint8_t ogf);

/* An absolute pin number beyond every supported GPIO bank makes
 * atm_io_ctrl_get_dev() fail, so gpio_self_test() returns false and the
 * command is reported as failed. Deterministic without external wiring.
 */
#define GPIO_INVALID_PIN 0xFF

/* Drive one GPIO self test command end-to-end:
 *   gpio_self_test_handler(payload) -> runs gpio_self_test() over the pairs
 *   gpio_self_test_cmp_handler()    -> emits the HCI Command Complete event
 * Returns the HCI status byte from the emitted event.
 */
static uint8_t drive_gpio_self_test(uint8_t const *payload, uint8_t **out_evt, uint32_t *out_size)
{
	struct vendor_handler const *hdlr =
		test_find_handler(GPIO_SELF_TEST_CMD_OCF, GPIO_SELF_TEST_CMD_OGF);

	zassert_not_null(hdlr, "GPIO self test handler not registered (CFG_VND_GPIO_TEST off?)");
	zassert_not_null(hdlr->cmd_hdlr, "GPIO self test cmd_hdlr is NULL");
	zassert_not_null(hdlr->cmd_cmp_hdlr, "GPIO self test cmd_cmp_hdlr is NULL");

	hdlr->cmd_hdlr(payload);

	uint8_t *bufptr = NULL;
	uint32_t size = 0;

	hdlr->cmd_cmp_hdlr(&bufptr, &size);
	zassert_not_null(bufptr, "gpio_self_test_cmp_handler returned NULL event buffer");
	zassert_true(size >= BASIC_HCI_EVT_CMD_LEN, "gpio event size %u too small", size);

	if (out_evt) {
		*out_evt = bufptr;
	}
	if (out_size) {
		*out_size = size;
	}

	return bufptr[HCI_EVT_STATUS_POS];
}

/**
 * @brief The GPIO self test handler is registered with the expected opcode and
 * an unchecked command length (variable-length pair list).
 */
ZTEST(atm_vendor_gpio, test_gpio_self_test_handler_registered)
{
	struct vendor_handler const *hdlr =
		test_find_handler(GPIO_SELF_TEST_CMD_OCF, GPIO_SELF_TEST_CMD_OGF);

	zassert_not_null(hdlr, "GPIO self test handler must be registered");
	zassert_equal(hdlr->ocf, GPIO_SELF_TEST_CMD_OCF, "OCF mismatch");
	zassert_equal(hdlr->ogf, GPIO_SELF_TEST_CMD_OGF, "OGF mismatch");
	zassert_false(hdlr->check_cmd_len, "GPIO self test must not validate cmd_len");
	zassert_equal(hdlr->cmd_len, GPIO_SELF_TEST_CMD_LEN, "GPIO self test cmd_len mismatch");
}

/**
 * @brief Zero pairs performs no GPIO access and must return HCI_EVT_SUCCESS.
 */
ZTEST(atm_vendor_gpio, test_gpio_self_test_zero_pairs_success)
{
	const uint8_t payload[] = {0};
	uint8_t status = drive_gpio_self_test(payload, NULL, NULL);

	zassert_equal(status, HCI_EVT_SUCCESS,
		      "zero-pair GPIO self test must return HCI_EVT_SUCCESS, got 0x%02x", status);
}

/**
 * @brief A pin pair that cannot map to any GPIO bank makes gpio_self_test()
 * fail, so the command must be rejected with HCI_EVT_ERROR.
 */
ZTEST(atm_vendor_gpio, test_gpio_self_test_invalid_pin_rejected)
{
	const uint8_t payload[] = {1, GPIO_INVALID_PIN, GPIO_INVALID_PIN};
	uint8_t status = drive_gpio_self_test(payload, NULL, NULL);

	zassert_equal(status, HCI_EVT_ERROR,
		      "invalid-pin GPIO self test must return HCI_EVT_ERROR, got 0x%02x", status);
}

/**
 * @brief A valid pin pair exercises the full configure/drive/read path. The
 * pass/fail outcome depends on external wiring, so only a well-formed event
 * carrying a defined status is asserted.
 */
ZTEST(atm_vendor_gpio, test_gpio_self_test_valid_pins_wellformed)
{
	const uint8_t payload[] = {1, 0, 1};
	uint8_t *evt = NULL;
	uint32_t size = 0;
	uint8_t status = drive_gpio_self_test(payload, &evt, &size);

	zassert_true(status == HCI_EVT_SUCCESS || status == HCI_EVT_ERROR,
		     "GPIO self test status must be SUCCESS or ERROR, got 0x%02x", status);
	zassert_equal(evt[4], GPIO_SELF_TEST_CMD_OCF, "OCF byte mismatch");
	zassert_equal(evt[5], GPIO_SELF_TEST_CMD_OGF, "OGF byte mismatch");
}

/**
 * @brief The emitted HCI event conforms to a Command Complete event carrying
 * the GPIO self test opcode.
 */
ZTEST(atm_vendor_gpio, test_gpio_self_test_hci_event_layout)
{
	const uint8_t payload[] = {0};
	uint8_t *evt = NULL;
	uint32_t size = 0;

	(void)drive_gpio_self_test(payload, &evt, &size);

	zassert_equal(evt[0], 0x04, "event should be H4 HCI EVT (0x04)");
	zassert_equal(evt[1], HCI_EVT_CMD_CPM, "event code should be CommandComplete");
	zassert_equal(evt[3], HCI_EVT_NOC, "num-of-cmd-packets byte mismatch");
	zassert_equal(evt[4], GPIO_SELF_TEST_CMD_OCF, "OCF byte mismatch");
	zassert_equal(evt[5], GPIO_SELF_TEST_CMD_OGF, "OGF byte mismatch");
}
```

## src/test_atm_vendor_psm.c
```c
/*
 * Copyright (c) 2026 Atmosic
 *
 * SPDX-License-Identifier: LicenseRef-Atmosic
 */

#include <stddef.h>
#include <stdint.h>

#include <zephyr/kernel.h>
#include <zephyr/ztest.h>
#include <zephyr/pm/policy.h>

#include "atm_vendor_internal.h"

extern struct vendor_handler const *test_find_handler(uint8_t ocf, uint8_t ogf);

/* Balance vendor_psm_config()'s policy-lock release in this minimal test. */
static void hold_psm_pm_lock(uint8_t mode)
{
#if defined(CONFIG_SOC_FAMILY_ATM) && defined(CONFIG_PM) && !defined(CONFIG_COVERAGE)
	switch (mode) {
	case PSM_DEEP:
		pm_policy_state_lock_get(PM_STATE_SUSPEND_TO_IDLE, PM_ALL_SUBSTATES);
		break;
	case PSM_RETAIN:
		pm_policy_state_lock_get(PM_STATE_SUSPEND_TO_RAM, PM_ALL_SUBSTATES);
		break;
	case PSM_HIBERNATE:
		pm_policy_state_lock_get(PM_STATE_SOFT_OFF, 0);
		break;
	case PSM_SOC_OFF:
		pm_policy_state_lock_get(PM_STATE_SOFT_OFF, 1);
		break;
	default:
		break;
	}
#else
	ARG_UNUSED(mode);
#endif
}

/* Drive one PSM command end-to-end:
 *   psm_handler(mode)  -> stores dat.psm_cmd.psm_mode
 *   psm_cmp_handler()  -> emits HCI event and calls vendor_psm_config()
 * Returns the HCI status byte from the emitted event.
 */
static uint8_t drive_psm(uint8_t mode, uint8_t **out_evt, uint32_t *out_size)
{
	struct vendor_handler const *hdlr = test_find_handler(PSM_CMD_OCF, PSM_CMD_OGF);

	zassert_not_null(hdlr, "PSM vendor handler not registered (CFG_VND_PSM off?)");
	zassert_not_null(hdlr->cmd_hdlr, "PSM cmd_hdlr is NULL");
	zassert_not_null(hdlr->cmd_cmp_hdlr, "PSM cmd_cmp_hdlr is NULL");
	zassert_equal(hdlr->cmd_len, PSM_CMD_LEN, "PSM cmd_len mismatch");

	uint8_t payload[PSM_CMD_LEN] = {mode};

	hdlr->cmd_hdlr(payload);

	uint8_t *bufptr = NULL;
	uint32_t size = 0;

	/* vendor_psm_config(), called from cmd_cmp_hdlr(), balances the lock acquired
	 * here (if any) for this mode with a pm_policy_state_lock_put().
	 */
	hold_psm_pm_lock(mode);
	hdlr->cmd_cmp_hdlr(&bufptr, &size);
	zassert_not_null(bufptr, "psm_cmp_handler returned NULL event buffer");
	zassert_true(size >= BASIC_HCI_EVT_CMD_LEN, "psm event size %u too small", size);

	if (out_evt) {
		*out_evt = bufptr;
	}
	if (out_size) {
		*out_size = size;
	}

	return bufptr[HCI_EVT_STATUS_POS];
}

/**
 * @brief PSM_NONE is accepted; vendor_psm_config() takes the NONE branch.
 */
ZTEST(atm_vendor_psm, test_psm_none)
{
	uint8_t *evt = NULL;
	uint32_t size = 0;
	uint8_t status = drive_psm(PSM_NONE, &evt, &size);

	zassert_equal(status, HCI_EVT_SUCCESS, "PSM_NONE must return HCI_EVT_SUCCESS, got 0x%02x",
		      status);
	zassert_equal(evt[4], PSM_CMD_OCF, "OCF byte mismatch");
	zassert_equal(evt[5], PSM_CMD_OGF, "OGF byte mismatch");
}

/**
 * @brief PSM_DEEP is accepted; vendor_psm_config() locks PM_STATE_SUSPEND_TO_IDLE.
 */
ZTEST(atm_vendor_psm, test_psm_deep)
{
	uint8_t status = drive_psm(PSM_DEEP, NULL, NULL);

	zassert_equal(status, HCI_EVT_SUCCESS, "PSM_DEEP must return HCI_EVT_SUCCESS, got 0x%02x",
		      status);
}

/**
 * @brief PSM_RETAIN is accepted; vendor_psm_config() targets PM_STATE_SUSPEND_TO_RAM.
 */
ZTEST(atm_vendor_psm, test_psm_retain)
{
	uint8_t status = drive_psm(PSM_RETAIN, NULL, NULL);

	zassert_equal(status, HCI_EVT_SUCCESS, "PSM_RETAIN must return HCI_EVT_SUCCESS, got 0x%02x",
		      status);
}

/**
 * @brief PSM_HIBERNATE is accepted; vendor_psm_config() targets PM_STATE_SOFT_OFF (substate 0).
 *
 * The actual pm_policy_state_lock_put() call is compiled out under
 * CONFIG_COVERAGE to keep the DUT recoverable during gcov runs, but the case
 * label itself is still executed here.
 */
ZTEST(atm_vendor_psm, test_psm_hibernate)
{
	uint8_t status = drive_psm(PSM_HIBERNATE, NULL, NULL);

	zassert_equal(status, HCI_EVT_SUCCESS,
		      "PSM_HIBERNATE must return HCI_EVT_SUCCESS, got 0x%02x", status);
}

/**
 * @brief PSM_SOC_OFF is accepted; vendor_psm_config() targets PM_STATE_SOFT_OFF (substate 1).
 */
ZTEST(atm_vendor_psm, test_psm_soc_off)
{
	uint8_t status = drive_psm(PSM_SOC_OFF, NULL, NULL);

	zassert_equal(status, HCI_EVT_SUCCESS,
		      "PSM_SOC_OFF must return HCI_EVT_SUCCESS, got 0x%02x", status);
}

/**
 * @brief Undefined PSM modes must fall through to the default branch and be
 * rejected with HCI_EVT_ERROR. vendor_psm_config() must not act on them.
 */
ZTEST(atm_vendor_psm, test_psm_invalid_mode_rejected)
{
	const uint8_t invalid_modes[] = {3, 6, 0x7F, 0xFF};

	for (size_t i = 0; i < ARRAY_SIZE(invalid_modes); i++) {
		uint8_t status = drive_psm(invalid_modes[i], NULL, NULL);

		zassert_equal(status, HCI_EVT_ERROR, "PSM mode 0x%02x must be rejected, got 0x%02x",
			      invalid_modes[i], status);
	}
}

/**
 * @brief Every valid PSM mode is accepted when driven in sequence, exercising
 * all case labels of vendor_psm_config() in one run.
 */
ZTEST(atm_vendor_psm, test_psm_all_valid_modes_sequence)
{
	const uint8_t valid[] = {PSM_NONE, PSM_DEEP, PSM_RETAIN, PSM_HIBERNATE, PSM_SOC_OFF};

	for (size_t i = 0; i < ARRAY_SIZE(valid); i++) {
		uint8_t status = drive_psm(valid[i], NULL, NULL);

		zassert_equal(status, HCI_EVT_SUCCESS,
			      "PSM mode 0x%02x expected SUCCESS, got 0x%02x", valid[i], status);
	}
}

/**
 * @brief The emitted HCI event conforms to a Command Complete event carrying
 * the PSM opcode and one status byte payload.
 */
ZTEST(atm_vendor_psm, test_psm_hci_event_layout)
{
	uint8_t *evt = NULL;
	uint32_t size = 0;

	(void)drive_psm(PSM_NONE, &evt, &size);

	zassert_equal(evt[0], 0x04, "event should be H4 HCI EVT (0x04)");
	zassert_equal(evt[1], HCI_EVT_CMD_CPM, "event code should be CommandComplete");
	zassert_equal(evt[3], HCI_EVT_NOC, "num-of-cmd-packets byte mismatch");
	zassert_equal(evt[4], PSM_CMD_OCF, "OCF byte mismatch");
	zassert_equal(evt[5], PSM_CMD_OGF, "OGF byte mismatch");
}
```
