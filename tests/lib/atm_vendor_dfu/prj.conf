## CMakeLists.txt
```
# Copyright (c) 2026 Atmosic
#
# SPDX-License-Identifier: LicenseRef-Atmosic

cmake_minimum_required(VERSION 3.20.0)

find_package(Zephyr REQUIRED HINTS $ENV{ZEPHYR_BASE})
project(atm_vendor_dfu_test)

target_sources(app PRIVATE src/main.c)
target_sources_ifdef(CONFIG_ZTEST app PRIVATE src/test_atm_vendor_dfu.c)
target_sources_ifndef(CONFIG_ZTEST app PRIVATE src/dfu_test_app.c)
```

## Kconfig
```
# Copyright (c) 2026 Atmosic
#
# SPDX-License-Identifier: LicenseRef-Atmosic

mainmenu "atm_vendor_dfu test"

config ATM_VENDOR_DFU_TEST_APP_VERSION
	string "Banner version printed by the test application"
	default "1.0.0"
	help
	  String embedded in the boot banner so the pytest harness can tell
	  v1 and v2 builds apart after an MCUboot swap. The pytest fixture
	  builds the v2 image with this option overridden to "2.0.0".

source "Kconfig.zephyr"
```

## prj.conf
```kconfig
# Copyright (c) 2026 Atmosic
#
# SPDX-License-Identifier: LicenseRef-Atmosic

CONFIG_ZTEST=y
CONFIG_ZTEST_STACK_SIZE=4096

CONFIG_FLASH=y
CONFIG_FLASH_MAP=y
CONFIG_STREAM_FLASH=y

CONFIG_BOOTLOADER_MCUBOOT=y
CONFIG_MCUBOOT_IMG_MANAGER=y
CONFIG_IMG_MANAGER=y

CONFIG_ATM_VENDOR_DFU=y
CONFIG_ATM_VENDOR_DFU_LOG_LEVEL_DBG=y

CONFIG_LOG=y
```

## app_pytest.overlay
```dts
/*
 * Copyright (c) 2026 Atmosic
 *
 * SPDX-License-Identifier: LicenseRef-Atmosic
 */

/* Enable uart0 (J-Link interface if00 on ATM34 EVK) as the DFU transport
 * for the pytest end-to-end swap test. The board DT already lists uart0 as
 * zephyr,uart-mcumgr; this overlay just brings it up.
 */

&uart0 {
	status = "okay";
	current-speed = <115200>;
};
```

## src/main.c
```c
/*
 * Copyright (c) 2026 Atmosic
 *
 * SPDX-License-Identifier: LicenseRef-Atmosic
 */

#include <zephyr/kernel.h>

#ifdef CONFIG_ZTEST
#include <zephyr/ztest.h>

#include "atm_vendor_dfu.h"

static void *atm_vendor_dfu_setup(void)
{
	int ret = atm_vendor_dfu_init();

	zassert_ok(ret, "atm_vendor_dfu_init failed: %d", ret);
	return NULL;
}

static void atm_vendor_dfu_before(void *fixture)
{
	ARG_UNUSED(fixture);
	atm_vendor_dfu_reset();
}

ZTEST_SUITE(atm_vendor_dfu, NULL, atm_vendor_dfu_setup, atm_vendor_dfu_before, NULL, NULL);
#else  /* !CONFIG_ZTEST */

void dfu_test_app_run(void);

int main(void)
{
	dfu_test_app_run();
	return 0;
}
#endif /* CONFIG_ZTEST */
```

## src/dfu_test_app.c
```c
/*
 * Copyright (c) 2026 Atmosic
 *
 * SPDX-License-Identifier: LicenseRef-Atmosic
 */

/*
 * Pytest-mode entry point for the atm_vendor_dfu test image.
 *
 * Console (uart1) prints a banner including TEST_APP_VERSION at boot so the
 * pytest harness can detect post-swap reboots. A simple framed protocol on
 * the chosen zephyr,uart-mcumgr UART (uart0 on ATM34 EVK) drives the DFU
 * APIs end-to-end: feed image bytes via atm_vendor_dfu_write(), then trigger
 * atm_vendor_dfu_request_upgrade() and reboot.
 *
 * Frame layout (little-endian):
 *   host -> dev:  [magic 0xA1B2C3D4] [cmd:1] [len:4] [payload:len]
 *   dev  -> host: [magic 0xD4C3B2A1] [status:1] [len:4] [payload:len]
 *
 * Commands:
 *   0x01 PING  - no payload; OK with banner string
 *   0x02 RESET - calls atm_vendor_dfu_reset()
 *   0x03 WRITE - payload is image bytes; calls atm_vendor_dfu_write()
 *   0x04 GO    - calls atm_vendor_dfu_request_upgrade() then sys_reboot()
 */

#include <errno.h>
#include <string.h>

#include <zephyr/devicetree.h>
#include <zephyr/drivers/uart.h>
#include <zephyr/kernel.h>
#include <zephyr/sys/printk.h>
#include <zephyr/sys/reboot.h>

#include "atm_vendor_dfu.h"

#define DFU_MAGIC_REQ  0xA1B2C3D4U
#define DFU_MAGIC_RESP 0xD4C3B2A1U

#define DFU_CMD_PING  0x01U
#define DFU_CMD_RESET 0x02U
#define DFU_CMD_WRITE 0x03U
#define DFU_CMD_GO    0x04U

#define DFU_HDR_LEN   9U
#define DFU_MAX_CHUNK 1024U

static const struct device *const dfu_uart = DEVICE_DT_GET(DT_CHOSEN(zephyr_uart_mcumgr));

static uint8_t rx_buf[DFU_MAX_CHUNK];

static void uart_write_bytes(const uint8_t *buf, size_t len)
{
	for (size_t i = 0; i < len; i++) {
		uart_poll_out(dfu_uart, buf[i]);
	}
}

static int uart_read_bytes(uint8_t *buf, size_t len)
{
	size_t got = 0;

	while (got < len) {
		uint8_t b;
		int rc = uart_poll_in(dfu_uart, &b);

		if (!rc) {
			buf[got++] = b;
			continue;
		}
		if (rc != -1) {
			return rc;
		}
		k_msleep(1);
	}
	return 0;
}

static void send_resp(uint8_t status, const uint8_t *payload, uint32_t len)
{
	uint8_t hdr[DFU_HDR_LEN];
	uint32_t magic = DFU_MAGIC_RESP;

	memcpy(hdr, &magic, sizeof(magic));
	hdr[4] = status;
	memcpy(hdr + 5, &len, sizeof(len));
	uart_write_bytes(hdr, sizeof(hdr));
	if (len) {
		uart_write_bytes(payload, len);
	}
}

static int read_request(uint8_t *cmd, uint32_t *len)
{
	uint8_t hdr[DFU_HDR_LEN];
	uint32_t magic;

	int rc = uart_read_bytes(hdr, sizeof(hdr));

	if (rc) {
		return rc;
	}
	memcpy(&magic, hdr, sizeof(magic));
	if (magic != DFU_MAGIC_REQ) {
		printk("DFU: bad magic %#x\n", magic);
		return -EINVAL;
	}
	*cmd = hdr[4];
	memcpy(len, hdr + 5, sizeof(*len));
	if (*len > sizeof(rx_buf)) {
		printk("DFU: oversize len %u\n", *len);
		return -EMSGSIZE;
	}
	if (*len) {
		rc = uart_read_bytes(rx_buf, *len);
	}
	return rc;
}

static void handle_request(uint8_t cmd, uint32_t len)
{
	int rc;

	switch (cmd) {
	case DFU_CMD_PING: {
		const char *banner = "VENDOR_DFU IMG_VER=" CONFIG_ATM_VENDOR_DFU_TEST_APP_VERSION;

		send_resp(0, (const uint8_t *)banner, (uint32_t)strlen(banner));
		break;
	}
	case DFU_CMD_RESET:
		atm_vendor_dfu_reset();
		send_resp(0, NULL, 0);
		break;
	case DFU_CMD_WRITE:
		rc = atm_vendor_dfu_write(rx_buf, len);
		send_resp((uint8_t)(rc ? -rc : 0), NULL, 0);
		break;
	case DFU_CMD_GO:
		rc = atm_vendor_dfu_request_upgrade();
		printk("REQUEST_UPGRADE rc=%d\n", rc);
		send_resp((uint8_t)(rc ? -rc : 0), NULL, 0);
		k_msleep(50);
		sys_reboot(SYS_REBOOT_COLD);
		break;
	default:
		send_resp((uint8_t)EINVAL, NULL, 0);
		break;
	}
}

void dfu_test_app_run(void)
{
	printk("ATM_VENDOR_DFU_TEST IMG_VER=" CONFIG_ATM_VENDOR_DFU_TEST_APP_VERSION "\n");

	if (!device_is_ready(dfu_uart)) {
		printk("DFU UART not ready\n");
		return;
	}

	int rc = atm_vendor_dfu_init();

	printk("atm_vendor_dfu_init rc=%d\n", rc);
	atm_vendor_dfu_reset();
	printk("DFU_READY\n");

	while (true) {
		uint8_t cmd = 0;
		uint32_t len = 0;

		if (read_request(&cmd, &len)) {
			k_msleep(10);
			continue;
		}
		handle_request(cmd, len);
	}
}
```

## src/test_atm_vendor_dfu.c
```c
/*
 * Copyright (c) 2026 Atmosic
 *
 * SPDX-License-Identifier: LicenseRef-Atmosic
 */

#include <errno.h>
#include <string.h>

#include <zephyr/devicetree.h>
#include <zephyr/kernel.h>
#include <zephyr/storage/flash_map.h>
#include <zephyr/ztest.h>

#include "atm_vendor_dfu.h"

#define HAS_SLOT3_PARTITION FIXED_PARTITION_EXISTS(slot3_partition)

/* Per-image payload size used by dual-image tests. Kept small so the test
 * stays fast and well below the smallest sector size of either slot.
 */
#define TEST_IMG0_SIZE 64U
#define TEST_IMG1_SIZE 64U

/**
 * @brief Idempotent init: a second call must succeed without side effects.
 */
ZTEST(atm_vendor_dfu, test_init_idempotent)
{
	zassert_ok(atm_vendor_dfu_init(), "second init should succeed");
}

/**
 * @brief Stream offset is zero immediately after reset.
 */
ZTEST(atm_vendor_dfu, test_reset_clears_offset)
{
	zassert_equal(atm_vendor_dfu_stream_offset(), 0, "offset should be 0 right after reset");
}

/**
 * @brief Zero-length write is a no-op and must not advance the stream.
 */
ZTEST(atm_vendor_dfu, test_write_zero_len)
{
	uint8_t dummy = 0xAA;

	zassert_ok(atm_vendor_dfu_write(&dummy, 0), "zero-length write should succeed");
	zassert_equal(atm_vendor_dfu_stream_offset(), 0, "offset must stay 0");
}

/**
 * @brief NULL data pointer with a non-zero length is rejected.
 */
ZTEST(atm_vendor_dfu, test_write_null_data)
{
	int ret = atm_vendor_dfu_write(NULL, 1);

	zassert_equal(ret, -EINVAL, "expected -EINVAL, got %d", ret);
	zassert_equal(atm_vendor_dfu_stream_offset(), 0, "offset must stay 0");
}

/**
 * @brief request_upgrade() marks every secondary slot as pending. The
 * staged data is not a valid signed image so MCUboot will revert on the
 * next boot, which is harmless for the test run.
 */
ZTEST(atm_vendor_dfu, test_request_upgrade)
{
	zassert_ok(atm_vendor_dfu_request_upgrade(), "request_upgrade should succeed");
}

#if HAS_SLOT3_PARTITION

/* Build a valid 32-byte ATMX header with the supplied payload sizes. */
static void build_header(uint8_t *buf, uint32_t img0_size, uint32_t img1_size)
{
	struct atm_vendor_dfu_header *hdr = (struct atm_vendor_dfu_header *)buf;

	memset(buf, 0, ATM_VENDOR_DFU_HDR_SIZE);
	hdr->magic = ATM_VENDOR_DFU_MAGIC;
	hdr->version = 1;
	hdr->img0_size = img0_size;
	hdr->img1_size = img1_size;
}

/**
 * @brief Header with the wrong magic value must be rejected.
 */
ZTEST(atm_vendor_dfu, test_dual_bad_magic)
{
	uint8_t hdr[ATM_VENDOR_DFU_HDR_SIZE];

	build_header(hdr, TEST_IMG0_SIZE, TEST_IMG1_SIZE);
	((struct atm_vendor_dfu_header *)hdr)->magic = 0xDEADBEEF;

	int ret = atm_vendor_dfu_write(hdr, sizeof(hdr));

	zassert_equal(ret, -EINVAL, "expected -EINVAL, got %d", ret);
}

/**
 * @brief Header with a zero-sized image must be rejected.
 */
ZTEST(atm_vendor_dfu, test_dual_zero_image_size)
{
	uint8_t hdr[ATM_VENDOR_DFU_HDR_SIZE];

	build_header(hdr, 0, TEST_IMG1_SIZE);
	zassert_equal(atm_vendor_dfu_write(hdr, sizeof(hdr)), -EINVAL, "img0_size = 0 should fail");

	atm_vendor_dfu_reset();
	build_header(hdr, TEST_IMG0_SIZE, 0);
	zassert_equal(atm_vendor_dfu_write(hdr, sizeof(hdr)), -EINVAL, "img1_size = 0 should fail");
}

/**
 * @brief Header may be delivered split across multiple write() calls.
 */
ZTEST(atm_vendor_dfu, test_dual_chunked_header)
{
	uint8_t hdr[ATM_VENDOR_DFU_HDR_SIZE];

	build_header(hdr, TEST_IMG0_SIZE, TEST_IMG1_SIZE);

	/* Feed the header in 4-byte chunks. The helper must accumulate it
	 * before transitioning to the IMG0 state.
	 */
	for (size_t i = 0; i < sizeof(hdr); i += 4) {
		zassert_ok(atm_vendor_dfu_write(&hdr[i], 4), "chunk %zu failed", i);
	}

	zassert_equal(atm_vendor_dfu_stream_offset(), ATM_VENDOR_DFU_HDR_SIZE,
		      "offset after header should equal header size");
}

/**
 * @brief End-to-end stream: header + img0 + img1 in one shot. Verifies
 * stream_offset advances by the full payload and that data lands in the
 * expected secondary slots.
 */
ZTEST(atm_vendor_dfu, test_dual_full_flow)
{
	uint8_t buf[ATM_VENDOR_DFU_HDR_SIZE + TEST_IMG0_SIZE + TEST_IMG1_SIZE];
	uint8_t *img0 = buf + ATM_VENDOR_DFU_HDR_SIZE;
	uint8_t *img1 = img0 + TEST_IMG0_SIZE;

	build_header(buf, TEST_IMG0_SIZE, TEST_IMG1_SIZE);
	for (size_t i = 0; i < TEST_IMG0_SIZE; i++) {
		img0[i] = (uint8_t)(0xA0 + (i & 0x0F));
	}
	for (size_t i = 0; i < TEST_IMG1_SIZE; i++) {
		img1[i] = (uint8_t)(0xB0 + (i & 0x0F));
	}

	zassert_ok(atm_vendor_dfu_write(buf, sizeof(buf)), "full-flow write failed");
	zassert_equal(atm_vendor_dfu_stream_offset(), sizeof(buf),
		      "offset should equal total bytes streamed");
}

/**
 * @brief Deliver the payload in 8-byte chunks so per-image writes land at
 * non-sector-aligned offsets after the first chunk, exercising the
 * flatten-skip path inside the dual-image state machine.
 */
ZTEST(atm_vendor_dfu, test_dual_chunked_payload)
{
	uint8_t hdr[ATM_VENDOR_DFU_HDR_SIZE];
	uint8_t chunk[8];

	build_header(hdr, TEST_IMG0_SIZE, TEST_IMG1_SIZE);
	zassert_ok(atm_vendor_dfu_write(hdr, sizeof(hdr)), "header write failed");

	memset(chunk, 0xC1, sizeof(chunk));
	for (size_t i = 0; i < TEST_IMG0_SIZE + TEST_IMG1_SIZE; i += sizeof(chunk)) {
		zassert_ok(atm_vendor_dfu_write(chunk, sizeof(chunk)),
			   "payload chunk at %zu failed", i);
	}

	zassert_equal(atm_vendor_dfu_stream_offset(),
		      ATM_VENDOR_DFU_HDR_SIZE + TEST_IMG0_SIZE + TEST_IMG1_SIZE,
		      "offset should equal total bytes streamed");
}

#else /* !HAS_SLOT3_PARTITION */

/**
 * @brief Single-image streaming: bytes are forwarded straight to slot1.
 */
ZTEST(atm_vendor_dfu, test_single_simple_write)
{
	uint8_t buf[64];

	for (size_t i = 0; i < sizeof(buf); i++) {
		buf[i] = (uint8_t)(i ^ 0x5A);
	}

	zassert_ok(atm_vendor_dfu_write(buf, sizeof(buf)), "single write failed");
	zassert_equal(atm_vendor_dfu_stream_offset(), sizeof(buf),
		      "offset should match bytes written");
}

/**
 * @brief Two consecutive writes leave the second call starting at a non-
 * sector-aligned slot offset, exercising the flatten-skip path.
 */
ZTEST(atm_vendor_dfu, test_single_two_writes)
{
	uint8_t buf[32];

	for (size_t i = 0; i < sizeof(buf); i++) {
		buf[i] = (uint8_t)(i + 0x10);
	}

	zassert_ok(atm_vendor_dfu_write(buf, sizeof(buf)), "first write failed");
	zassert_ok(atm_vendor_dfu_write(buf, sizeof(buf)), "second write failed");
	zassert_equal(atm_vendor_dfu_stream_offset(), 2U * sizeof(buf),
		      "offset should accumulate across writes");
}

#endif /* HAS_SLOT3_PARTITION */
```
