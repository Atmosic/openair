## CMakeLists.txt
```
# Copyright (c) 2025-2026 Atmosic
#
# SPDX-License-Identifier: LicenseRef-Atmosic

cmake_minimum_required(VERSION 3.20.0)

# common overlay file
set(DTC_OVERLAY_FILE boards/common.overlay)

find_package(Zephyr REQUIRED HINTS $ENV{ZEPHYR_BASE})
project(dtm_2wire_test)

target_sources(app PRIVATE
  src/main.c
  src/test_dtm_hci_bridge.c
  src/test_dtm_message_processing.c
  src/test_dtm_state_machine.c
  src/test_dtm_simulated_rx.c
)
```

## prj.conf
```kconfig
# Copyright (c) 2026 Atmosic
#
# SPDX-License-Identifier: LicenseRef-Atmosic

CONFIG_ZTEST=y
CONFIG_BT=y
CONFIG_BT_HCI=y
CONFIG_DTM_2WIRE=y
CONFIG_UART_INTERRUPT_DRIVEN=y
CONFIG_SERIAL=y
CONFIG_LOG=y
CONFIG_DTM_2WIRE_LOG_LEVEL_DBG=y

# Increase stack size for complex DTM tests
CONFIG_ZTEST_STACK_SIZE=4096
CONFIG_ZTEST_NO_YIELD=n
```

## boards/common.overlay
```dts
/*
 * Copyright (c) 2025-2026 Atmosic
 *
 * SPDX-License-Identifier: LicenseRef-Atmosic
 */

/ {
	chosen {
		zephyr,dtm-2wire-uart = &uart0;
	};
};

&uart0 {
	status = "okay";
	current-speed = <115200>;
	/delete-property/ hw-flow-control;
};

&uart1 {
	status = "okay";
	current-speed = <115200>;
	/delete-property/ hw-flow-control;
};
```

## src/main.c
```c
/*
 * Copyright (c) 2025-2026 Atmosic
 *
 * SPDX-License-Identifier: LicenseRef-Atmosic
 */

#include <zephyr/kernel.h>
#include <zephyr/ztest.h>
#include <zephyr/device.h>
#include <zephyr/drivers/uart.h>
#include <zephyr/bluetooth/bluetooth.h>
#include <zephyr/bluetooth/hci.h>

#include "dtm_mgr.h"
#include "dtm_hci_bridge.h"
#include "ble_dtm.h"

#define TIMEOUT 2000

/* Device references */
#if DT_NODE_EXISTS(DT_CHOSEN(zephyr_dtm_2wire_uart))
static const struct device *uart_dev = DEVICE_DT_GET(DT_CHOSEN(zephyr_dtm_2wire_uart));
#else
static const struct device *uart_dev = NULL;
#endif

/* Test fixture setup and teardown */
static void *dtm_2wire_setup(void)
{
	/* Initialize Bluetooth stack for HCI operations */
	int err = bt_enable(NULL);
	if (err) {
		TC_PRINT("Bluetooth init failed (err %d)\n", err);
	}

	return NULL;
}

static void dtm_2wire_before(void *fixture)
{
	ARG_UNUSED(fixture);
	/* Clean state before each test */
}

static void dtm_2wire_after(void *fixture)
{
	ARG_UNUSED(fixture);
	/* Clean up after each test */
}

static void dtm_2wire_teardown(void *fixture)
{
	ARG_UNUSED(fixture);
	/* Final cleanup */
}

/* Helper functions for tests */
const struct device *test_get_uart_device(void)
{
	return uart_dev;
}

bool test_uart_available(void)
{
	return uart_dev && device_is_ready(uart_dev);
}

ZTEST_SUITE(dtm_hci_bridge, NULL, dtm_2wire_setup, dtm_2wire_before, dtm_2wire_after,
	    dtm_2wire_teardown);

ZTEST_SUITE(dtm_message_processing, NULL, dtm_2wire_setup, dtm_2wire_before, dtm_2wire_after,
	    dtm_2wire_teardown);

ZTEST_SUITE(dtm_state_machine, NULL, dtm_2wire_setup, dtm_2wire_before, dtm_2wire_after,
	    dtm_2wire_teardown);

#ifdef CONFIG_DTM_2WIRE_RX_TESTING_SIMULATED
ZTEST_SUITE(dtm_simulated_rx, NULL, dtm_2wire_setup, dtm_2wire_before, dtm_2wire_after,
	    dtm_2wire_teardown);
#endif
```

## src/test_dtm_hci_bridge.c
```c
/*
 * Copyright (c) 2025-2026 Atmosic
 *
 * SPDX-License-Identifier: LicenseRef-Atmosic
 */

#include <zephyr/kernel.h>
#include <zephyr/ztest.h>
#include <zephyr/bluetooth/hci.h>

#include "dtm_hci_bridge.h"

/* External references from main.c */
extern const struct device *test_get_uart_device(void);
extern bool test_uart_available(void);

/* Test callback tracking */
static volatile bool callback_called = false;
static volatile uint16_t last_opcode = 0;
static volatile uint8_t last_status = 0;

/* Test callback function */
static bool test_cmd_complete_cb(uint16_t opcode, const void *param_buf, uint8_t len)
{
	callback_called = true;
	last_opcode = opcode;

	if (len && param_buf) {
		last_status = *((uint8_t *)param_buf);
	}

	TC_PRINT("HCI Command Complete: opcode=0x%04x, status=0x%02x, len=%d\n", opcode,
		 last_status, len);

	return true; /* Handled */
}

/* Reset test state */
static void reset_test_state(void)
{
	callback_called = false;
	last_opcode = 0;
	last_status = 0;
}

/**
 * @brief Test callback registration
 */
ZTEST(dtm_hci_bridge, test_callback_registration)
{
	/* Test setting callback */
	dtm_hci_bridge_set_cmd_complete_cb(test_cmd_complete_cb);

	/* Test setting NULL callback */
	dtm_hci_bridge_set_cmd_complete_cb(NULL);

	/* Restore test callback */
	dtm_hci_bridge_set_cmd_complete_cb(test_cmd_complete_cb);
}

/**
 * @brief Test HCI Reset command
 */
ZTEST(dtm_hci_bridge, test_hci_reset_command)
{
	reset_test_state();
	dtm_hci_bridge_set_cmd_complete_cb(test_cmd_complete_cb);

	uint8_t ret = dtm_hci_bridge_send_cmd(BT_HCI_OP_RESET, NULL, 0);
	zassert_equal(ret, BT_HCI_ERR_SUCCESS, "HCI Reset should succeed, got ret=0x%02x", ret);

	/* Give some time for callback */
	k_msleep(100);

	zassert_true(callback_called, "Command complete callback should be called");
	zassert_equal(last_opcode, BT_HCI_OP_RESET, "Callback should receive correct opcode");
	zassert_equal(last_status, BT_HCI_ERR_SUCCESS, "Reset should return success status");
}

/**
 * @brief Test LE Read Max Data Length command
 */
ZTEST(dtm_hci_bridge, test_le_read_max_data_len)
{
	reset_test_state();
	dtm_hci_bridge_set_cmd_complete_cb(test_cmd_complete_cb);

	uint8_t ret = dtm_hci_bridge_send_cmd(BT_HCI_OP_LE_READ_MAX_DATA_LEN, NULL, 0);
	zassert_equal(ret, BT_HCI_ERR_SUCCESS,
		      "LE Read Max Data Len should succeed, got ret=0x%02x", ret);

	/* Give some time for callback */
	k_msleep(100);

	zassert_true(callback_called, "Command complete callback should be called");
	zassert_equal(last_opcode, BT_HCI_OP_LE_READ_MAX_DATA_LEN,
		      "Callback should receive correct opcode");
}

/**
 * @brief Test LE Enhanced TX Test command
 */
ZTEST(dtm_hci_bridge, test_le_enh_tx_test)
{
	struct bt_hci_cp_le_enh_tx_test tx_params = {.tx_ch = 0x13, /* Channel 19 (2440 MHz) */
						     .test_data_len = 0x25, /* 37 bytes */
						     .pkt_payload = BT_HCI_TEST_PKT_PAYLOAD_PRBS9,
						     .phy = BT_HCI_LE_TX_PHY_1M};

	reset_test_state();
	dtm_hci_bridge_set_cmd_complete_cb(test_cmd_complete_cb);

	/* First ensure any previous test is ended */
	dtm_hci_bridge_send_cmd(BT_HCI_OP_LE_TEST_END, NULL, 0);
	k_msleep(50);

	uint8_t ret = dtm_hci_bridge_send_cmd(BT_HCI_OP_LE_ENH_TX_TEST, (uint8_t *)&tx_params,
					      sizeof(tx_params));
	zassert_equal(ret, BT_HCI_ERR_SUCCESS, "LE Enhanced TX Test should succeed, got ret=0x%02x",
		      ret);

	/* Give some time for callback */
	k_msleep(100);

	zassert_true(callback_called, "Command complete callback should be called");
	zassert_equal(last_opcode, BT_HCI_OP_LE_ENH_TX_TEST,
		      "Callback should receive correct opcode");

	/* Clean up - end the test */
	dtm_hci_bridge_send_cmd(BT_HCI_OP_LE_TEST_END, NULL, 0);
	k_msleep(50);
}

/**
 * @brief Test LE Enhanced RX Test command
 */
ZTEST(dtm_hci_bridge, test_le_enh_rx_test)
{
	struct bt_hci_cp_le_enh_rx_test rx_params = {.rx_ch = 0x13, /* Channel 19 (2440 MHz) */
						     .phy = BT_HCI_LE_RX_PHY_1M,
						     .mod_index = BT_HCI_LE_MOD_INDEX_STANDARD};

	reset_test_state();
	dtm_hci_bridge_set_cmd_complete_cb(test_cmd_complete_cb);

	uint8_t ret = dtm_hci_bridge_send_cmd(BT_HCI_OP_LE_ENH_RX_TEST, (uint8_t *)&rx_params,
					      sizeof(rx_params));
	zassert_equal(ret, BT_HCI_ERR_SUCCESS, "LE Enhanced RX Test should succeed, got ret=0x%02x",
		      ret);

	/* Give some time for callback */
	k_msleep(100);

	zassert_true(callback_called, "Command complete callback should be called");
	zassert_equal(last_opcode, BT_HCI_OP_LE_ENH_RX_TEST,
		      "Callback should receive correct opcode");
}

/**
 * @brief Test LE Test End command
 */
ZTEST(dtm_hci_bridge, test_le_test_end)
{
	reset_test_state();
	dtm_hci_bridge_set_cmd_complete_cb(test_cmd_complete_cb);

	/* Start a test first, then end it */
	struct bt_hci_cp_le_enh_rx_test rx_params = {.rx_ch = 0x13,
						     .phy = BT_HCI_LE_RX_PHY_1M,
						     .mod_index = BT_HCI_LE_MOD_INDEX_STANDARD};

	uint8_t ret_start = dtm_hci_bridge_send_cmd(BT_HCI_OP_LE_ENH_RX_TEST, (uint8_t *)&rx_params,
						    sizeof(rx_params));
	zassert_equal(ret_start, BT_HCI_ERR_SUCCESS, "RX test start should succeed");
	k_msleep(50);

	/* Now test the Test End command */
	uint8_t ret = dtm_hci_bridge_send_cmd(BT_HCI_OP_LE_TEST_END, NULL, 0);
	zassert_equal(ret, BT_HCI_ERR_SUCCESS, "LE Test End should succeed, got ret=0x%02x", ret);

	/* Give some time for callback */
	k_msleep(100);

	zassert_true(callback_called, "Command complete callback should be called");
	zassert_equal(last_opcode, BT_HCI_OP_LE_TEST_END, "Callback should receive correct opcode");
}

/**
 * @brief Test multiple consecutive commands
 */
ZTEST(dtm_hci_bridge, test_multiple_commands)
{
	reset_test_state();
	dtm_hci_bridge_set_cmd_complete_cb(test_cmd_complete_cb);

	/* Send multiple commands in sequence */
	uint8_t ret1 = dtm_hci_bridge_send_cmd(BT_HCI_OP_RESET, NULL, 0);
	zassert_equal(ret1, BT_HCI_ERR_SUCCESS, "First command should succeed");

	k_msleep(50);

	uint8_t ret2 = dtm_hci_bridge_send_cmd(BT_HCI_OP_LE_READ_MAX_DATA_LEN, NULL, 0);
	zassert_equal(ret2, BT_HCI_ERR_SUCCESS, "Second command should succeed");

	k_msleep(50);

	/* Start a test first, then end it (Test End without active test may fail) */
	struct bt_hci_cp_le_enh_rx_test rx_params = {.rx_ch = 0x13,
						     .phy = BT_HCI_LE_RX_PHY_1M,
						     .mod_index = BT_HCI_LE_MOD_INDEX_STANDARD};

	uint8_t ret_start = dtm_hci_bridge_send_cmd(BT_HCI_OP_LE_ENH_RX_TEST, (uint8_t *)&rx_params,
						    sizeof(rx_params));
	zassert_equal(ret_start, BT_HCI_ERR_SUCCESS, "RX test start should succeed");

	k_msleep(50);

	uint8_t ret3 = dtm_hci_bridge_send_cmd(BT_HCI_OP_LE_TEST_END, NULL, 0);
	zassert_equal(ret3, BT_HCI_ERR_SUCCESS, "Third command should succeed");
}
```

## src/test_dtm_message_processing.c
```c
/*
 * Copyright (c) 2025-2026 Atmosic
 *
 * SPDX-License-Identifier: LicenseRef-Atmosic
 */

#include <zephyr/kernel.h>
#include <zephyr/ztest.h>

#include "ble_dtm.h"

/* Test state tracking - no mock needed, just test the macros */
static volatile uint16_t test_message = 0;

/* Helper macros for testing - define locally to avoid modifying the module */
/* For TX/RX tests: CTRL field contains frequency (6 bits), PARAM field contains length+packet type
 */
#define TEST_DTM_TXRX_SET_FREQ(freq) ((uint8_t)(freq)) /* Frequency goes directly in CTRL field */
#define TEST_DTM_TXRX_SET_LEN_PKT(len, pkt)                                                        \
	((uint8_t)((((len) << DTM_TXRX_TEST_LEN_SHIFT) & DTM_TXRX_TEST_LEN_MASK) |                 \
		   (((pkt) << DTM_TXRX_TEST_PKT_SHIFT) & DTM_TXRX_TEST_PKT_MASK)))
#define TEST_DTM_PARAM_SET_PHY_MODE(phy)                                                           \
	((uint8_t)(((phy) << DTM_PARAM_FIELD_SHIFT) & DTM_PARAM_FIELD_MASK))
#define TEST_DTM_PARAM_SET_LEN_EXT(ext)                                                            \
	((uint8_t)(((ext) << DTM_PARAM_FIELD_SHIFT) & DTM_PARAM_FIELD_MASK))
#define TEST_DTM_ASSEMBLE_PKT_REPORT_RESPONSE(count) DTM_ASSEMBLE_PKT_REPORT(count)

/* Helper to create DTM messages */
static uint16_t create_dtm_message(uint8_t cmd, uint8_t ctrl, uint8_t param)
{
	return (cmd << DTM_CMD_SHIFT) | (ctrl << DTM_CTRL_SHIFT) | (param << DTM_PARAM_SHIFT);
}

/**
 * @brief Test DTM message parsing macros
 */
ZTEST(dtm_message_processing, test_message_parsing)
{
	uint16_t test_msg = create_dtm_message(DTM_CMD_TEST_SETUP, DTM_CTRL_RESET, 0x55);

	zassert_equal(DTM_GET_CMD(test_msg), DTM_CMD_TEST_SETUP, "Command extraction should work");
	zassert_equal(DTM_GET_CTRL(test_msg), DTM_CTRL_RESET, "Control extraction should work");
	zassert_equal(DTM_GET_PARAM(test_msg), 0x55, "Parameter extraction should work");
}

/**
 * @brief Test Test Setup Reset command
 */
ZTEST(dtm_message_processing, test_setup_reset)
{
	uint16_t reset_msg = create_dtm_message(DTM_CMD_TEST_SETUP, DTM_CTRL_RESET, 0x00);

	/* Test the message creation and parsing */
	zassert_equal(DTM_GET_CMD(reset_msg), DTM_CMD_TEST_SETUP, "Should be test setup command");
	zassert_equal(DTM_GET_CTRL(reset_msg), DTM_CTRL_RESET, "Should be reset control");
}

/**
 * @brief Test Test Setup PHY mode setting
 */
ZTEST(dtm_message_processing, test_setup_phy_mode)
{

	/* Test setting 1M PHY */
	uint16_t phy_1m_msg = create_dtm_message(DTM_CMD_TEST_SETUP, DTM_CTRL_SET_PHY_MODE,
						 DTM_PARAM_PHY_MODE_LE_1M);

	zassert_equal(DTM_GET_CMD(phy_1m_msg), DTM_CMD_TEST_SETUP, "Should be test setup command");
	zassert_equal(DTM_GET_CTRL(phy_1m_msg), DTM_CTRL_SET_PHY_MODE,
		      "Should be PHY mode control");
	zassert_equal(DTM_GET_PARAM(phy_1m_msg), DTM_PARAM_PHY_MODE_LE_1M, "Should be 1M PHY");

	/* Test setting 2M PHY */
	uint16_t phy_2m_msg = create_dtm_message(DTM_CMD_TEST_SETUP, DTM_CTRL_SET_PHY_MODE,
						 DTM_PARAM_PHY_MODE_LE_2M);

	zassert_equal(DTM_GET_PARAM(phy_2m_msg), DTM_PARAM_PHY_MODE_LE_2M, "Should be 2M PHY");

	/* Test setting Coded PHY S8 */
	uint16_t phy_s8_msg = create_dtm_message(DTM_CMD_TEST_SETUP, DTM_CTRL_SET_PHY_MODE,
						 DTM_PARAM_PHY_MODE_LE_S8);

	zassert_equal(DTM_GET_PARAM(phy_s8_msg), DTM_PARAM_PHY_MODE_LE_S8, "Should be S8 PHY");
}

/**
 * @brief Test TX Test command creation
 */
ZTEST(dtm_message_processing, test_tx_test_command)
{

	/* Create TX test message: channel 19, length 37, PRBS9 payload */
	uint8_t channel = 19;
	uint8_t length = 37;
	uint8_t packet_type = DTM_PKT_TYPE_PRBS9;

	uint16_t tx_msg = create_dtm_message(DTM_CMD_TX_TEST, TEST_DTM_TXRX_SET_FREQ(channel),
					     TEST_DTM_TXRX_SET_LEN_PKT(length, packet_type));

	zassert_equal(DTM_GET_CMD(tx_msg), DTM_CMD_TX_TEST, "Should be TX test command");
	zassert_equal(DTM_GET_TXRX_FREQ(tx_msg), channel, "Should extract correct channel");
	zassert_equal(DTM_GET_TXRX_LEN(tx_msg), length, "Should extract correct length");
	zassert_equal(DTM_GET_TXRX_PKT(tx_msg), packet_type, "Should extract correct packet type");
}

/**
 * @brief Test RX Test command creation
 */
ZTEST(dtm_message_processing, test_rx_test_command)
{

	/* Create RX test message: channel 19 */
	uint8_t channel = 19;

	uint16_t rx_msg =
		create_dtm_message(DTM_CMD_RX_TEST, TEST_DTM_TXRX_SET_FREQ(channel), 0x00);

	zassert_equal(DTM_GET_CMD(rx_msg), DTM_CMD_RX_TEST, "Should be RX test command");
	zassert_equal(DTM_GET_TXRX_FREQ(rx_msg), channel, "Should extract correct channel");
}

/**
 * @brief Test Test End command
 */
ZTEST(dtm_message_processing, test_end_command)
{

	uint16_t end_msg =
		create_dtm_message(DTM_CMD_TEST_END, DTM_END_CTRL_END, DTM_END_PARAM_END);

	zassert_equal(DTM_GET_CMD(end_msg), DTM_CMD_TEST_END, "Should be test end command");
	zassert_equal(DTM_GET_CTRL(end_msg), DTM_END_CTRL_END, "Should be end control");
	zassert_equal(DTM_GET_PARAM(end_msg), DTM_END_PARAM_END, "Should be end parameter");
}

/**
 * @brief Test status response assembly
 */
ZTEST(dtm_message_processing, test_status_response)
{

	/* Test success response - DTM_EVENT_TYPE_STATUS = 0, so bit 15 should be 0 */
	uint16_t success_response = DTM_ASSEMBLE_STATUS_RESPONSE(0, 0x1234);
	zassert_equal((success_response >> 15) & 0x1, 0,
		      "Status response should have event type bit 0");

	/* Test error response - still DTM_EVENT_TYPE_STATUS = 0, status is in bit 0 */
	uint16_t error_response = DTM_ASSEMBLE_STATUS_RESPONSE(1, 0x5678);
	zassert_equal((error_response >> 15) & 0x1, 0,
		      "Status response should have event type bit 0");
	zassert_equal(error_response & 0x1, 1, "Error should have status bit 1");
}

/**
 * @brief Test packet report assembly
 */
ZTEST(dtm_message_processing, test_packet_report)
{

	uint16_t packet_count = 1234;
	uint16_t report = TEST_DTM_ASSEMBLE_PKT_REPORT_RESPONSE(packet_count);

	/* Packet report should have event type bit 1 (DTM_EVENT_TYPE_PKT_REPORT = 1) */
	zassert_equal((report >> 15) & 0x1, 1, "Packet report should have event type bit 1");
	zassert_equal(report & 0x7FFF, packet_count, "Should contain correct packet count");
}

/**
 * @brief Test feature support bits
 */
ZTEST(dtm_message_processing, test_feature_support)
{
	/* Test individual feature bits */
	zassert_equal(DTM_SUPPORT_LENGTH_EXT_MASK, 0x0001, "Length extension bit should be 0x0001");
	zassert_equal(DTM_SUPPORT_LE_2M_PHY_MASK, 0x0002, "2M PHY bit should be 0x0002");
	zassert_equal(DTM_SUPPORT_TX_HAS_STD_MOD_IDX, 0, "Standard mod index bit should be 0");
	zassert_equal(DTM_SUPPORT_LE_CODED_PHY_MASK, 0x0008, "Coded PHY bit should be 0x0008");

	/* Test combined features */
	uint16_t all_features = DTM_SUPPORT_LENGTH_EXT_MASK | DTM_SUPPORT_LE_2M_PHY_MASK |
				DTM_SUPPORT_TX_HAS_STD_MOD_IDX | DTM_SUPPORT_LE_CODED_PHY_MASK;

	zassert_equal(all_features, 0x000B, "All features combined should be 0x000B");
}

/**
 * @brief Test parameter field extraction macros
 */
ZTEST(dtm_message_processing, test_parameter_extraction)
{
	/* Test PHY mode extraction */
	uint8_t param_with_phy = TEST_DTM_PARAM_SET_PHY_MODE(DTM_PARAM_PHY_MODE_LE_2M);
	zassert_equal(DTM_PARAM_GET_PHY_MODE(param_with_phy), DTM_PARAM_PHY_MODE_LE_2M,
		      "Should extract 2M PHY mode");

	/* Test length extension extraction */
	uint8_t param_with_len_ext = TEST_DTM_PARAM_SET_LEN_EXT(0x03);
	zassert_equal(DTM_PARAM_GET_LEN_EXT(param_with_len_ext), 0x03,
		      "Should extract length extension");
}
```

## src/test_dtm_simulated_rx.c
```c
/*
 * Copyright (c) 2025-2026 Atmosic
 *
 * SPDX-License-Identifier: LicenseRef-Atmosic
 */

#include <zephyr/kernel.h>
#include <zephyr/ztest.h>
#include <zephyr/bluetooth/hci.h>

#include "ble_dtm.h"
#include "dtm_mgr.h"
#include "dtm_hci_bridge.h"

/*
 * Non-weak override of dtm_mgr_send.  The library declares this as __weak so
 * that applications (and tests) can intercept outbound DTM responses without
 * modifying library code.  This definition applies to the whole test binary.
 */
static volatile uint16_t g_last_sent;
static volatile int g_send_count;

void dtm_mgr_send(uint16_t message)
{
	g_last_sent = message;
	g_send_count++;
#ifdef CONFIG_DTM_2WIRE_RX_TESTING_SIMULATED
	TC_PRINT("dtm_mgr_send: 0x%04x\n", message);
#endif
}

#ifdef CONFIG_DTM_2WIRE_RX_TESTING_SIMULATED

static void reset_capture(void)
{
	g_last_sent = 0;
	g_send_count = 0;
}

/* Helper: build a 16-bit DTM wire message */
static uint16_t make_msg(uint8_t cmd, uint8_t ctrl, uint8_t param)
{
	return ((uint16_t)cmd << DTM_CMD_SHIFT) | ((uint16_t)ctrl << DTM_CTRL_SHIFT) | param;
}

static void sim_rx_setup(void)
{
	int ret = dtm_mgr_init();
	zassert_equal(ret, 0, "DTM manager init should succeed");

	/* Reset the library state and discard the reset's response */
	uint16_t reset_msg = make_msg(DTM_CMD_TEST_SETUP, DTM_CTRL_RESET, 0);
	dtm_process_message(reset_msg);
	reset_capture();
}

/**
 * @brief Simulated RX mode: RX_TEST is accepted and immediately returns success
 *        without forwarding any command to the BT controller.
 */
ZTEST(dtm_simulated_rx, test_sim_rx_accepts_command)
{
	sim_rx_setup();

	uint16_t rx_msg = make_msg(DTM_CMD_RX_TEST, 19 /* channel */, 0);
	dtm_process_message(rx_msg);

	zassert_equal(g_send_count, 1, "Exactly one DTM response expected after RX_TEST");

	uint16_t expected = DTM_ASSEMBLE_STATUS_RESPONSE(0, 0);
	zassert_equal(g_last_sent, expected,
		      "Simulated RX start should send success (0x%04x), got 0x%04x", expected,
		      g_last_sent);

	/* Clean up - end the active test */
	uint16_t end_msg = make_msg(DTM_CMD_TEST_END, DTM_END_CTRL_END, DTM_END_PARAM_END);
	dtm_process_message(end_msg);
}

/**
 * @brief Simulated RX mode: TEST_END always reports 0 packets received.
 */
ZTEST(dtm_simulated_rx, test_sim_rx_test_end_zero_packets)
{
	sim_rx_setup();

	/* Start simulated RX */
	uint16_t rx_msg = make_msg(DTM_CMD_RX_TEST, 19, 0);
	dtm_process_message(rx_msg);

	/* Issue TEST_END and capture its response */
	reset_capture();
	uint16_t end_msg = make_msg(DTM_CMD_TEST_END, DTM_END_CTRL_END, DTM_END_PARAM_END);
	dtm_process_message(end_msg);

	zassert_equal(g_send_count, 1, "Exactly one DTM response expected after TEST_END");

	uint16_t expected = DTM_ASSEMBLE_PKT_REPORT(0);
	zassert_equal(g_last_sent, expected,
		      "Simulated RX end should report 0 packets (0x%04x), got 0x%04x", expected,
		      g_last_sent);
}

/**
 * @brief Simulated RX mode: a second test command while one is active returns
 *        CONTROLLER_BUSY.
 */
ZTEST(dtm_simulated_rx, test_sim_rx_controller_busy)
{
	sim_rx_setup();

	/* Start first simulated RX test */
	uint16_t rx_msg = make_msg(DTM_CMD_RX_TEST, 19, 0);
	dtm_process_message(rx_msg);

	/* Attempt to start a second RX test while the first is still active */
	reset_capture();
	dtm_process_message(rx_msg);

	zassert_equal(g_send_count, 1, "Expected one response for the busy rejection");

	/* Status response with the error bit set */
	uint16_t expected = DTM_ASSEMBLE_STATUS_RESPONSE(1, 0);
	zassert_equal(g_last_sent, expected,
		      "Second RX_TEST should return busy (0x%04x), got 0x%04x", expected,
		      g_last_sent);

	/* Clean up */
	uint16_t end_msg = make_msg(DTM_CMD_TEST_END, DTM_END_CTRL_END, DTM_END_PARAM_END);
	dtm_process_message(end_msg);
}

/**
 * @brief Simulated RX mode: multiple consecutive cycles each report success on
 *        start and 0 packets on end.
 */
ZTEST(dtm_simulated_rx, test_sim_rx_multiple_cycles)
{
	sim_rx_setup();

	uint16_t end_msg = make_msg(DTM_CMD_TEST_END, DTM_END_CTRL_END, DTM_END_PARAM_END);
	uint16_t expected_start = DTM_ASSEMBLE_STATUS_RESPONSE(0, 0);
	uint16_t expected_end = DTM_ASSEMBLE_PKT_REPORT(0);

	for (int cycle = 0; cycle < 3; cycle++) {
		TC_PRINT("Simulated RX cycle %d\n", cycle);

		/* Start */
		reset_capture();
		uint16_t rx_msg = make_msg(DTM_CMD_RX_TEST, 19 + cycle, 0);
		dtm_process_message(rx_msg);
		zassert_equal(g_send_count, 1, "Cycle %d: one response for RX_TEST", cycle);
		zassert_equal(g_last_sent, expected_start,
			      "Cycle %d: RX_TEST should return success", cycle);

		/* End */
		reset_capture();
		dtm_process_message(end_msg);
		zassert_equal(g_send_count, 1, "Cycle %d: one response for TEST_END", cycle);
		zassert_equal(g_last_sent, expected_end,
			      "Cycle %d: TEST_END should return 0-packet report", cycle);
	}
}

#endif /* CONFIG_DTM_2WIRE_RX_TESTING_SIMULATED */
```

## src/test_dtm_state_machine.c
```c
/*
 * Copyright (c) 2025-2026 Atmosic
 *
 * SPDX-License-Identifier: LicenseRef-Atmosic
 */

#include <zephyr/kernel.h>
#include <zephyr/ztest.h>
#include <zephyr/bluetooth/hci.h>
#include <zephyr/sys/byteorder.h>

#include "dtm_mgr.h"
#include "dtm_hci_bridge.h"
#include "ble_dtm.h"

/* External function for testing DTM message processing */
extern void dtm_process_message(uint16_t message);

/* External references from main.c */
extern const struct device *test_get_uart_device(void);
extern bool test_uart_available(void);

/* Test state tracking */
static volatile bool reset_complete = false;
static volatile bool test_active = false;

/* Mock callback for command completion tracking */
static bool test_state_cmd_complete_cb(uint16_t opcode, const void *param_buf, uint8_t len)
{
	TC_PRINT("State test HCI Command Complete: opcode=0x%04x, len=%d\n", opcode, len);

	if (len && param_buf) {
		uint8_t status = *((uint8_t *)param_buf);
		TC_PRINT("Command status: 0x%02x\n", status);

		/* Track test state based on command completion */
		switch (opcode) {
		case BT_HCI_OP_RESET:
			if (status == BT_HCI_ERR_SUCCESS) {
				reset_complete = true;
			}
			break;
		case BT_HCI_OP_LE_ENH_TX_TEST:
		case BT_HCI_OP_LE_ENH_RX_TEST:
			if (status == BT_HCI_ERR_SUCCESS) {
				test_active = true;
			}
			break;
		case BT_HCI_OP_LE_TEST_END:
			test_active = false;
			break;
		}
	}

	return true;
}

/* Reset test state */
static void reset_state_test(void)
{
	reset_complete = false;
	test_active = false;

	/* Initialize DTM manager */
	int ret = dtm_mgr_init();
	zassert_equal(ret, 0, "DTM manager init should succeed");

	uint16_t reset_msg = (DTM_CMD_TEST_SETUP << DTM_CMD_SHIFT) |
			     (DTM_CTRL_RESET << DTM_CTRL_SHIFT) | (0x00 << DTM_PARAM_SHIFT);

	TC_PRINT("Sending DTM Reset message: 0x%04x\n", reset_msg);
	dtm_process_message(reset_msg);
}

/**
 * @brief Test HCI bridge state after initialization
 */
ZTEST(dtm_state_machine, test_hci_bridge_state)
{
	reset_state_test();

	/* Set callback */
	dtm_hci_bridge_set_cmd_complete_cb(test_state_cmd_complete_cb);

	/* Test basic HCI command */
	uint8_t cmd_ret = dtm_hci_bridge_send_cmd(BT_HCI_OP_RESET, NULL, 0);
	zassert_equal(cmd_ret, BT_HCI_ERR_SUCCESS, "HCI Reset should succeed");
	zassert_true(reset_complete, "Reset should complete");

	/* Test Tx HCI command */
	struct bt_hci_cp_le_enh_tx_test tx_params = {.tx_ch = 0x13, /* Channel 19 (2440 MHz) */
						     .test_data_len = 0x25, /* 37 bytes */
						     .pkt_payload = BT_HCI_TEST_PKT_PAYLOAD_PRBS9,
						     .phy = BT_HCI_LE_TX_PHY_1M};

	cmd_ret = dtm_hci_bridge_send_cmd(BT_HCI_OP_LE_ENH_TX_TEST, (uint8_t *)&tx_params,
					  sizeof(tx_params));
	zassert_equal(cmd_ret, BT_HCI_ERR_SUCCESS, "LE Enhanced TX Test should succeed");
	zassert_true(test_active, "Test should be active after TX start");

	/* Test End HCI command */
	cmd_ret = dtm_hci_bridge_send_cmd(BT_HCI_OP_LE_TEST_END, NULL, 0);
	zassert_equal(cmd_ret, BT_HCI_ERR_SUCCESS, "LE Test End should succeed");
	zassert_false(test_active, "Test should be inactive after end");

	/* Test Rx HCI command */
	struct bt_hci_cp_le_enh_rx_test rx_params = {.rx_ch = 0x13, /* Channel 19 (2440 MHz) */
						     .phy = BT_HCI_LE_RX_PHY_1M,
						     .mod_index = BT_HCI_LE_MOD_INDEX_STANDARD};

	cmd_ret = dtm_hci_bridge_send_cmd(BT_HCI_OP_LE_ENH_RX_TEST, (uint8_t *)&rx_params,
					  sizeof(rx_params));
	zassert_equal(cmd_ret, BT_HCI_ERR_SUCCESS, "LE Enhanced RX Test should succeed");
	zassert_true(test_active, "Test should be active after RX start");

	/* Test End HCI command */
	cmd_ret = dtm_hci_bridge_send_cmd(BT_HCI_OP_LE_TEST_END, NULL, 0);
	zassert_equal(cmd_ret, BT_HCI_ERR_SUCCESS, "LE Test End should succeed");
	zassert_false(test_active, "Test should be inactive after end");
}

/**
 * @brief Test DTM test lifecycle - TX test with state tracking
 */
ZTEST(dtm_state_machine, test_tx_test_lifecycle)
{
	reset_state_test();

	/* Set callback for state tracking */
	dtm_hci_bridge_set_cmd_complete_cb(test_state_cmd_complete_cb);

	/* Start TX test using DTM message */
	uint8_t tx_channel = 19;
	uint8_t tx_length = 37;
	uint8_t tx_packet_type = DTM_PKT_TYPE_PRBS9;

	uint16_t tx_msg = (DTM_CMD_TX_TEST << DTM_CMD_SHIFT) | (tx_channel << DTM_CTRL_SHIFT) |
			  ((tx_length << DTM_TXRX_TEST_LEN_SHIFT) |
			   (tx_packet_type << DTM_TXRX_TEST_PKT_SHIFT));

	TC_PRINT("Sending DTM TX Test message: 0x%04x (ch=%d, len=%d, pkt=%d)\n", tx_msg,
		 tx_channel, tx_length, tx_packet_type);
	dtm_process_message(tx_msg);

	/* Verify test is active */
	zassert_true(test_active, "Test should be active after TX start");

	/* End test using DTM message */
	uint16_t end_msg = (DTM_CMD_TEST_END << DTM_CMD_SHIFT) |
			   (DTM_END_CTRL_END << DTM_CTRL_SHIFT) |
			   (DTM_END_PARAM_END << DTM_PARAM_SHIFT);

	TC_PRINT("Sending DTM Test End message: 0x%04x\n", end_msg);
	dtm_process_message(end_msg);

	/* Verify test is inactive */
	zassert_false(test_active, "Test should be inactive after end");
}

/**
 * @brief Test DTM test lifecycle - RX test with state tracking
 *
 * This test drives an RX test through dtm_process_message() and relies on the
 * HCI command-complete callback to confirm the controller accepted it.  In
 * SIMULATED mode no HCI command is issued, so the callback never fires and the
 * local test_active flag stays false.  Skip the test in that configuration.
 */
ZTEST(dtm_state_machine, test_rx_test_lifecycle)
{
#ifdef CONFIG_DTM_2WIRE_RX_TESTING_SIMULATED
	ztest_test_skip();
#endif
	reset_state_test();

	/* Set callback for state tracking */
	dtm_hci_bridge_set_cmd_complete_cb(test_state_cmd_complete_cb);

	/* Start RX test using DTM message */
	uint8_t rx_channel = 19;

	uint16_t rx_msg = (DTM_CMD_RX_TEST << DTM_CMD_SHIFT) | (rx_channel << DTM_CTRL_SHIFT) |
			  (0x00 << DTM_PARAM_SHIFT);

	TC_PRINT("Sending DTM RX Test message: 0x%04x (ch=%d)\n", rx_msg, rx_channel);
	dtm_process_message(rx_msg);

	/* Verify test is active */
	zassert_true(test_active, "Test should be active after RX start");

	/* End test using DTM message */
	uint16_t end_msg = (DTM_CMD_TEST_END << DTM_CMD_SHIFT) |
			   (DTM_END_CTRL_END << DTM_CTRL_SHIFT) |
			   (DTM_END_PARAM_END << DTM_PARAM_SHIFT);

	TC_PRINT("Sending DTM Test End message: 0x%04x\n", end_msg);
	dtm_process_message(end_msg);

	/* Verify test is inactive */
	zassert_false(test_active, "Test should be inactive after end");
}

/**
 * @brief Test multiple test cycles using DTM messages
 */
ZTEST(dtm_state_machine, test_multiple_test_cycles)
{
	reset_state_test();

	/* End message (reused) */
	uint16_t end_msg = (DTM_CMD_TEST_END << DTM_CMD_SHIFT) |
			   (DTM_END_CTRL_END << DTM_CTRL_SHIFT) |
			   (DTM_END_PARAM_END << DTM_PARAM_SHIFT);

	/* Run multiple TX test cycles */
	for (int i = 0; i < 3; i++) {
		TC_PRINT("Test cycle %d\n", i);

		/* Start TX test with different channels */
		uint8_t channel = 19 + i; /* Channels 19, 20, 21 */
		uint16_t tx_msg = (DTM_CMD_TX_TEST << DTM_CMD_SHIFT) | (channel << DTM_CTRL_SHIFT) |
				  ((37 << DTM_TXRX_TEST_LEN_SHIFT) |
				   (DTM_PKT_TYPE_PRBS9 << DTM_TXRX_TEST_PKT_SHIFT));

		TC_PRINT("TX test cycle %d: 0x%04x (ch=%d)\n", i, tx_msg, channel);
		dtm_process_message(tx_msg);

		/* End test */
		TC_PRINT("End test cycle %d: 0x%04x\n", i, end_msg);
		dtm_process_message(end_msg);
	}
}

/**
 * @brief Test different PHY modes using DTM messages
 */
ZTEST(dtm_state_machine, test_different_phy_modes)
{
	reset_state_test();

	/* Test 1M PHY - Set PHY mode first */
	uint16_t phy_1m_msg = (DTM_CMD_TEST_SETUP << DTM_CMD_SHIFT) |
			      (DTM_CTRL_SET_PHY_MODE << DTM_CTRL_SHIFT) |
			      (DTM_PARAM_PHY_MODE_LE_1M << DTM_PARAM_FIELD_SHIFT);

	TC_PRINT("Setting 1M PHY mode: 0x%04x\n", phy_1m_msg);
	dtm_process_message(phy_1m_msg);

	/* TX test with 1M PHY */
	uint16_t tx_1m_msg =
		(DTM_CMD_TX_TEST << DTM_CMD_SHIFT) | (19 << DTM_CTRL_SHIFT) |
		((37 << DTM_TXRX_TEST_LEN_SHIFT) | (DTM_PKT_TYPE_PRBS9 << DTM_TXRX_TEST_PKT_SHIFT));

	TC_PRINT("1M PHY TX test: 0x%04x\n", tx_1m_msg);
	dtm_process_message(tx_1m_msg);

	/* End 1M test */
	uint16_t end_msg = (DTM_CMD_TEST_END << DTM_CMD_SHIFT) |
			   (DTM_END_CTRL_END << DTM_CTRL_SHIFT) |
			   (DTM_END_PARAM_END << DTM_PARAM_SHIFT);

	TC_PRINT("End 1M test: 0x%04x\n", end_msg);
	dtm_process_message(end_msg);

	/* Test 2M PHY - Set PHY mode */
	uint16_t phy_2m_msg = (DTM_CMD_TEST_SETUP << DTM_CMD_SHIFT) |
			      (DTM_CTRL_SET_PHY_MODE << DTM_CTRL_SHIFT) |
			      (DTM_PARAM_PHY_MODE_LE_2M << DTM_PARAM_FIELD_SHIFT);

	TC_PRINT("Setting 2M PHY mode: 0x%04x\n", phy_2m_msg);
	dtm_process_message(phy_2m_msg);

	/* TX test with 2M PHY */
	uint16_t tx_2m_msg =
		(DTM_CMD_TX_TEST << DTM_CMD_SHIFT) | (19 << DTM_CTRL_SHIFT) |
		((37 << DTM_TXRX_TEST_LEN_SHIFT) | (DTM_PKT_TYPE_PRBS9 << DTM_TXRX_TEST_PKT_SHIFT));

	TC_PRINT("2M PHY TX test: 0x%04x\n", tx_2m_msg);
	dtm_process_message(tx_2m_msg);

	/* End 2M test */
	TC_PRINT("End 2M test: 0x%04x\n", end_msg);
	dtm_process_message(end_msg);

	/* Test Coded PHY - Set PHY mode */
	uint16_t phy_coded_msg = (DTM_CMD_TEST_SETUP << DTM_CMD_SHIFT) |
				 (DTM_CTRL_SET_PHY_MODE << DTM_CTRL_SHIFT) |
				 (DTM_PARAM_PHY_MODE_LE_S2 << DTM_PARAM_FIELD_SHIFT);

	TC_PRINT("Setting coded PHY mode: 0x%04x\n", phy_coded_msg);
	dtm_process_message(phy_coded_msg);

	/* RX test with coded PHY */
	uint16_t rx_coded_msg = (DTM_CMD_RX_TEST << DTM_CMD_SHIFT) | (19 << DTM_CTRL_SHIFT) |
				(0x00 << DTM_PARAM_SHIFT);

	TC_PRINT("Coded PHY RX test: 0x%04x\n", rx_coded_msg);
	dtm_process_message(rx_coded_msg);

	/* End coded test */
	TC_PRINT("End coded test: 0x%04x\n", end_msg);
	dtm_process_message(end_msg);
}

/**
 * @brief Test error handling scenarios
 */
ZTEST(dtm_state_machine, test_error_handling)
{
	reset_state_test();

	/* Test invalid channel (> 39) */
	struct bt_hci_cp_le_enh_tx_test invalid_tx = {.tx_ch = 0xFF, /* Invalid channel */
						      .test_data_len = 0x25,
						      .pkt_payload = BT_HCI_TEST_PKT_PAYLOAD_PRBS9,
						      .phy = BT_HCI_LE_TX_PHY_1M};

	uint8_t cmd_ret = dtm_hci_bridge_send_cmd(BT_HCI_OP_LE_ENH_TX_TEST, (uint8_t *)&invalid_tx,
						  sizeof(invalid_tx));
	/* Command might succeed at HCI level but fail at controller level */
	/* The key is that it doesn't crash */
	TC_PRINT("Invalid channel TX test returned: 0x%02x\n", cmd_ret);
}

/**
 * @brief Test DTM message processing with native callback
 */
ZTEST(dtm_state_machine, test_dtm_message_processing)
{
	reset_state_test();

	/* Keep native callback - don't replace with test callback */
	/* This tests the actual DTM message processing and HCI command conversion */

	/* Step 1: Test Setup Reset - DTM message (0x00, 0x00, 0x00) */
	uint16_t reset_msg = (DTM_CMD_TEST_SETUP << DTM_CMD_SHIFT) |
			     (DTM_CTRL_RESET << DTM_CTRL_SHIFT) | (0x00 << DTM_PARAM_SHIFT);

	TC_PRINT("Sending DTM Reset message: 0x%04x\n", reset_msg);
	dtm_process_message(reset_msg);

	/* Step 2: TX Test - DTM message for channel 19, length 37, PRBS9 */
	uint8_t tx_channel = 19;
	uint8_t tx_length = 37;
	uint8_t tx_packet_type = DTM_PKT_TYPE_PRBS9;

	uint16_t tx_msg = (DTM_CMD_TX_TEST << DTM_CMD_SHIFT) | (tx_channel << DTM_CTRL_SHIFT) |
			  ((tx_length << DTM_TXRX_TEST_LEN_SHIFT) |
			   (tx_packet_type << DTM_TXRX_TEST_PKT_SHIFT));

	TC_PRINT("Sending DTM TX Test message: 0x%04x (ch=%d, len=%d, pkt=%d)\n", tx_msg,
		 tx_channel, tx_length, tx_packet_type);
	dtm_process_message(tx_msg);

	/* Step 3: Test End to stop TX test */
	uint16_t end_msg = (DTM_CMD_TEST_END << DTM_CMD_SHIFT) |
			   (DTM_END_CTRL_END << DTM_CTRL_SHIFT) |
			   (DTM_END_PARAM_END << DTM_PARAM_SHIFT);

	TC_PRINT("Sending DTM Test End message: 0x%04x\n", end_msg);
	dtm_process_message(end_msg);

	/* Step 4: RX Test - DTM message for channel 19 */
	uint8_t rx_channel = 19;

	uint16_t rx_msg = (DTM_CMD_RX_TEST << DTM_CMD_SHIFT) | (rx_channel << DTM_CTRL_SHIFT) |
			  (0x00 << DTM_PARAM_SHIFT);

	TC_PRINT("Sending DTM RX Test message: 0x%04x (ch=%d)\n", rx_msg, rx_channel);
	dtm_process_message(rx_msg);

	/* Step 5: Test End to stop RX test */
	TC_PRINT("Sending DTM Test End message: 0x%04x\n", end_msg);
	dtm_process_message(end_msg);

	/* Step 6: Test Setup PHY mode - Set 2M PHY */
	uint16_t phy_2m_msg = (DTM_CMD_TEST_SETUP << DTM_CMD_SHIFT) |
			      (DTM_CTRL_SET_PHY_MODE << DTM_CTRL_SHIFT) |
			      (DTM_PARAM_PHY_MODE_LE_2M << DTM_PARAM_FIELD_SHIFT);

	TC_PRINT("Sending DTM Set 2M PHY message: 0x%04x\n", phy_2m_msg);
	dtm_process_message(phy_2m_msg);

	/* Step 7: TX Test with 2M PHY - different packet type */
	uint8_t tx_2m_packet_type = DTM_PKT_TYPE_11110000;

	uint16_t tx_2m_msg = (DTM_CMD_TX_TEST << DTM_CMD_SHIFT) | (tx_channel << DTM_CTRL_SHIFT) |
			     ((tx_length << DTM_TXRX_TEST_LEN_SHIFT) |
			      (tx_2m_packet_type << DTM_TXRX_TEST_PKT_SHIFT));

	TC_PRINT("Sending DTM 2M TX Test message: 0x%04x (ch=%d, len=%d, pkt=%d)\n", tx_2m_msg,
		 tx_channel, tx_length, tx_2m_packet_type);
	dtm_process_message(tx_2m_msg);

	/* Step 8: Test End to stop 2M TX test */
	TC_PRINT("Sending final DTM Test End message: 0x%04x\n", end_msg);
	dtm_process_message(end_msg);

	/* Step 9: Test Setup Receiver Mode - Set Stable Receiver Mode */
	uint16_t recv_mode_msg = (DTM_CMD_TEST_SETUP << DTM_CMD_SHIFT) |
				 (DTM_CTRL_SET_RECV_MODE << DTM_CTRL_SHIFT) |
				 (DTM_PARAM_RECV_ASSUME_STABLE << DTM_PARAM_FIELD_SHIFT);

	TC_PRINT("Sending DTM Set Receiver Mode message: 0x%04x\n", recv_mode_msg);
	dtm_process_message(recv_mode_msg);

	/* Step 10: RX Test - Test Rx with Stable Receiver Mode */
	TC_PRINT("Sending DTM RX Test message: 0x%04x (ch=%d)\n", rx_msg, rx_channel);
	dtm_process_message(rx_msg);

	/* Step 11: Test End to stop RX test */
	TC_PRINT("Sending final DTM Test End message: 0x%04x\n", end_msg);
	dtm_process_message(end_msg);

	TC_PRINT("DTM message processing test completed\n");
	TC_PRINT("  Reset -> TX(1M,PRBS9) -> End -> RX(1M) -> End -> Set2M -> TX(2M,11110000) -> "
		 "End\n");
	TC_PRINT("  -> SetStableRx -> RX(2M,stable) -> End\n");
}

/**
 * @brief Test different packet types using DTM messages
 */
ZTEST(dtm_state_machine, test_packet_types)
{
	reset_state_test();

	uint8_t tx_channel = 19;
	uint8_t tx_length = 37;

	/* End message (reused) */
	uint16_t end_msg = (DTM_CMD_TEST_END << DTM_CMD_SHIFT) |
			   (DTM_END_CTRL_END << DTM_CTRL_SHIFT) |
			   (DTM_END_PARAM_END << DTM_PARAM_SHIFT);

	/* Test different packet types */
	uint8_t packet_types[] = {DTM_PKT_TYPE_PRBS9, DTM_PKT_TYPE_11110000, DTM_PKT_TYPE_10101010,
				  DTM_PKT_TYPE_LEC_11111111};

	const char *packet_names[] = {"PRBS9", "11110000", "10101010", "LEC_11111111"};

	for (int i = 0; i < ARRAY_SIZE(packet_types); i++) {
		TC_PRINT("Testing packet type: %s (0x%02x)\n", packet_names[i], packet_types[i]);

		/* TX test with specific packet type */
		uint16_t tx_msg = (DTM_CMD_TX_TEST << DTM_CMD_SHIFT) |
				  (tx_channel << DTM_CTRL_SHIFT) |
				  ((tx_length << DTM_TXRX_TEST_LEN_SHIFT) |
				   (packet_types[i] << DTM_TXRX_TEST_PKT_SHIFT));

		TC_PRINT("Sending DTM TX Test message: 0x%04x (ch=%d, len=%d, pkt=%s)\n", tx_msg,
			 tx_channel, tx_length, packet_names[i]);
		dtm_process_message(tx_msg);

		/* End test */
		TC_PRINT("Ending test for packet type: %s\n", packet_names[i]);
		dtm_process_message(end_msg);
	}

	TC_PRINT("All packet types tested successfully\n");
}

/**
 * @brief Test DTM control commands (Read features, PDU support, etc.)
 */
ZTEST(dtm_state_machine, test_control_commands)
{
	reset_state_test();

	/* Test different receiver modes */
	uint8_t recv_modes[] = {DTM_PARAM_RECV_ASSUME_STD, DTM_PARAM_RECV_ASSUME_STABLE};

	const char *recv_mode_names[] = {"Standard", "Stable"};

	for (int i = 0; i < ARRAY_SIZE(recv_modes); i++) {
		uint16_t recv_msg = (DTM_CMD_TEST_SETUP << DTM_CMD_SHIFT) |
				    (DTM_CTRL_SET_RECV_MODE << DTM_CTRL_SHIFT) |
				    (recv_modes[i] << DTM_PARAM_FIELD_SHIFT);

		TC_PRINT("Setting receiver mode: %s (0x%04x)\n", recv_mode_names[i], recv_msg);
		dtm_process_message(recv_msg);
	}

	/* Test Read Test Features */
	uint16_t read_feat_msg = (DTM_CMD_TEST_SETUP << DTM_CMD_SHIFT) |
				 (DTM_CTRL_READ_TEST_FEAT << DTM_CTRL_SHIFT) |
				 (DTM_PARAM_READ_TEST_FEAT_TEST_CASES << DTM_PARAM_FIELD_SHIFT);

	TC_PRINT("Reading test features: 0x%04x\n", read_feat_msg);
	dtm_process_message(read_feat_msg);

	/* Test Set Length Extension */
	uint16_t set_len_ext_msg = (DTM_CMD_TEST_SETUP << DTM_CMD_SHIFT) |
				   (DTM_CTRL_SET_LEN_EXT << DTM_CTRL_SHIFT) |
				   (0x01 << DTM_PARAM_FIELD_SHIFT);

	TC_PRINT("Setting length extension: 0x%04x\n", set_len_ext_msg);
	dtm_process_message(set_len_ext_msg);

	/* Test different PDU support queries */
	uint8_t pdu_types[] = {
		DTM_PARAM_READ_PDU_MAX_TX_OCTETS, DTM_PARAM_READ_PDU_MAX_TX_TIME,
		DTM_PARAM_READ_PDU_MAX_RX_OCTETS, DTM_PARAM_READ_PDU_MAX_RX_TIME,
		0x0F /* Unsupported PDU type (valid range but undefined) */
	};

	const char *pdu_type_names[] = {"Max TX Octets", "Max TX Time", "Max RX Octets",
					"Max RX Time", "Unsupported (0x0F)"};

	for (int i = 0; i < ARRAY_SIZE(pdu_types); i++) {
		uint16_t pdu_msg = (DTM_CMD_TEST_SETUP << DTM_CMD_SHIFT) |
				   (DTM_CTRL_READ_PDU_SUPP << DTM_CTRL_SHIFT) |
				   (pdu_types[i] << DTM_PARAM_FIELD_SHIFT);

		TC_PRINT("Reading PDU support: %s (0x%04x)\n", pdu_type_names[i], pdu_msg);
		dtm_process_message(pdu_msg);
	}

	TC_PRINT("All control commands tested successfully\n");
}

/**
 * @brief Test TX power level setting
 */
ZTEST(dtm_state_machine, test_tx_power_level)
{
	reset_state_test();

	/* Initialize DTM manager */
	int ret = dtm_mgr_init();
	zassert_equal(ret, 0, "DTM manager init should succeed");

	/* Test setting TX power to specific dBm values */
	const int8_t test_powers[] = {
		-20,                    /* Low power */
		0,                      /* Mid power */
		10,                     /* High power */
		DTM_TX_PWR_LVL_MIN_SET, /* Minimum supported */
		DTM_TX_PWR_LVL_MAX_SET  /* Maximum supported */
	};

	for (size_t i = 0; i < ARRAY_SIZE(test_powers); i++) {
		int8_t tx_pwr = test_powers[i];

		/* Set TX power level */
		uint16_t set_pwr_msg = (DTM_CMD_TEST_SETUP << DTM_CMD_SHIFT) |
				       (DTM_CTRL_SET_TX_PWR_LVL << DTM_CTRL_SHIFT) |
				       ((uint8_t)tx_pwr << DTM_PARAM_SHIFT);

		TC_PRINT("Setting TX power to %d dBm (msg: 0x%04x)\n", tx_pwr, set_pwr_msg);
		dtm_process_message(set_pwr_msg);
		k_msleep(50);

		/* Start TX test to verify power is applied */
		uint16_t tx_msg = (DTM_CMD_TX_TEST << DTM_CMD_SHIFT) |
				  (19 << DTM_CTRL_SHIFT) | /* Channel 19 */
				  ((37 << DTM_TXRX_TEST_LEN_SHIFT) |
				   (DTM_PKT_TYPE_PRBS9 << DTM_TXRX_TEST_PKT_SHIFT));

		TC_PRINT("Starting TX test with power %d dBm\n", tx_pwr);
		dtm_process_message(tx_msg);
		k_msleep(100);

		/* End test */
		uint16_t end_msg = (DTM_CMD_TEST_END << DTM_CMD_SHIFT);
		dtm_process_message(end_msg);
		k_msleep(50);
	}

	TC_PRINT("TX power level tests completed\n");
}

/**
 * @brief Test error handling with invalid DTM parameters
 */
ZTEST(dtm_state_machine, test_error_handling_invalid_params)
{
	reset_state_test();

	/* Test invalid control type for TEST_SETUP (valid range but unsupported) */
	uint16_t invalid_ctrl_msg = (DTM_CMD_TEST_SETUP << DTM_CMD_SHIFT) |
				    (0x07 << DTM_CTRL_SHIFT) | /* Invalid control (max 6-bit) */
				    (0x00 << DTM_PARAM_SHIFT);

	TC_PRINT("Testing invalid control type: 0x%04x\n", invalid_ctrl_msg);
	dtm_process_message(invalid_ctrl_msg);

	/* Test Read Test Features invalid parameter */
	uint16_t read_feat_msg = (DTM_CMD_TEST_SETUP << DTM_CMD_SHIFT) |
				 (DTM_CTRL_READ_TEST_FEAT << DTM_CTRL_SHIFT) |
				 (0x0F << DTM_PARAM_FIELD_SHIFT);

	TC_PRINT("Reading invalid test features: 0x%04x\n", read_feat_msg);
	dtm_process_message(read_feat_msg);

	/* Test invalid receiver mode parameter */
	uint16_t invalid_recv_msg = (DTM_CMD_TEST_SETUP << DTM_CMD_SHIFT) |
				    (DTM_CTRL_SET_RECV_MODE << DTM_CTRL_SHIFT) |
				    (0x0F << DTM_PARAM_FIELD_SHIFT); /* Invalid receiver mode */

	TC_PRINT("Testing invalid receiver mode: 0x%04x\n", invalid_recv_msg);
	dtm_process_message(invalid_recv_msg);

	/* Test invalid PHY mode */
	uint16_t invalid_phy_msg = (DTM_CMD_TEST_SETUP << DTM_CMD_SHIFT) |
				   (DTM_CTRL_SET_PHY_MODE << DTM_CTRL_SHIFT) |
				   (0x0F << DTM_PARAM_FIELD_SHIFT); /* Invalid PHY mode */

	TC_PRINT("Testing invalid PHY mode: 0x%04x\n", invalid_phy_msg);
	dtm_process_message(invalid_phy_msg);

	/* Test invalid channel (> 39) */
	uint16_t invalid_ch_msg =
		(DTM_CMD_TX_TEST << DTM_CMD_SHIFT) | (50 << DTM_CTRL_SHIFT) | /* Invalid channel */
		((37 << DTM_TXRX_TEST_LEN_SHIFT) | (DTM_PKT_TYPE_PRBS9 << DTM_TXRX_TEST_PKT_SHIFT));

	TC_PRINT("Testing invalid channel: 0x%04x\n", invalid_ch_msg);
	dtm_process_message(invalid_ch_msg);

	/* Test invalid length (> 255) */
	uint16_t invalid_len_msg = (DTM_CMD_TX_TEST << DTM_CMD_SHIFT) | (19 << DTM_CTRL_SHIFT) |
				   ((0x3F << DTM_TXRX_TEST_LEN_SHIFT) | /* Max length field */
				    (DTM_PKT_TYPE_PRBS9 << DTM_TXRX_TEST_PKT_SHIFT));

	TC_PRINT("Testing maximum length: 0x%04x\n", invalid_len_msg);
	dtm_process_message(invalid_len_msg);

	/* Test invalid TX power (out of range) */
	int8_t invalid_tx_pwr = 50; /* Exceeds DTM_TX_PWR_LVL_MAX (20 dBm) */
	uint16_t invalid_pwr_msg = (DTM_CMD_TEST_SETUP << DTM_CMD_SHIFT) |
				   (DTM_CTRL_SET_TX_PWR_LVL << DTM_CTRL_SHIFT) |
				   ((uint8_t)invalid_tx_pwr << DTM_PARAM_SHIFT);

	TC_PRINT("Testing invalid TX power: %d dBm (0x%04x)\n", invalid_tx_pwr, invalid_pwr_msg);
	dtm_process_message(invalid_pwr_msg);

	TC_PRINT("Error handling tests completed\n");
}

/**
 * @brief Test controller busy
 */
ZTEST(dtm_state_machine, test_controller_busy)
{
	reset_state_test();

	/* Test TX test with channel 19 */
	uint8_t tx_channel = 19;
	uint8_t tx_length = 37;

	uint16_t tx_msg = (DTM_CMD_TX_TEST << DTM_CMD_SHIFT) | (tx_channel << DTM_CTRL_SHIFT) |
			  ((tx_length << DTM_TXRX_TEST_LEN_SHIFT) |
			   (DTM_PKT_TYPE_PRBS9 << DTM_TXRX_TEST_PKT_SHIFT));

	TC_PRINT("Sending DTM TX Test message: 0x%04x (ch=%d, len=%d, pkt=%d)\n", tx_msg,
		 tx_channel, tx_length, DTM_PKT_TYPE_PRBS9);
	dtm_process_message(tx_msg);

	TC_PRINT("Skipping Test End to test controller busy\n");

	/* Test RX test with channel 19 */
	uint16_t rx_msg = (DTM_CMD_RX_TEST << DTM_CMD_SHIFT) | (tx_channel << DTM_CTRL_SHIFT) |
			  (0x00 << DTM_PARAM_SHIFT);

	TC_PRINT("Sending DTM RX Test message: 0x%04x (ch=%d)\n", rx_msg, tx_channel);
	dtm_process_message(rx_msg);

	TC_PRINT("Controller busy test completed\n");
}
```
