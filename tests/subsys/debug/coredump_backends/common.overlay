/*
 * Copyright (c) 2025 Atmosic
 *
 * SPDX-License-Identifier: Apache-2.0
 */

#define ATM_COREDUMP_PARTITION_SIZE 4096
#define ATM_COREDUMP_PARTITION_OFFSET (FLASH_SIZE - ATM_COREDUMP_PARTITION_SIZE)

&flash0 {
        partitions {
                compatible = "atmosic,tz-fixed-partitions", "fixed-partitions";
                #address-cells = <1>;
                #size-cells = <1>;
                coredump_partition: partition@ATM_COREDUMP_NODE_ID {
                        label = "coredump-partition";
                        reg = <ATM_COREDUMP_PARTITION_OFFSET ATM_COREDUMP_PARTITION_SIZE>;
                };
        };
};
