## CMakeLists.txt
```
# Copyright (c) 2026 Atmosic
#
# SPDX-License-Identifier: LicenseRef-Atmosic

cmake_minimum_required(VERSION 3.20.0)

find_package(Zephyr REQUIRED HINTS $ENV{ZEPHYR_BASE})
project(at_cmd_dfu_test)

target_sources(app PRIVATE src/main.c)
```

## Kconfig
```
# Copyright (c) 2026 Atmosic
#
# SPDX-License-Identifier: LicenseRef-Atmosic

mainmenu "AT command DFU test"

config AT_CMD_DFU_TEST_APP_VERSION
	string "Banner version printed by the test application"
	default "1.0.0"
	help
	  String embedded in the boot banner so the pytest harness can tell
	  v1 and v2 builds apart after an MCUboot swap. The pytest fixture
	  builds the v2 image with this option overridden to "2.0.0".

source "Kconfig.zephyr"
```

## prj.conf
```kconfig
# Copyright (c) 2026 Atmosic
#
# SPDX-License-Identifier: LicenseRef-Atmosic

CONFIG_BT=y

CONFIG_ATM_AT_CMD=y
CONFIG_AT_CMD_SET=y
CONFIG_AT_CMD_SYSDFU=y
CONFIG_AT_CMD_SYSMKBANKGOOD=y
CONFIG_AT_CMD_SET_LOG_LEVEL_DBG=y

CONFIG_ATM_VENDOR_DFU=y
CONFIG_ATM_VENDOR_DFU_LOG_LEVEL_DBG=y

CONFIG_FLASH=y
CONFIG_FLASH_MAP=y
CONFIG_STREAM_FLASH=y

CONFIG_BOOTLOADER_MCUBOOT=y
CONFIG_MCUBOOT_IMG_MANAGER=y
CONFIG_IMG_MANAGER=y

CONFIG_CRC=y
CONFIG_UART_INTERRUPT_DRIVEN=y
CONFIG_SERIAL=y
CONFIG_REBOOT=y

CONFIG_LOG=y
```

## app_pytest.overlay
```dts
/*
 * Copyright (c) 2026 Atmosic
 *
 * SPDX-License-Identifier: LicenseRef-Atmosic
 */

/* Enable uart0 (J-Link interface if00 on ATM34 EVK) as the AT command
 * transport for the pytest end-to-end DFU swap test.
 */

&uart0 {
	status = "okay";
	current-speed = <115200>;
};
```

## src/main.c
```c
/*
 * Copyright (c) 2026 Atmosic
 *
 * SPDX-License-Identifier: LicenseRef-Atmosic
 */

/*
 * Minimal AT command DFU test application.
 *
 * Console (uart1) prints a version banner at boot so the pytest harness can
 * detect post-swap reboots.  AT commands are served on uart0 (the same UART
 * that the host uses to drive the DFU).
 *
 * Supported AT commands (via CONFIG_AT_CMD_SET / CONFIG_AT_CMD_SYSDFU):
 *   AT+SYSDFU=0,<len>,<crc_en>   - begin serial DFU transfer
 *   AT+SYSSWITCHBANK              - request MCUboot upgrade and reboot
 *   AT+SYSMKBANKGOOD              - confirm running image (prevent revert)
 *
 * UART transport and SYSDFU byte passthrough are handled by the shared
 * at_cmd_uart_transport library and subsys/at_cmd_set respectively.
 */

#include <zephyr/device.h>
#include <zephyr/sys/printk.h>
#include "at_cmd_set.h"

int main(void)
{
	printk("AT_CMD_DFU_TEST IMG_VER=" CONFIG_AT_CMD_DFU_TEST_APP_VERSION "\n");

	int err = at_cmd_set_uart_ch_init(DEVICE_DT_GET(DT_NODELABEL(uart0)));

	if (err) {
		printk("AT UART init failed: %d\n", err);
		return err;
	}

	printk("DFU_READY\n");
	return 0;
}
```
