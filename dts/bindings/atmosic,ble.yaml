## dts/bindings/sensor/atmosic,mcp3221-sensor.yaml
```yaml
# Copyright (c) 2023-2026, Atmosic
#
# SPDX-License-Identifier: LicenseRef-Atmosic

description: |
  Atmosic sensor-API binding for the Microchip MCP3221 Low-Power 12-Bit A/D
  Converter with I2C Interface.  See
  https://www.microchip.com/en-us/product/mcp3221.

  The "microchip,mcp3221" compatible string is claimed upstream by an
  ADC-controller binding (zephyr/dts/bindings/adc/microchip,mcp3221.yaml).
  This Atmosic-specific compatible exposes the same chip through the
  Zephyr sensor API instead.

compatible: "atmosic,mcp3221-sensor"

include: [sensor-device.yaml, i2c-device.yaml]
```

## dts/bindings/timer/arm,cmsdk-systimer.yaml
```yaml
# Copyright (c) 2026 Atmosic Technologies, Inc.
# SPDX-License-Identifier: LicenseRef-Atmosic

description: |
  ARM CMSDK Timer used as Zephyr system clock.

  This binding is for using a CMSDK Timer as the system tick source.
  For general-purpose counter/timer use, see arm,cmsdk-timer instead.

compatible: "arm,cmsdk-systimer"

include: base.yaml

properties:
  reg:
    required: true
    description: |
      Base address and size of the CMSDK Timer register block.
      Register layout:
        0x000: CTRL      - Control Register (R/W)
        0x004: VALUE     - Current Value Register (R/W)
        0x008: RELOAD    - Reload Value Register (R/W)
        0x00C: INTSTATUS - Interrupt Status (R) / Clear (W) Register

  interrupts:
    required: true
    description: |
      Interrupt line used by this timer instance.
```

## dts/bindings/watchdog/atmosic,cmsdk-watchdog.yaml
```yaml
# Copyright (c) 2025-2026 Atmosic
#
# SPDX-License-Identifier: LicenseRef-Atmosic

description: |
  Atmosic CMSDK watchdog with QSPI reset workaround integration.

  This is an extended version of the ARM CMSDK watchdog driver that
  integrates the QSPI reset workaround. The driver will always
  poll QSPI REMOTE_STATUS register before watchdog reset to ensure
  flash is ready for ROM code.

compatible: "atmosic,cmsdk-watchdog"

include: base.yaml

properties:
  reg:
    required: true

  clocks:
    required: true
```

## lib/Kconfig
```kconfig
# Copyright (c) 2024-2026 Atmosic
#
# SPDX-License-Identifier: LicenseRef-Atmosic

rsource "*/Kconfig"
```

## lib/app_batt/Kconfig
```kconfig
# Copyright (c) 2024-2026 Atmosic
#
# SPDX-License-Identifier: LicenseRef-Atmosic

config APP_BATT
	bool "Battery support"
```

## lib/ariad/Kconfig
```kconfig
# Copyright (c) 2026 Atmosic
#
# SPDX-License-Identifier: LicenseRef-Atmosic

config ATM_ARIAD_LIB
	bool "Atmosic Ariad channel-sounding distance estimator library"
	select CMSIS_DSP
	select CMSIS_DSP_TRANSFORM
	select CMSIS_DSP_COMPLEXMATH
	select CMSIS_DSP_STATISTICS
	select CMSIS_DSP_MATRIX
	select FPU_SHARING
	help
	  Links the prebuilt libariad.a for this SoC revision from
	  openair/lib/ariad, together with its public headers.
```
