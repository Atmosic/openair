## dts/bindings/atmosic,ble.yaml
```yaml
# Copyright 2018-2026 Atmosic
# SPDX-License-Identifier: LicenseRef-Atmosic

description: |
    This binding gives a base representation of the Atmosic BLE

compatible: "atmosic,ble"

include: bt-hci.yaml

properties:
  bt-hci-name:
    default: "Atmosic BLE"
  bt-hci-bus:
    default: "virtual"

  reg:
      type: array
      description: mmio register space
      required: true

  interrupts:
      type: array
      description: required interrupts
      required: true
```

## dts/bindings/atmosic,brownout.yaml
```yaml
# Copyright (c) 2026 Atmosic
# SPDX-License-Identifier: LicenseRef-Atmosic

description: |
  Atmosic brownout policy.

  When threshold properties are absent, the driver selects defaults based on
  the SoC and battery configuration. Applications can override these properties
  in a Devicetree overlay. Set ``CONFIG_ATM_BROWNOUT=n`` to disable brownout
  support.

compatible: "atmosic,brownout"

include: base.yaml

properties:
  brownout-thr-vbat:
    type: int
    required: false
    description: |
      Raw brownout threshold, ``X``, programmed by the brownout driver. The
      voltage formula depends on the SoC, battery type, and battery level:

      - Rechargeable or non-rechargeable, > 1.8 V (ATM33 and ATM34
        non-VBATLI):

        ``V = 1.4 V + 0.05 V * X``
      - Rechargeable or non-rechargeable, <= 1.8 V (ATM33 and ATM34
        non-VBATLI):

        ``V = 0.9 V + 0.025 V * X``
      - Li-ion, > 1.8 V (ATM34 VBATLI):

        ``V = 2.4 V + 0.05 V * X``
      - Li-ion, <= 1.8 V (ATM34 VBATLI):

        ``V = 1.9 V + 0.025 V * X``
      - ATM5 boost mode:

        ``V = 0.875 V + 0.025 V * X``
      - ATM5 buck mode:

        ``V = 1.75 V + 0.05 V * X``

      The ATM34 driver validates the following raw ranges at build time:

      - Rechargeable or non-rechargeable, > 1.8 V: ``8`` through ``31``;
        default ``14``
      - Rechargeable or non-rechargeable, <= 1.8 V: ``4`` through ``31``;
        default ``4``
      - Li-ion, > 1.8 V: ``6`` through ``31``; default ``10``
      - Li-ion, <= 1.8 V: ``0`` through ``31``; default ``8``

      On ATM5, the valid raw range is ``3`` through ``14`` and the default is
      ``3``.

      ATM33 VBATLI configurations use a separate GADC threshold
      (``brownout-thr-vbatli-mv``) and do not use this property.

  brownout-thr-vbatli-mv:
    type: int
    required: false
    description: |
      ATM33 Li-ion GADC brownout threshold in millivolts. This property is
      used only when ``batt-type = <0>``. The driver converts it to volts and
      compares it with the calibrated GADC VBAT measurement.

      When this property is absent, the ATM33 driver selects 2800 mV for the
      HSC battery model or 3250 mV for the standard Li-ion battery model.

  brownout-thr-vstore:
    type: int
    required: false
    description: |
      Raw VSTORE brownout threshold for SoCs that support a VSTORE threshold.
      This board-level value is programmed by the brownout driver.

  brownout-thr-vbat-hysteresis-delta:
    type: int
    required: false
    description: |
      Raw delta that raises ``brownout-thr-vbat`` to the threshold used to wake
      from brownout hibernation. The delta must be non-negative, and the
      summed raw threshold must be within the applicable platform range;
      invalid configurations are rejected at build time.

      The resulting hysteresis voltage formula includes a fixed +0.1 V offset.
      The sum must satisfy the same battery-type and battery-level-specific raw
      range as ``brownout-thr-vbat``. When absent, the ATM34 driver selects the
      following fallback delta values:

      - Rechargeable or non-rechargeable, > 1.8 V: ``4``
      - Rechargeable or non-rechargeable, <= 1.8 V: ``0``
      - Li-ion, > 1.8 V: ``6``
      - Li-ion, <= 1.8 V: ``8``

      On ATM5, the summed raw threshold must be ``3`` through ``14``; the
      default delta is ``5``.
```

## dts/bindings/atmosic,otp.yaml
```yaml
# Copyright 2025-2026 Atmosic
# SPDX-License-Identifier: LicenseRef-Atmosic

description: Atmosic OTP definition

compatible: "atmosic,otp"

include: base.yaml

properties:
  otp-size:
    type: int
    required: true
    description: Size (in bytes) of available OTP memory for secure journal use.
```

## dts/bindings/atmosic,rram-controller.yaml
```yaml
# Copyright (c) 2024-2026 Atmosic
#
# SPDX-License-Identifier: LicenseRef-Atmosic

description: RRAM controller

compatible: "atmosic,rram-controller"

include: flash-controller.yaml
properties:
    no-erase-before-write:
        type: boolean
        required: false
        description: Set if erase is not required before re-writing byte
```

## dts/bindings/atmosic,sec-cntr.yaml
```yaml
# Copyright 2025-2026 Atmosic
# SPDX-License-Identifier: LicenseRef-Atmosic

description: Atmosic secure counters

compatible: "atmosic,sec-cntr"

include: base.yaml

properties:
  reg:
    required: true
```

## dts/bindings/atmosic,sec-debug.yaml
```yaml
# Copyright 2025-2026 Atmosic
# SPDX-License-Identifier: LicenseRef-Atmosic

description: Atmosic secure debug

compatible: "atmosic,sec-debug"

include: base.yaml
```

## dts/bindings/atmosic,sec-jrnl.yaml
```yaml
# Copyright 2025-2026 Atmosic
# SPDX-License-Identifier: LicenseRef-Atmosic

description: Atmosic secure journal

compatible: "atmosic,sec-jrnl"

include: base.yaml

properties:
  reg:
    required: false

  flash-journal-size:
    type: int
    description: |
      Size in bytes of the mapped NVM (Flash) region used as the
      secondary journal source.  When present, the driver falls back
      to this region after the primary source is exhausted.  The base
      address of the region is supplied by the board via the
      SEC_JOURNAL_BASE define.

  has-status-field:
    type: boolean
    description: |
      Indicates that each TLV tag header contains a status byte
      between the tag byte and the length field, giving a 4-byte
      header {tag, status, length[2]}.  When absent the header is
      the compact 3-byte form {tag, length[2]}.

  otp-journal-offset:
    type: int
    default: 0
    description: |
      Byte offset within the OTP address space where the secure
      journal region begins.

  otp-journal-size:
    type: int
    description: |
      Size in bytes of the OTP region reserved for the secure
      journal.
```

## dts/bindings/atmosic,sec-mem-protect.yaml
```yaml
# Copyright 2025-2026 Atmosic
# SPDX-License-Identifier: LicenseRef-Atmosic

description: Atmosic secure memory protection

compatible: "atmosic,sec-mem-prot"

include: base.yaml
```

## dts/bindings/atmosic,sec-nv-mem-flash-prot.yaml
```yaml
# Copyright 2025-2026 Atmosic
# SPDX-License-Identifier: LicenseRef-Atmosic

description: Atmosic secure non volatile memory FLASH protection support

compatible: "atmosic,sec-nv-mem-flash-prot"

include: base.yaml

properties:
  blk-size:
    type: int
    required: true
    description: Size in bytes of each protected block
  read-prot-size:
    type: int
    required: true
    description: Length in bytes of configurable read protection from the beginning of the memory area
  write-prot-size:
    type: int
    required: true
    description: Length in bytes of configurable write protection from the beginning of the memory area
```

## dts/bindings/atmosic,sec-nv-mem-rom-prot.yaml
```yaml
# Copyright 2025-2026 Atmosic
# SPDX-License-Identifier: LicenseRef-Atmosic

description: Atmosic secure non volatile memory ROM protection support

compatible: "atmosic,sec-nv-mem-rom-prot"

include: base.yaml

properties:
  blk-size:
    type: int
    required: true
    description: Size in bytes of the ROM protection block size
  read-prot-size:
    type: int
    required: true
    description: Length in bytes of configurable read protection from the beginning of the memory area
```

## dts/bindings/atmosic,sec-nv-mem-rram-prot.yaml
```yaml
# Copyright 2026 Atmosic
# SPDX-License-Identifier: LicenseRef-Atmosic

description: Atmosic secure non volatile memory RRAM protection support

compatible: "atmosic,sec-nv-mem-rram-prot"

include: base.yaml

properties:
  blk-size:
    type: int
    required: true
    description: Size in bytes of the RRAM protection block size
  write-prot-size:
    type: int
    required: true
    description: Length in bytes of configurable write protection from the beginning of the memory area
  read-prot-size:
    type: int
    required: true
    description: Length in bytes of configurable read protection from the beginning of the memory area
```

## dts/bindings/atmosic,sec-sideload-keys.yaml
```yaml
# Copyright 2025-2026 Atmosic
# SPDX-License-Identifier: LicenseRef-Atmosic

description: Atmosic secure sideload keys

compatible: "atmosic,sec-sideload-keys"

include: base.yaml

properties:
  reg:
    required: true
```

## dts/bindings/atmosic,sec-tz.yaml
```yaml
# Copyright 2025-2026 Atmosic
# SPDX-License-Identifier: LicenseRef-Atmosic

description: Atmosic TrustZone platform support

compatible: "atmosic,sec-tz"

include: base.yaml

properties:
  allow_nsc_in_ram:
    type: boolean
    description: Non-secure callable region can be placed in RAM
  ns_app:
    type: boolean
    description: Non-secure (NS) application configuration
```

## dts/bindings/atmosic,tz-fixed-partitions.yaml
```yaml
description: Atmosic Trustzone Fixed partitions

compatible: "atmosic,tz-fixed-partitions"

include: fixed-partitions.yaml

child-binding:
  properties:
    secure:
      type: boolean
      description: set this property if the partition is a secure parition.
```

## dts/bindings/atmosic,tz-fixed-subpartitions.yaml
```yaml
description: Atmosic Trustzone Fixed subpartitions

compatible: "atmosic,tz-fixed-subpartitions"

include: fixed-subpartitions.yaml

child-binding:
  properties:
    secure:
      type: boolean
      description: set this property if the partition is a secure parition.
```

## dts/bindings/atmosic,unified-watchdog.yaml
```yaml
# Copyright (c) 2025-2026 Atmosic
# SPDX-License-Identifier: LicenseRef-Atmosic

description: |
  Atmosic Unified Watchdog Wrapper

  This device wraps an ARM CMSDK APB watchdog and adds Atmosic PMU
  watchdog management. It presents a single unified watchdog interface
  to applications while managing both hardware watchdogs internally.

  The wrapper delegates ARM watchdog operations to the upstream Zephyr
  driver and adds PMU watchdog functionality for power state management.

compatible: "atmosic,unified-watchdog"

include: base.yaml

properties:
  arm-watchdog:
    type: phandle
    required: true
    description: |
      Reference to the ARM CMSDK APB watchdog device that this
      wrapper will delegate ARM watchdog operations to.

      This should point to a device with compatible = "arm,cmsdk-watchdog".
```

## dts/bindings/display/atmosic,gme-oled.yaml
```yaml
# Copyright (c) 2026 Atmosic
#
# SPDX-License-Identifier: LicenseRef-Atmosic

description: |
  GME12864 family monochrome OLED module on I2C.

  These modules ship with an SSD1306, SSD1315 or compatible controller. Zephyr's
  solomon,ssd1306 driver covers the well-behaved ones; this binding exists for the bare
  COG variants, whose controller sits behind ITO tracks on the glass and will not accept
  an arbitrarily long transfer or a back-to-back one. max-write-len and write-gap-us
  express those two limits, which cannot be described to the upstream driver.

compatible: "atmosic,gme-oled"

include: [display-controller.yaml, i2c-device.yaml]

properties:
  width:
    required: true
  height:
    required: true

  multiplex-ratio:
    type: int
    default: 63
    description: Multiplex ratio, command 0xA8. Normally height - 1.

  display-offset:
    type: int
    default: 0
    description: Vertical COM shift, command 0xD3.

  prechargep:
    type: int
    default: 0x22
    description: |
      Pre-charge period, command 0xD9. 0x22 suits an SSD1306; a QG-2864KMBEG39 asks for
      0xF1 in its own datasheet.

  vcom-desel-level:
    type: int
    default: 0x20
    description: |
      VCOMH deselect level, command 0xDB. 0x20 suits an SSD1306; a QG-2864KMBEG39 asks
      for 0x40. Affects contrast and ghosting only, never whether the panel responds.

  contrast:
    type: int
    default: 0xcf
    description: Contrast, command 0x81.

  segment-remap:
    type: boolean
    description: Reverse the column order, command 0xA1 instead of 0xA0.

  com-invdir:
    type: boolean
    description: Reverse the COM scan direction, command 0xC8 instead of 0xC0.

  com-sequential:
    type: boolean
    description: Sequential rather than alternative COM pin layout, command 0xDA.

  inversion-on:
    type: boolean
    description: Start with the display inverted, command 0xA7 instead of 0xA6.

  use-internal-iref:
    type: boolean
    description: Select the internal current reference, command 0xAD.

  max-write-len:
    type: int
    default: 0
    description: |
      Split writes so no single I2C transaction carries more than this many payload
      bytes; each chunk repeats the control byte, which the controller reads as a
      continuation. Zero sends every write whole.

      A QG-2864KMBEG39 with 2.2k pull-ups measured a limit of 8 bytes at 400 kHz.

  write-gap-us:
    type: int
    default: 0
    description: |
      Idle the bus for this long after each write. Zero does not wait.

      Independent of max-write-len: the panel above needs both, and either alone is not
      enough. 16-byte chunks acknowledge every time when spaced 20 ms apart, then fail
      84 times out of 88 sent back to back.

  ready-time-ms:
    type: int
    default: 10
    description: Time from power-up until the controller accepts commands.
```

## dts/bindings/gpio/atmosic,atm-gpio.yaml
```yaml
# Copyright (c) 2025-2026 Atmosic
# SPDX-License-Identifier: LicenseRef-Atmosic

description: |
  Atmosic GPIO controller with automatic pinmux configuration.

  This driver extends the ARM CMSDK GPIO controller to automatically
  configure pin multiplexing when a pin is set as GPIO. It is hardware
  compatible with ARM CMSDK GPIO but adds Atmosic-specific pinmux handling.

  Key features:
  - Automatic PIN_SELECT() call when configuring GPIO pins
  - Handles P0/P1 (SWD pins) demux automatically
  - Package-specific pin validation via PIN_SELECT()
  - Transparent to application code (uses standard Zephyr GPIO APIs)

  Pin numbering:
  - gpio0: pins 0-15 map to physical pins P0-P15
  - gpio1: pins 0-14 map to physical pins P16-P30
  - gpio2: pins 3-15 map to physical pins P35-P47
  - gpio3: pins 0-3 map to physical pins P48-P51

  Example usage:
    gpio0: gpio@100000 {
        compatible = "atmosic,atm-gpio";
        reg = <0x00100000 0x1000>;
        interrupts = <93 8>;
        gpio-controller;
        #gpio-cells = <2>;
    };

compatible: "atmosic,atm-gpio"

include: [gpio-controller.yaml, base.yaml]

properties:
  reg:
    required: true

  interrupts:
    required: true

  "#gpio-cells":
    const: 2

gpio-cells:
  - pin
  - flags
```

## dts/bindings/ir/atmosic,ir-nec.yaml
```yaml
# Copyright (c) 2026 Atmosic
#
# SPDX-License-Identifier: LicenseRef-Atmosic

description: Atmosic NEC IR blaster (ATM PWM FIFO-driven)

compatible: "atmosic,ir-nec"

include: base.yaml

properties:
  pwms:
    type: phandle-array
    required: true
    description: |
      PWM specifier for the channel used to generate the 38 kHz IR carrier.
      Example: pwms = <&pwm5 5 0 0>;
      The referenced PWM node must have its 'pin' property set to the GPIO
      pin wired to the IR LED driver.
```
