## modules/hal_atmosic/ATM33xx-5/drivers/atmwstk/Kconfig
```kconfig
# Copyright (c) 2024-2025 Atmosic
#
# SPDX-License-Identifier: Apache-2.0

if BT || ENTROPY_ATM_TRNG

choice ATM_WIRELESS_STACK_CHOICE
	prompt "BLE link layer wireless stack flavor"
	optional #TODO: Make ATMWSTK_PD50 default when deprecating CONFIG_ATMWSTK and CONFIG_ATMWSTKLIB.

config ATMWSTK_PD50
	bool "PD50 link controller"

config ATMWSTK_FULL
	bool "Full link controller"
	select USE_ATMWSTK if SOC_ATM33XX_5

endchoice

config USE_ATMWSTK
	bool "Use fixed BLE stack image"

config ATMWSTK
	string "Fixed BLE stack image flavor"
	default "LL"
	depends on USE_ATMWSTK

config ATMWSTKLIB
	string "BLE link layer library flavor"
	default "PD50"
	depends on !USE_ATMWSTK

config ATMWSTK_PATH
	string "path of BLE link stack image"
	default "${ZEPHYR_OPENAIR_MODULE_DIR}/modules/hal_atmosic/ATM33xx-5/drivers/ble"

endif
```

## modules/hal_atmosic/ATM33xx-5/drivers/batt_model_hsc_liion/Kconfig
```kconfig
# Copyright (c) 2024 Atmosic
#
# SPDX-License-Identifier: Apache-2.0

config BATT_MODEL_HSC_LIION
	bool "Lithium-Ion Battery support"
	depends on ADC
	select BATT_MODEL

config BATT_MODEL_HSC
	bool "Hybrid Supercap support"
```

## modules/hal_atmosic/ATM33xx-5/drivers/ble/Kconfig
```kconfig
# Copyright (c) 2023-2025 Atmosic
#
# SPDX-License-Identifier: Apache-2.0

config ATM_BLE
    bool "Atmosic BLE driver"
    default y
    depends on BT
    select ATM_RWLC
    select ATM_EUI
    select ATM_BTHCI_UTILS
    select MBEDTLS

config ATM_RWLC
    bool "Atmosic RWLC driver"
    default y if BT || ENTROPY_ATM_TRNG
    depends on DT_HAS_ATMOSIC_BLE_ENABLED

if ATM_RWLC

config EXT_WAKEUP_ENABLE_INDEFINITE
	bool "Set EXT_WAKEUP_ENABLE to 0x02"

config EXT_WAKEUP_ENABLE
	int "EXT WAKEUP ENABLE"
	default 2 if EXT_WAKEUP_ENABLE_INDEFINITE
	default 1
	help
	   0x00: Timer and software wakeup only
	   0x01: External (from PSEQ) wakeup enabled with limited timeout
	   0x02: External wakeup enabled with no maximum sleep duration

config ATM_BLE_DRIVER_SLEEP
	bool "Atmosic BLE driver sleep"
	default y

config ATM_SLEEP_ENABLE
	int "Sleep enable value"
	default 2 if ATM_BLE_DRIVER_SLEEP
	default 0

config ATM_SLEEP_ADJ
	int "Sleep adjustment value"
	default 0

choice ATM_WIRELESS_STACK_CHOICE
	prompt "BLE link layer wireless stack flavor"
	default ATMWSTK_PD50

config ATMWSTK_PD50
	bool "PD50 link controller"

config ATMWSTK_FULL
	bool "Full link controller"

endchoice

endif
```

## modules/hal_atmosic/ATM33xx-5/drivers/dma/Kconfig
```kconfig
# Copyright (c) 2024 Atmosic
#
# SPDX-License-Identifier: Apache-2.0

config ATM_DMA
	bool "Atmosic DMA module"
	default y if BT || ENTROPY_ATM_TRNG
```

## modules/hal_atmosic/ATM33xx-5/drivers/fixed_atmwstk/Kconfig
```kconfig
# Copyright (c) 2024-2025 Atmosic
#
# SPDX-License-Identifier: Apache-2.0

if BT || ENTROPY_ATM_TRNG

config USE_FIXED_ATMWSTK
	bool
	default y if ATMWSTK_CPD200

config FIXED_ATMWSTK_PATH
	string "path of BLE link stack image"
	default "${ZEPHYR_OPENAIR_MODULE_DIR}/modules/hal_atmosic/ATM33xx-5/drivers/ble"

endif
```

## modules/hal_atmosic/ATM33xx-5/drivers/hw_cfg/Kconfig
```kconfig
# Copyright (c) 2024 Atmosic
#
# SPDX-License-Identifier: Apache-2.0

config ATM_HW_CFG
	bool "Atmosic Hardware Configuration module"
	default y if ADC
	default y if BT
	default y if ENTROPY_ATM_TRNG
	default y if PM
```

## modules/hal_atmosic/ATM33xx-5/drivers/key_sideload/Kconfig
```kconfig
# Copyright (c) 2024 Atmosic-2025
#
# SPDX-License-Identifier: Apache-2.0

config ATM_KEY_SIDELOAD
	bool "Atmosic Key sideloading driver"
	depends on TRUSTED_EXECUTION_SECURE
```

## modules/hal_atmosic/ATM33xx-5/drivers/lpc/Kconfig
```kconfig
# Copyright (c) 2024 Atmosic
#
# SPDX-License-Identifier: Apache-2.0

config ATM_LPC
	bool "Atmosic Low Power Clock module"
	default y if BT
```

## modules/hal_atmosic/ATM33xx-5/drivers/pmu/Kconfig
```kconfig
# Copyright (c) 2024 Atmosic
#
# SPDX-License-Identifier: Apache-2.0

config ATM_PMU
	bool "Atmosic Power Management Unit module"
	default y if ADC
	default y if BT
	default y if ENTROPY_ATM_TRNG
	default y if PM

config PMU_WDOG_TIMEOUT
	int "PMU watchdog timeout"
	default 0
	help
	   A value of 0 implies 1 sec.
	   A value of 1 implies 32 sec.
```
