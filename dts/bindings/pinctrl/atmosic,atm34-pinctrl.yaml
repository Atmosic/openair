## dts/bindings/pinctrl/atmosic,atm34-pinctrl.yaml
```yaml
# Copyright (c) 2024-2025 Atmosic
#
# SPDX-License-Identifier: Apache-2.0

description: |
    The Atmosic pin controller is a node used for configuring pin selections
    and related properties such as pull-up and pull-down.

    You can modify this node by using the 'pinctrl' node label in the boards
    devictree as shown below:

      &pinctrl {
        /* Pin configuration */
      };

    Each pin that makes up a pin configuration should be a child node of the
    pinctrl node. These child nodes contain a 'pinmux' element which is a
    2-element array of the pin number, and the signal for the pin. They may
    optionally have pull-up and pull-down information added as well. An example
    for I2C is shown below.

      /* include signal macros */
      #include <atm34_pinmux.h>

      &pinctrl {
        i2c1_sda_default: i2c1_sda_default {
            /* configure P7 as I2C1 SDA with pull-up
            pinmux = <7 PINMUX_I2C1_SDA>;
            bias-pull-up;
        };

        i2c1_scl_default: i2c1_scl_default {
            /* configure P6 as I2C1 SCL */
            pinmux = <6 PINMUX_I2C1_SCL>;
        };
      };


    The above node defines a configuration called 'i2c1_sda_default' which
    configures P7 as I2C1 SDA with a pull-up and 'i2c1_scl_default' which
    condigures P6 as I2C1 SCL. Finally a peripheral can use this configuration
    by adding a pinctrl-N and pinctrl-names property to the peripherals node.
    An example is as follows:

      &i2c1 {
        ...
        pinctrl-0 = <&i2c1_sda_default &i2c1_scl_default>;
        pinctrl-names = "default";
        ...
      };

    Each pin configuration for a specific peripheral should have its own
    "pinctrl-N" with a unique number, starting with 0, however numbers are
    expected to be reset and be reused between different peripherals. Typically
    only a 'pinctrl-0' is necessary. The names for each configuration should be
    comma seperated.

compatible: "atmosic,atm34-pinctrl"

include: base.yaml

properties:
  num-pins:
    required: true
    type: int
    description: |
      The max number of pins available for the given SOC Series.

child-binding:

  include:
    - name: pincfg-node.yaml
      property-allowlist:
        - bias-disable
        - bias-pull-down
        - bias-pull-up

  properties:
    drive-strength:
      type: int
      enum:
        - 0
        - 1
        - 2
        - 3
      default: 0
      description: |
          These values correspond to the PDSN value which can be found in
          Table 2-5 "GPIO Characteristics" from the ATM34 datasheet. The
          actual drive strength is affected by external voltages supplied
          to the SoC. A copy of the table has been provided below.
          +-------------------------------+-------------------------------+
          | VIO = VDDIO - 0.3V            | VIO = 0.3V                    |
          +-------+------+----------------+-------------------------------+
          | VDDIO | PDSN | Drive Strength | VDDIO | PDSN | Drive Strength |
          +-------+------+----------------+-------+------+----------------+
          |  3.3V |   0  |     21 mA      |  3.3V |   0  |     27 mA      |
          +-------+------+----------------+-------+------+----------------+
          |  3.3V |   1  |     15 mA      |  3.3V |   1  |     18 mA      |
          +-------+------+----------------+-------+------+----------------+
          |  3.3V |   2  |     11 mA      |  3.3V |   2  |     14 mA      |
          +-------+------+----------------+-------+------+----------------+
          |  3.3V |   3  |      4 mA      |  3.3V |   3  |      5 mA      |
          +-------+------+----------------+-------+------+----------------+
          |  1.8V |   0  |     14 mA      |  1.8V |   0  |     18 mA      |
          +-------+------+----------------+-------+------+----------------+
          |  1.8V |   1  |      9 mA      |  1.8V |   1  |     12 mA      |
          +-------+------+----------------+-------+------+----------------+
          |  1.8V |   2  |      7 mA      |  1.8V |   2  |      9 mA      |
          +-------+------+----------------+-------+------+----------------+
          |  1.8V |   3  |      2 mA      |  1.8V |   3  |      3 mA      |
          +-------+------+----------------+-------+------+----------------+
    pinmux:
      required: true
      type: array
      description: |
          Each pinmux entry should be an array of two values, the first value
          is the pin, and the second value is the signal it should be configured
          to.
```

## hci_vendor/sample.yaml
```yaml
sample:
  description: Atmosic HCI vendor sample
  name: Atmosic HCI vendor sample
```

## lib/app_work_q/Kconfig
```kconfig
# Copyright (c) 2024 Atmosic
#
# SPDX-License-Identifier: Apache-2.0

config APP_WORK_Q
	bool "App work queue support"

if APP_WORK_Q

config APP_WORK_Q_STACK_SIZE
	int "App work queue thread stack size"
	default 2560

config APP_WORK_Q_PRIORITY
	int "App work queue thread priority"
	default 0

endif # APP_WORK_Q
```

## lib/atm_cs/Kconfig
```kconfig
# Copyright (c) 2025 Atmosic
#
# SPDX-License-Identifier: Apache-2.0

config ATM_CS
	bool "Atmosic Reflector with Ranging Responder Library"
	select BT_CHANNEL_SOUNDING
	select BT_RAS
	select ATM_LDO_MODE
	select APP_WORK_Q
	select ATM_SETTINGS if !ATM_CS_ADV_BT_ID_DEFAULT
	depends on SOC_SERIES_ATM34
	help
	  Enable Atmosic Channel Sounding (CS) reflector functionality.
	  This provides ranging capabilities using Bluetooth Channel Sounding
	  for precise distance measurement applications.

if ATM_CS

module = ATM_CS
module-str = atm_cs
source "${ZEPHYR_BASE}/subsys/logging/Kconfig.template.log_config"

config ATM_CS_ADV_BT_ID_DEFAULT
	bool "CS Advertising on default BT ID"
	default y
	help
	  Use default BT ID for CS advertising. If not, CS will create it's own BT ID.

config ATM_CS_CUSTOM_BT_ADDR
	bool "Enable custom Bluetooth device address for testing or development purposes"
	depends on !ATM_CS_ADV_BT_ID_DEFAULT
	help
	  Enable custom Bluetooth device address for testing or development purposes.

config ATM_CS_CUSTOM_BT_ADDR_VALUE
	string "Custom Bluetooth address (MAC format: XX:XX:XX:XX:XX:XX)"
	depends on ATM_CS_CUSTOM_BT_ADDR
	default "ED:11:11:11:6E:EF"
	help
	  Custom Bluetooth address (MAC format: XX:XX:XX:XX:XX:XX)

config ATM_CS_ADV_TIMEOUT_CS
	int "CS Advertising timeout time(cs)"
	range 0 360000
	default 0
	help
	  Advertising timeout in centiseconds (0 = no timeout).
	  When non-zero, advertising will stop after this duration.

endif # ATM_CS
```

## lib/atm_gfp/Kconfig
```kconfig
# Copyright (c) 2025 Atmosic
#
# SPDX-License-Identifier: Apache-2.0

config ATM_GFP
	bool "Atmosic Google Fast Pair Library"
	select ATM_SETTINGS
	select ATM_GFPS
	select ATM_GFP_DIRECT_UECC_INTERFACE

if ATM_GFP
module = ATM_GFP
module-str = atm_gfp
source "${ZEPHYR_BASE}/subsys/logging/Kconfig.template.log_config"

config ATM_GFP_MUTLIMODE_TAG
	bool "Enable Atmosic Google Fast Pair as once of Multimode Tag"

config FAST_PAIR_FORCE_UNPAIR_ALL_BT_ID
	bool "Force unpair all BT_IDs when button reset"
	help
	  Force unpair all BT_IDs when button reset. Default only unpair Fast Pair related BT_IDs.

endif # ATM_GFP
```

## lib/atm_test_common/Kconfig
```kconfig
# Copyright (c) 2025 Atmosic
#
# SPDX-License-Identifier: Apache-2.0

config ATM_TEST_UTIL
	bool "ATM auto test enable"
	depends on AUTO_TEST
	select ATM_RESET

config ATM_TEST_UTIL_HAS_OVR
	bool "Use overwrite values"

if ATM_TEST_UTIL

config ATM_TEST_AUTO_PASS
	bool "Auto pass after certain time."

config ATM_TEST_AUTO_PASS_TIME
	int "Timeout value in millisecond"
	depends on ATM_TEST_AUTO_PASS
	default 600 if ATM_IS_FOR_SIM
	default 10000

if ATM_TEST_UTIL_HAS_OVR
config ATM_TEST_UTIL_BOOL1
	bool "bool value to overwrite configuration value"

config ATM_TEST_UTIL_INT1
	int "Int value to overwrite configuration value"

config ATM_TEST_UTIL_INT2
	int "Int value to overwrite configuration value"

config ATM_TEST_UTIL_INT3
	int "Int value to overwrite configuration value"

config ATM_TEST_UTIL_HEX1
	hex "hex value to overwrite configuration value"
endif
endif
```

## lib/atm_utils_reg/Kconfig
```kconfig
# Copyright (c) 2024 Atmosic
#
# SPDX-License-Identifier: Apache-2.0

config ATM_UTILS_REG
	bool "Atmosic lib atm_utils_reg module"
	default y if ATM_ATLC
	default y if ATM_AES
	default y if ATM_AES_HW
	default y if ATM_SHA2_HW
	default y if ATM_SHA2_HW_BOOTUTIL
```

## lib/atm_vendor/Kconfig
```kconfig
# Copyright (c) Atmosic 2024-2025
#
# SPDX-License-Identifier: Apache-2.0

config ATM_VENDOR
	bool "Atmosic Vendor command core and parser library"

config ATM_VENDOR_API
	bool "Atmosic Vendor command API"

if ATM_VENDOR

module = ATM_VENDOR
module-str = atm_vendor
source "subsys/logging/Kconfig.template.log_config"

config RUNTIME_EN_HCI_VENDOR
	bool "Runtime Enable HCI vendor"

config VND_DBG_MMR
	bool "[0xFC01] DBG Read Memory."
	depends on SOC_SERIES_ATM33
	default y

config VND_DBG_MMW
	bool "[0xFC02] DBG Write Memory."
	depends on SOC_SERIES_ATM33
	default y

config VND_BLE_REGR
	bool "[0xFC30] BLE Register Read."
	depends on SOC_SERIES_ATM33
	default y

config VND_BLE_REGW
	bool "[0xFC31] BLE Register Write."
	depends on SOC_SERIES_ATM33
	default y

config VND_EN_TXCW
	bool "[0xF802] Tx CW mode control - Enable TX CW mode on specific BLE RF Channel(0~39), RF Channel 255 is used to disable Tx CW mode."
	default y

config VND_CAP_V1
	bool "[0xF803] 16MXtal cap. control - set cap. value."
	depends on SOC_SERIES_ATM33
	default y

config VND_CAP_V2
	bool "[0xF803] 16MXtal cap. control - set cap. value."
	depends on SOC_SERIES_ATM34
	default y

config VND_SYS_MMR
	bool "[0xF804] Memory read - read system memory value by address."
	default y

config VND_PV_TEST
	bool "[0xF80C] PV Test"

config VND_PSM
	bool "[0xF80F] PSM - set power save mode."

config VND_SET_BDDR
	bool "[0xF806] Set Public BD Address."

config VND_SET_ADV_CH
	bool "[0xF807] Set Advertising Channels."

config VND_MALLOC
	bool "[0xF809] Memory Allocate - Allocate n bytes memory (little endian)."
	default y

config VND_IO_CTRL
	bool "[0xF80A] IO Control - set io pin."

config VND_GADC_V2
	bool "[0xF80B] GADC - set gadc value."
	depends on (SOC_SERIES_ATM33 || SOC_SERIES_ATM34)

config VND_GPIO_TEST
	bool "[0xF80E] GPIO Self Test."

config VND_COREMARK
	bool "[0xF810] coremark - get coremark score multiplied by 100."
	depends on (SOC_SERIES_ATM33 || SOC_SERIES_ATM34)

config VND_WFI
	bool "[0xF811] wfi - do wfi to be used for power measure tests."
	depends on (SOC_SERIES_ATM33 || SOC_SERIES_ATM34)

config VND_NO_CLOCK
	bool "[0xF812] no_clock - turn off mpc clock to be used for power measure tests."
	depends on (SOC_SERIES_ATM33 || SOC_SERIES_ATM34)

config VND_WHILE_ONE
	bool "[0xF813] while_one - do while_one to be used for power measure tests"
	depends on (SOC_SERIES_ATM33 || SOC_SERIES_ATM34)

config VND_SET_TX_PWR
	bool "[0xF814] set max Tx power."

config VND_PMU_RADIO_REGR
	bool "[0xFC32] PMU Radio Register Read."
	depends on (SOC_SERIES_ATM33 || SOC_SERIES_ATM34)

config VND_PMU_RADIO_REGW
	bool "[0xFC33] PMU Radio Register Write."
	depends on (SOC_SERIES_ATM33 || SOC_SERIES_ATM34)

config VND_XTAL_32K_PIN_OUT
	bool "[0xFC34] 32KHz XTAL Pin Out assignment in runtime."
	depends on (SOC_SERIES_ATM33 || SOC_SERIES_ATM34)

endif # ATM_VENDOR

if ATM_VENDOR_API

module = ATM_VENDOR_API
module-str = atm_vendor_api
source "subsys/logging/Kconfig.template.log_config"

config VND_API_SET_PREF_SLAVE_LAT
	bool "[0xFC13] Set Prefer Slave latency."

config VND_API_SET_MAX_TX_POWER
	bool "Set Maximum Transmitter Power."
	depends on (SOC_SERIES_ATM33 || SOC_SERIES_ATM34)

config VND_API_SET_ADV_TX_POWER
	bool "Set Advertising Transmitter Power."
	depends on SOC_SERIES_ATM34
	help
	  Direct configuration of advertising TX power is not supported on the ATM33 series. Instead, it can be set indirectly through the atm_vendor_set_max_tx_power() API.

config VND_API_SET_CON_TX_POWER
	bool "[0xFC1A] Set Transmitter Power."
	depends on (SOC_SERIES_ATM33 || SOC_SERIES_ATM34)

config VND_API_SET_SCAN_CHMAP
	bool "[0xFFE0] Set Scan Channel Map."
	depends on SOC_SERIES_ATM34

endif # ATM_VENDOR_API
```

## lib/mcuboot_hooks/Kconfig
```kconfig
# Copyright (c) 2024-2025 Atmosic
#
# SPDX-License-Identifier: Apache-2.0

if MCUBOOT

config ATM_MCUBOOT_HOOKS
	bool
	# enable Zephyr mcuboot action hooks
	select MCUBOOT_ACTION_HOOKS
	# enable standard mcuboot hooks
	select BOOT_IMAGE_ACCESS_HOOKS

if DT_HAS_ATMOSIC_SEC_MEM_PROT_ENABLED

config ATM_MCUBOOT_LOCK_PRIMARY_SLOT
	bool
	select ATM_MCUBOOT_HOOKS
	# enable extension use in hooks to lock the slot
	select ATM_MCUBOOT_EXT

config ATM_MCUBOOT_PROTECT_PRIMARY_SLOT
	bool "Protect primary image slot"
	select ATM_MCUBOOT_LOCK_PRIMARY_SLOT

config ATM_MCUBOOT_SKIP_PRIMARY_VALIDATE_HIBER
	bool "Skip primary slot validation on resume from hibernate"
	# requires locking the primary slot with hooks+extensions
	select ATM_MCUBOOT_LOCK_PRIMARY_SLOT

endif # DT_HAS_ATMOSIC_SEC_MEM_PROT_ENABLED

config ATM_MCUBOOT_SECURE_DEBUG
	bool "Enable secure debug authentication"
	depends on DT_HAS_ATMOSIC_SEC_DEBUG_ENABLED
	select ATM_MCUBOOT_HOOKS
	# enable extension use in hooks to lock the slot
	select ATM_MCUBOOT_EXT
	select ATM_MCUBOOT_UART_DEBUG_AUTH
	# exposes SERIAL adapter configs
	select MCUBOOT_SERIAL_INTF
	select ATM_SEC_COUNTER if DT_HAS_ATMOSIC_SEC_CNTR_ENABLED
	select ATM_SEC_DEBUG
	select ATM_SEC_DEBUG_AUTH
	select BASE64
	select SERIAL

endif # MCUBOOT
```

## modules/hal_atmosic/ATM33xx-5/Kconfig
```kconfig
# Copyright (c) 2024 Atmosic
#
# SPDX-License-Identifier: Apache-2.0

if SOC_ATM33XX_5

rsource "drivers/Kconfig"

if TRUSTED_EXECUTION_SECURE

config SOC_RESET_HOOK
	# if bootloader is set and the SPE, leave bp_init to MCUBOOT
	default n if BOOTLOADER_MCUBOOT && ARM_FIRMWARE_HAS_SECURE_ENTRY_FUNCS
	default y

endif # TRUSTED_EXECUTION_SECURE

endif # SOC_ATM33XX_5
```

## modules/hal_atmosic/ATM33xx-5/drivers/Kconfig
```kconfig
# Copyright (c) 2023-2024 Atmosic
#
# SPDX-License-Identifier: Apache-2.0

rsource "*/Kconfig"

config MBEDTLS_USER_CONFIG_FILE
	default "atm33-mbedtls-config.h" if ATM_AES_HW || ATM_SHA2_HW || ATM_UECC
```

## modules/hal_atmosic/ATM33xx-5/drivers/at_tz_mpc/Kconfig
```kconfig
# Copyright (c) 2024 Atmosic
#
# SPDX-License-Identifier: Apache-2.0

config ATM_TZ_MPC
	bool "Atmosic TrustZone Memory Protection Controller module"
	default y if TRUSTED_EXECUTION_SECURE && !MCUBOOT
```

## modules/hal_atmosic/ATM33xx-5/drivers/at_tz_ppc/Kconfig
```kconfig
# Copyright (c) 2024-2025 Atmosic
#
# SPDX-License-Identifier: Apache-2.0

config ATM_TZ_PPC
	bool "Atmosic TrustZone Peripheral Protection Controller module"
	default y if TRUSTED_EXECUTION_SECURE
	depends on DT_HAS_ATMOSIC_SEC_TZ_ENABLED
```

## modules/hal_atmosic/ATM33xx-5/drivers/atm_aes/Kconfig
```kconfig
# Copyright (c) 2024 Atmosic
#
# SPDX-License-Identifier: Apache-2.0

config ATM_AES
	bool "Atmosic AES module"
	default y if ATM_AES_HW

config ATM_AES_HW
	bool "Hardware accelerator for AES"
	default y
	depends on MBEDTLS_CIPHER_AES_ENABLED && !USERSPACE
	select MBEDTLS_USER_CONFIG_ENABLE
```

## modules/hal_atmosic/ATM33xx-5/drivers/atm_bp_clock/Kconfig
```kconfig
# Copyright (c) 2024 Atmosic
#
# SPDX-License-Identifier: Apache-2.0

config ATM_BP_CLOCK
	bool "Atmosic Backplane Clock module"
	default y if TRUSTED_EXECUTION_NONSECURE && (SOC_FLASH_ATM || BT || ENTROPY_ATM_TRNG || PM || ADC)
	default y if TRUSTED_EXECUTION_SECURE && !BOOTLOADER_MCUBOOT
```

## modules/hal_atmosic/ATM33xx-5/drivers/atm_vendor_drv/Kconfig
```kconfig
# Copyright (c) 2025 Atmosic
#
# SPDX-License-Identifier: Apache-2.0

config ATM_VENDOR_DRIVER
	bool "Atmosic HCI Vendor Command Driver"
	default y if ATM_VENDOR
```
