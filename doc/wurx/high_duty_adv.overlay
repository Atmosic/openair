/*
 * Copyright (c) 2025 Atmosic
 *
 * SPDX-License-Identifier: Apache-2.0
 */

/*
 * WuRx overlay for High Duty Cycle Advertisement wake-up detection
 *
 * This configuration enables the WuRx driver to detect high duty cycle
 * advertisement signals for EVK-to-EVK wake-up scenarios. This is optimized
 * for direct device-to-device communication using custom advertisement patterns.
 */

&wurx {
	status = "okay";

	/* Timing configuration optimized for high duty cycle advertisements */
	wake-timeout-ms = <500>;
	consecutive-signals = <4>;
	signal-spacing-ms = <250>;

	/* PMU WURX register values from high_duty_adv.tds */
	wurx-general-default = <0x00202600>;    /* wurx_general */
	wurx-general2-default = <0x000320c8>;   /* wurx_general2 (default) */

	/* WuRx0 algorithm registers for high duty cycle advertisement detection */
	wurx0-regs-default = <
		0xaaaaaaaa    /* wurx0_0: UID pattern */
		0xaaaaaaaa    /* wurx0_1: GID pattern */
		0x0c0f78dc    /* wurx0_2: correlation and threshold config */
		0x20180c04    /* wurx0_3: energy thresholds and clock freq */
		0x3fb27c0b    /* wurx0_4: timer and algorithm control */
	>;

	/* WuRx1 algorithm registers (typically not used for high duty adv) */
	wurx1-regs-default = <
		0xaaaaaaaa    /* wurx0_0: UID pattern */
		0xaaaaaaaa    /* wurx0_1: GID pattern */
		0x0c0f78dc    /* wurx0_2: correlation and threshold config */
		0x20180c04    /* wurx0_3: energy thresholds and clock freq */
		0x3fb27c0b    /* wurx0_4: timer and algorithm control */
	>;
};
