## modules/hal_atmosic/ATM34xx/drivers/atm_otp/Kconfig
```kconfig
# Copyright (c) 2024 Atmosic-2026
#
# SPDX-License-Identifier: Apache-2.0

config ATM_OTP
	bool "Atmosic One-Time Programmed module"
	default y if TRUSTED_EXECUTION_SECURE
```

## modules/hal_atmosic/ATM34xx/drivers/ble/Kconfig
```kconfig
# Copyright (c) 2023-2026 Atmosic
#
# SPDX-License-Identifier: Apache-2.0

config ATM_BLE
	bool "Atmosic BLE driver"
	default y
	depends on BT
	select ATM_ATLC
	select ATM_BTHCI_UTILS
	select MBEDTLS if ATM_ENA_LL_FEAT_ENC_PRIV
	select MBEDTLS_PSA_CRYPTO_C if ATM_ENA_LL_FEAT_ENC_PRIV

config ATM_BLE_DRIVER_SPLIT_INIT
	bool "Split the initialization path for the BLE driver"
	depends on ATM_BLE
	help
	  [EXPERIMENTAL] This option splits driver initialization
	  into two phases.  The initial phase minimally initializes
	  driver state and interrupts.  The second phase initiatizes the
	  BLE driver thread and is deferred until the driver is opened.

config ATM_BLE_ALLOW_PUB_ADDR
	bool "Allow the use of a public BD address"
	default y
	depends on ATM_BLE
	select ATM_EUI
	help
	  This option will acquire the public address
	  from the EUI driver. If disabled, the application must
	  request the BT stack to use a static random.

config ATM_ATLC
	bool "Atmosic ATLC driver"
	default y if BT || IEEE802154_ATM34
	depends on DT_HAS_ATMOSIC_BLE_ENABLED
	select PM_CUSTOM_TICKS_HOOK if PM

if ATM_ATLC

config EXT_WAKEUP_ENABLE_INDEFINITE
	bool "Symbol for backward compatibility"

config ATM_BLE_DRIVER_SLEEP
	bool "Atmosic BLE driver sleep"
	default y

config ATLC_DEEP_SLEEP
	bool "ATLC deep sleep enable"
	default y if ATM_BLE_DRIVER_SLEEP

config ATM_BLE_STACK_SIZE
	int "Size of the event loop thread stack"
	default 2048 if PSA_CSPRNG_GENERATOR
	default 1416

config ATM_BLE_HIGH_PRIO
	int
	default 6

config ATM_BLE_DUMP_HCI
	bool "Dump HCI traffic in the BLE driver"
	depends on ATM_BLE
	select ATM_BTHCI_UTILS_DUMP_PKTS

config ATM_BLE_DUMP_HCI_ALL
	bool "Dump all HCI traffic in the BLE driver"
	depends on ATM_BLE
	select ATM_BTHCI_UTILS_DUMP_PKTS

endif # ATM_ATLC

if ATM_ATLC || DTOP_BYPASS || PM

config ZERO_LATENCY_IRQS
	default y

config ZERO_LATENCY_LEVELS
	default 2

endif # ATM_ATLC || DTOP_BYPASS
```

## modules/hal_atmosic/ATM34xx/drivers/brwnout/Kconfig
```kconfig
# Copyright (c) 2024-2026 Atmosic
#
# SPDX-License-Identifier: LicenseRef-Atmosic

config ATM_BROWNOUT
	bool "Enable brownout support"
	depends on !$(dt_nodelabel_has_prop,pmu,batt-type) || \
		$(dt_nodelabel_int_prop,pmu,batt-type) != 2
	default y if PM

if ATM_BROWNOUT

config BROWNOUT_IMMEDIATELY
        bool "Trigger brownout power-off immediately in ISR"
        default y
        help
            When enabled, the brownout power-off sequence (brwnout_plf_off())
            is executed immediately in the PMU interrupt handler instead of
            being deferred to a workqueue.

            This also suppresses the PMU status register read and print that
            is otherwise emitted during the power-off sequence.

endif
```

## modules/hal_atmosic/ATM34xx/drivers/hw_cfg/Kconfig
```kconfig
# Copyright (c) 2024-2026 Atmosic
#
# SPDX-License-Identifier: Apache-2.0

config ATM_HW_CFG_ALLOW_INVALID_ATE
	bool "Assert on invalid ATE data when false"
	default y if ATM_IS_FOR_SIM

config ATM_HW_CFG
	bool "Atmosic Hardware Config module"
	default y if ATM_ATLC
	default y if DTOP_BYPASS
	default y if ENTROPY_ATM_TRNG
	default y if PM
	default y if ATM_BROWNOUT

config ATM_MAX_TX_POWER_DBM
	int "Maximum TX power possible on this chip, in dBm"
	default 10
```

## modules/hal_atmosic/ATM34xx/drivers/lpc_rcos/Kconfig
```kconfig
# Copyright (c) 2025 Atmosic
#
# SPDX-License-Identifier: Apache-2.0

config ATM_LPC_RCOS
	bool "Atmosic Low Power Clock xtal omit module"
	depends on ATM_ATLC

config ATM_FORCE_LPC_RCOS
	bool "Use RCOS for LPC even with xtal present"
	depends on ATM_LPC_RCOS

config ATM_LPC_RCOS_VALID_SECONDS
	int "Duration for RCOS measurement to remain valid (seconds)"
	default 5
	depends on ATM_LPC_RCOS
	help
         Duration for an RCOS measurement to remain valid in seconds.
         The value is converted to 32kHz clock cycles internally
         (value * 32768). Default is 5 seconds.
```

## modules/hal_atmosic/ATM34xx/drivers/sec_hw_cfg/Kconfig
```kconfig
# Copyright (c) 2024-2026 Atmosic
#
# SPDX-License-Identifier: Apache-2.0

config ATM_SEC_HW_CFG
	bool "Atmosic Secure Hardware Config module"
	default y if TRUSTED_EXECUTION_SECURE && !BOOTLOADER_MCUBOOT

if ATM_SEC_HW_CFG

config ATM_VOLT_CHECK_THR
        int "Initial voltage check threshold"
        default 20
        help
            Controls the VBAT/VBATLI threshold to allow SW boot
            For VBAT level <= 1.8V,
                VBAT threshold = 0.9 + 0.025X, where 0 <= X <= 31
            For VBAT level > 1.8V,
                VBAT threshold = 1.4 + 0.05X, where 0 <= X <= 31
	    For VBATLI,
		VBATLI threshold = 2.4V + 0.050X, where 2 <= X <= 31

endif
```

## modules/hal_atmosic/ATM34xx/lib/Kconfig
```kconfig
# Copyright (c) 2023-2026 Atmosic
#
# SPDX-License-Identifier: Apache-2.0

config DTOP_BYPASS
	bool "FPGA dtop_bypass mezzanine driver"
	depends on BT || IEEE802154_ATM34 || ENTROPY_ATM_TRNG

choice ATM_WIRELESS_STACK_CHOICE
	prompt "BLE link layer wireless stack flavor"
	default ATMWSTK_FULL if BT_HCI_RAW || ATM_BT_INTERNAL_FEATURE
	default ATMWSTK_CPD200 if BT_CENTRAL || BT_OBSERVER || BT_PER_ADV || BT_PER_ADV_SYNC
	default ATMWSTK_PD50
	depends on BT

config ATMWSTK_PD50
	bool "PD50 link controller"

config ATMWSTK_CPD200
	bool "CPD200 link controller"

config ATMWSTK_FULL
	bool "Full link controller"

endchoice
```

## modules/hal_atmosic/ATM34xx/src/Kconfig
```kconfig
# Copyright (c) 2025 Atmosic
#
# SPDX-License-Identifier: Apache-2.0

config POWER_OFF_SBRK
	bool "Power off unused SRAM during retention"
	default y if NEWLIB_LIBC
	depends on PM

config PM_MAX_SLEEP_DURATION_SEC
	int "Maximum sleep duration for all low-power states (seconds)"
	depends on PM
	default 900 if ATM_PMU_WDT_ENABLE
	default 0
	help
	  Maximum duration to remain in any low-power state (retention, hibernation,
	  or SOC-off), in seconds. When set to a non-zero value, this acts as a cap
	  on the sleep duration regardless of the requested idle time.

	  This option is closely tied to PMU watchdog functionality:

	  When CONFIG_ATM_PMU_WDT_ENABLE is enabled (default 900 seconds):
	  - The PMU watchdog warning timer is configured relative to this duration
	  - The system will periodically wake from low-power states to service the
	    PMU watchdog, preventing unexpected resets
	  - The PMU warning fires at: sleep_duration + CONFIG_ATM_WDT_PMU_WARN_OFFSET_SEC
	  - A non-zero value is REQUIRED for PMU watchdog to function correctly in
	    low-power states

	  When CONFIG_ATM_PMU_WDT_ENABLE is disabled (default 0):
	  - No PMU watchdog protection is active during low-power states
	  - The system can sleep indefinitely (infinite sleep allowed)
	  - Wakeup depends solely on configured wakeup sources (timer, GPIO, LPCOMP, etc.)

	  This is also useful for periodically waking up from low-power states when
	  using non-timer based wakeup sources (LPCOMP, GPIO) to perform housekeeping
	  tasks.

	  When set to 0, no maximum duration limit is applied.

config DETECT_PULSE_IN_RETENTION
	bool "Enable GPIO pulse detection in retention mode"
	depends on PM
	depends on GPIO
	help
	  Enable GPIO pulse detection feature that addresses the problem of missing
	  short GPIO pulses during power mode transitions. The system captures GPIO
	  state before entering retention mode and restores GPIO interrupt status
	  after waking up, ensuring that brief pulses are not lost.

	  The feature works by:
	  - Capturing GPIO data values before retention entry
	  - Comparing wake events with GPIO state changes after retention exit
	  - Restoring interrupt status for pins that caused wake events but show
	    no state change (indicating a pulse occurred during transition)
	  - Using polarity manipulation to artificially regenerate missed interrupts

	  This is particularly useful for edge-triggered GPIO interrupts that might
	  be missed during the retention entry/exit process.
```

## modules/hal_atmosic/ATM5xxx/Kconfig
```kconfig
# Copyright (c) 2024-2026 Atmosic
#
# SPDX-License-Identifier: LicenseRef-Atmosic

if SOC_SERIES_ATM5

if SOC_ATM5XXX_2
rsource "rev-2/drivers/Kconfig"
rsource "rev-2/lib/Kconfig"
endif
rsource "drivers/Kconfig"
rsource "src/Kconfig"

if TRUSTED_EXECUTION_SECURE

config SOC_RESET_HOOK
	# if bootloader is set and the SPE, leave bp_init to MCUBOOT
	default n if BOOTLOADER_MCUBOOT && ARM_FIRMWARE_HAS_SECURE_ENTRY_FUNCS
	# if bootloader is set and the ATM_NO_TZ, leave bp_init to MCUBOOT
	default n if BOOTLOADER_MCUBOOT && ATM_NO_TZ
	default y

config ATM_HAL_ENABLE_NSC_IN_RAM
	bool
	default y
	depends on $(dt_nodelabel_bool_prop,sec_tz,allow_nsc_in_ram) || ATM_NO_TZ
	help
	  Support non-secure callable API relocation to RAM.  This includes
	  moving performance critical HAL functions to RAM.

endif # TRUSTED_EXECUTION_SECURE

config ATM_RELOC_SRAM
	bool "Atmosic code & data relocation to SRAM"
	default y if BT || PM
	select CODE_DATA_RELOCATION_SRAM
	select ATM_DMA_RELOC_SRAM

endif
```

## modules/hal_atmosic/ATM5xxx/drivers/Kconfig
```kconfig
# Copyright (c) 2026 Atmosic
#
# SPDX-License-Identifier: LicenseRef-Atmosic

rsource "*/Kconfig"
```

## modules/hal_atmosic/ATM5xxx/drivers/ble/Kconfig
```kconfig
# Copyright (c) 2023-2026 Atmosic
#
# SPDX-License-Identifier: LicenseRef-Atmosic

config ATM_BLE
	bool "Atmosic BLE driver"
	default y
	depends on BT
	select ATM_ATLC
	select ATM_BTHCI_UTILS
	select MBEDTLS
	select MBEDTLS_PSA_CRYPTO_C

config ATM_BLE_ALLOW_PUB_ADDR
	bool "Allow the use of a public BD address"
	default y
	depends on ATM_BLE
	select ATM_EUI
	help
	  This option will acquire the public address
	  from the EUI driver. If disabled, the application must
	  request the BT stack to use a static random.

config ATM_ATLC
	bool "Atmosic ATLC driver"
	default y if BT
	depends on DT_HAS_ATMOSIC_BLE_ENABLED
	select ATM_RELOC_SRAM
	select PM_CUSTOM_TICKS_HOOK if PM

if ATM_ATLC

config EXT_WAKEUP_ENABLE_INDEFINITE
	bool "Symbol for backward compatibility"

config ATM_BLE_DRIVER_SLEEP
	bool "Atmosic BLE driver sleep"
	default y

config ATLC_DEEP_SLEEP
	bool "ATLC deep sleep enable"
	default y if ATM_BLE_DRIVER_SLEEP

config ATM_BLE_STACK_SIZE
	int "Size of the event loop thread stack"
	default 2048 if PSA_CSPRNG_GENERATOR
	default 1416

config ATM_BLE_HIGH_PRIO
	int
	default 6

config ATM_BLE_DUMP_HCI
	bool "Dump HCI traffic in the BLE driver"
	depends on ATM_BLE
	select ATM_BTHCI_UTILS_DUMP_PKTS

config ATM_BLE_DUMP_HCI_ALL
	bool "Dump all HCI traffic in the BLE driver"
	depends on ATM_BLE
	select ATM_BTHCI_UTILS_DUMP_PKTS

endif # ATM_ATLC

if ATM_ATLC || DTOP_BYPASS || PM

config ZERO_LATENCY_IRQS
	default y

config ZERO_LATENCY_LEVELS
	default 2

endif # ATM_ATLC || DTOP_BYPASS
```

## modules/hal_atmosic/ATM5xxx/rev-2/drivers/at_tz_ppc/Kconfig
```kconfig
# Copyright (c) 2024-2026 Atmosic
#
# SPDX-License-Identifier: LicenseRef-Atmosic

config ATM_TZ_PPC
	bool "Atmosic TrustZone Peripheral Protection Controller module"
	default y if TRUSTED_EXECUTION_SECURE
	depends on DT_HAS_ATMOSIC_SEC_TZ_ENABLED
```

## modules/hal_atmosic/ATM5xxx/rev-2/drivers/atm_otp/Kconfig
```kconfig
# Copyright (c) 2025-2026 Atmosic
#
# SPDX-License-Identifier: LicenseRef-Atmosic

config ATM_OTP
	bool "Atmosic One-Time Programmed module"
	default y if TRUSTED_EXECUTION_SECURE && DT_HAS_ATMOSIC_OTP_ENABLED
```

## modules/hal_atmosic/ATM5xxx/rev-2/drivers/atm_vendor_drv/Kconfig
```kconfig
# Copyright (c) 2025-2026 Atmosic
#
# SPDX-License-Identifier: LicenseRef-Atmosic

config ATM_VENDOR_DRIVER
	bool "Atmosic HCI Vendor Command Driver"
	default y if ATM_VENDOR
```

## modules/hal_atmosic/ATM5xxx/rev-2/drivers/brwnout/Kconfig
```kconfig
# Copyright (c) 2026 Atmosic
#
# SPDX-License-Identifier: LicenseRef-Atmosic

config ATM_BROWNOUT
	bool "Enable brownout support"
	default y if PM

if ATM_BROWNOUT

config BROWNOUT_IMMEDIATELY
        bool "Trigger brownout power-off immediately in ISR"
        default y
        help
            When enabled, the brownout power-off sequence (brwnout_plf_off())
            is executed immediately in the PMU interrupt handler instead of
            being deferred to a workqueue.

            This also suppresses the PMU status register read and print that
            is otherwise emitted during the power-off sequence.

endif
```

## modules/hal_atmosic/ATM5xxx/rev-2/drivers/hw_cfg/Kconfig
```kconfig
# Copyright (c) 2024-2026 Atmosic
#
# SPDX-License-Identifier: LicenseRef-Atmosic

config ATM_HW_CFG
	bool "Atmosic Hardware Config module"
	default y if ATM_ATLC
	default y if DTOP_BYPASS
	default y if ENTROPY_ATM_TRNG
	default y if PM
	default y if BROWNOUT

config ATM_MAX_TX_POWER_DBM
	int "Maximum TX power possible on this chip, in dBm"
	default 8
```

## modules/hal_atmosic/ATM5xxx/rev-2/drivers/lcrom_iface/Kconfig
```kconfig
# Copyright (c) 2025-2026 Atmosic
#
# SPDX-License-Identifier: LicenseRef-Atmosic

config ATM_LCROM_IFACE
	bool "Include interface to LCROM"
	default y if ATM_BLE
	select CPU_HAS_CUSTOM_FIXED_SOC_MPU_REGIONS
```

## modules/hal_atmosic/ATM5xxx/rev-2/drivers/pseq/Kconfig
```kconfig
# Copyright (c) 2024-2026 Atmosic
#
# SPDX-License-Identifier: LicenseRef-Atmosic

config ATM_PSEQ
	bool "Atmosic Power Sequencer module"
	default y
```

## modules/hal_atmosic/ATM5xxx/rev-2/drivers/radio_hal_burst/Kconfig
```kconfig
# Copyright (c) 2024-2026 Atmosic
#
# SPDX-License-Identifier: LicenseRef-Atmosic

config ATM_RADIO_HAL_BURST
	bool "Atmosic burst mode module"
```

## modules/hal_atmosic/ATM5xxx/rev-2/drivers/sec_hw_cfg/Kconfig
```kconfig
# Copyright (c) 2024-2026 Atmosic
#
# SPDX-License-Identifier: LicenseRef-Atmosic

config ATM_SEC_HW_CFG
	bool "Atmosic Secure Hardware Config module"
	default y if TRUSTED_EXECUTION_SECURE
```

## modules/hal_atmosic/ATM5xxx/rev-2/lib/Kconfig
```kconfig
# Copyright (c) 2025 Atmosic
#
# SPDX-License-Identifier: Apache-2.0

if BT

choice ATM_WIRELESS_STACK_CHOICE
	prompt "BLE link layer wireless stack flavor"
	default ATMWSTK_FULL if BT_HCI_RAW || ATM_BT_INTERNAL_FEATURE
	default ATMWSTK_CPD200 if BT_OBSERVER || BT_CENTRAL
	default ATMWSTK_PD50

config ATMWSTK_PD50
	bool "PD50 link controller"

config ATMWSTK_CPD200
	bool "CPD200 link controller"

config ATMWSTK_FULL
	bool "Full link controller"

endchoice

endif # BT
```
