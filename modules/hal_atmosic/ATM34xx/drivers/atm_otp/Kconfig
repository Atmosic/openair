## modules/hal_atmosic/ATM5xxx/src/Kconfig
```kconfig
# Copyright (c) 2025 Atmosic
#
# SPDX-License-Identifier: Apache-2.0

DT_CHOSEN_ATM_HIB_SAVED_SRAM := atmosic,hib-saved-sram

config ATM_HIB_SAVED_SRAM_BASE_ADDRESS
	hex
	default $(dt_chosen_reg_addr_hex,$(DT_CHOSEN_ATM_HIB_SAVED_SRAM))
	help
	  Base address of the SRAM sub-region selected by the
	  "atmosic,hib-saved-sram" chosen entry. Its 16 KB banks are retained
	  across hibernation so application state in __noinit survives without an
	  OTP reload on wake. 0 when the chosen entry is absent.

config ATM_HIB_SAVED_SRAM_SIZE
	int
	default $(dt_chosen_reg_size_int,$(DT_CHOSEN_ATM_HIB_SAVED_SRAM))
	help
	  Size in bytes of the "atmosic,hib-saved-sram" region. 0 (default) when
	  the chosen entry is absent, in which case no SRAM is retained during
	  hibernation. Partial trailing 16 KB banks are rounded up.

config POWER_OFF_SBRK
	bool "Power off unused SRAM during retention"
	default y if NEWLIB_LIBC
	depends on PM

config PM_MAX_SLEEP_DURATION_SEC
	int "Maximum sleep duration for all low-power states (seconds)"
	depends on PM
	default 900 if ATM_PMU_WDT_ENABLE
	default 0
	help
	  Maximum duration to remain in any low-power state (retention, hibernation,
	  or SOC-off), in seconds. When set to a non-zero value, this acts as a cap
	  on the sleep duration regardless of the requested idle time.

	  This option is closely tied to PMU watchdog functionality:

	  When CONFIG_ATM_PMU_WDT_ENABLE is enabled (default 900 seconds):
	  - The PMU watchdog warning timer is configured relative to this duration
	  - The system will periodically wake from low-power states to service the
	    PMU watchdog, preventing unexpected resets
	  - The PMU warning fires at: sleep_duration + CONFIG_ATM_WDT_PMU_WARN_OFFSET_SEC
	  - A non-zero value is REQUIRED for PMU watchdog to function correctly in
	    low-power states

	  When CONFIG_ATM_PMU_WDT_ENABLE is disabled (default 0):
	  - No PMU watchdog protection is active during low-power states
	  - The system can sleep indefinitely (infinite sleep allowed)
	  - Wakeup depends solely on configured wakeup sources (timer, GPIO, LPCOMP, etc.)

	  This is also useful for periodically waking up from low-power states when
	  using non-timer based wakeup sources (LPCOMP, GPIO) to perform housekeeping
	  tasks.

	  When set to 0, no maximum duration limit is applied.

config DETECT_PULSE_IN_RETENTION
	bool "Enable GPIO pulse detection in retention mode"
	depends on PM
	depends on GPIO
	help
	  Enable GPIO pulse detection feature that addresses the problem of missing
	  short GPIO pulses during power mode transitions. The system captures GPIO
	  state before entering retention mode and restores GPIO interrupt status
	  after waking up, ensuring that brief pulses are not lost.

	  The feature works by:
	  - Capturing GPIO data values before retention entry
	  - Comparing wake events with GPIO state changes after retention exit
	  - Restoring interrupt status for pins that caused wake events but show
	    no state change (indicating a pulse occurred during transition)
	  - Using polarity manipulation to artificially regenerate missed interrupts

	  This is particularly useful for edge-triggered GPIO interrupts that might
	  be missed during the retention entry/exit process.
```

## modules/hal_atmosic/Kconfig
```kconfig
# Copyright (c) 2024-2026 Atmosic
#
# SPDX-License-Identifier: LicenseRef-Atmosic

rsource "*/Kconfig"

config ATM_PD
	bool "Atmosic forced-power-down prep (atm_pd_prep) mechanism"
	default y if PM
	help
	  Enables the forced-power-down prep-hook registry (ATM_PD_PREP_DEFINE /
	  atm_pd_prep_run) and the atm_pseq_soc_off()/atm_pseq_hibernate() entry
	  points. Defaults to y when Zephyr power management (PM) is enabled, but
	  can be selected independently (e.g. by the fast low-power mode driver)
	  so the mechanism is available without the full PM subsystem.

config ATM_PLF_DEBUG
	bool "Debugging for low level platform drivers"
	default y
	depends on PRINTK

config ATM_ASSERT_THREAD_DUMP
	bool "Dump thread info on assert and fatal error"
	depends on CPU_CORTEX_M
	select THREAD_ANALYZER
	select THREAD_NAME
	help
	  Print detailed information for all threads (state, priority,
	  PC/LR/SP, stack usage, raw stack words), IRQ/SysTick/NVIC state
	  and thread analyzer statistics when an assertion (assert_err or
	  assert_param) or a Zephyr fatal error occurs. The dump runs at
	  most once per fatal path.

config ATM_ASSERT_THREAD_DUMP_MAX_WORDS
	int "Maximum number of stack words to dump per thread"
	depends on ATM_ASSERT_THREAD_DUMP
	default 16
	range 1 1024
	help
	  Set the maximum number of raw stack words printed for each thread
	  during the thread dump.

config ATM_BUILD_CORE_C_FILES
	bool "Build core.c files if present. Only meant for internal debugging"
```

## modules/hal_atmosic/drivers/Kconfig
```kconfig
# Copyright (c) 2024-2026 Atmosic
#
# SPDX-License-Identifier: LicenseRef-Atmosic
#

rsource "*/Kconfig"

config MBEDTLS_USER_CONFIG_FILE
	default "atm-mbedtls-config.h" if ATM_UECC_PSA_NO_FALLBACK
```

## modules/hal_atmosic/drivers/at_tz_mpc/Kconfig
```kconfig
# Copyright (c) 2024-2026 Atmosic
#
# SPDX-License-Identifier: LicenseRef-Atmosic
#

config ATM_TZ_MPC
	bool "Atmosic TrustZone Memory Protection Controller module"
	default y if TRUSTED_EXECUTION_SECURE && !MCUBOOT
	depends on DT_HAS_ATMOSIC_SEC_TZ_ENABLED || NULL_POINTER_EXCEPTION_DETECTION_MPC

choice NULL_POINTER_EXCEPTION_DETECTION

config NULL_POINTER_EXCEPTION_DETECTION_MPC
	bool "Use MPC for null pointer exception detection"
	depends on ATM_NO_TZ
	depends on !TRUSTED_EXECUTION_NONSECURE
	select ATM_TZ_MPC
	help
	  Null pointer dereference detection implemented using
	  TrustZone MPC. This frees up MPU regions for other uses
	  like userspace. The MPC marks the NULL page as non-secure
	  and generates bus faults on access attempts.

	  To fully disable the rom_null_page MPU region, the DTS flag
	  ATM_MPC_NULL_POINTER_DETECTION must also be passed via
	  DTS_EXTRA_CPPFLAGS.

endchoice
```
