## modules/hal_atmosic/ATM34xx/drivers/sec_counter/Kconfig
```kconfig
# Copyright (c) 2024-2025 Atmosic
#
# SPDX-License-Identifier: Apache-2.0

config ATM_SEC_COUNTER_PRESENT
	bool "Atmosic platform has access to sec_counter functions"
	default y if TRUSTED_EXECUTION_NONSECURE || TRUSTED_EXECUTION_SECURE

config ATM_SEC_COUNTER
	bool "Atmosic Secure Counter module"
	depends on TRUSTED_EXECUTION_SECURE
	select ATM_OTP
```

## modules/hal_atmosic/ATM34xx/drivers/spi/Kconfig
```kconfig
# Copyright (c) 2024 Atmosic
#
# SPDX-License-Identifier: Apache-2.0

config ATM_SPI
	bool "Atmosic SPI module"
	default y if TRUSTED_EXECUTION_NONSECURE && (SOC_FLASH_ATM || ATM_ATLC || DTOP_BYPASS || ENTROPY_ATM_TRNG || PM || ADC || ATM_PMU)
	default y if TRUSTED_EXECUTION_SECURE && !BOOTLOADER_MCUBOOT
```

## modules/hal_atmosic/ATM5xxx/rev-2/drivers/key_sideload/Kconfig
```kconfig
# Copyright (c) Atmosic 2024-2025
#
# SPDX-License-Identifier: Apache-2.0

config ATM_KEY_SIDELOAD
	bool "Atmosic Key sideloading driver"
	depends on TRUSTED_EXECUTION_SECURE
	depends on DT_HAS_ATMOSIC_SEC_SIDELOAD_KEYS_ENABLED
```

## modules/hal_atmosic/ATM5xxx/rev-2/drivers/sec_dev_lockout/Kconfig
```kconfig
# Copyright (c) 2024 Atmosic
#
# SPDX-License-Identifier: Apache-2.0

config ATM_SEC_DEV_LOCKOUT
	bool "Atmosic Secure Device Lockout module"
	default y if TRUSTED_EXECUTION_SECURE && !MCUBOOT
```

## modules/hal_atmosic/ATMx2xx-x1x/Kconfig
```kconfig
# Copyright (c) 2024 Atmosic
#
# SPDX-License-Identifier: Apache-2.0

if SOC_SERIES_ATMX2

rsource "drivers/Kconfig"
rsource "src/Kconfig"

endif # SOC_SERIES_ATMX2
```

## modules/hal_atmosic/ATMx2xx-x1x/drivers/ble/Kconfig
```kconfig
# Copyright (c) 2024 Atmosic
#
# SPDX-License-Identifier: Apache-2.0

config ATM_BLE
    bool "Atmosic BLE driver"
    default y
    depends on BT
    select MBEDTLS

if BT

config EXT_WAKEUP_ENABLE
	int "EXT WAKEUP ENABLE"
	default 1

config ATM_BLE_DRIVER_SLEEP
	bool "Atmosic BLE driver sleep"
	default y

config ATM_SLEEP_ENABLE
	int "Sleep enable value"
	default 3 if ATM_BLE_DRIVER_SLEEP
	default 0

config ATM_SLEEP_ADJ
	int "Sleep adjustment value"
	default 10

endif # BT
```

## modules/hal_atmosic/ATMx2xx-x1x/drivers/brwnout/Kconfig
```kconfig
# Copyright (c) 2024 Atmosic
#
# SPDX-License-Identifier: Apache 2.0

config ATM_BROWNOUT
	bool "Enable brownout support"
	select ATM_PMU
	depends on PM

config BROWNOUT_WAKE_DURATION
	int "Brownout Sleep Duration in ticks"
	default 612
	depends on ATM_BROWNOUT
```

## modules/hal_atmosic/ATMx2xx-x1x/drivers/hw_cfg/Kconfig
```kconfig
# Copyright (c) 2024 Atmosic
#
# SPDX-License-Identifier: Apache-2.0

config ATM_HW_CFG
	bool "Atmosic Hardware Configuration module"
	default y if BT
```

## modules/hal_atmosic/ATMx2xx-x1x/drivers/pmu/Kconfig
```kconfig
# Copyright (c) 2024 Atmosic
#
# SPDX-License-Identifier: Apache-2.0

config ATM_PMU
	bool "Atmosic Power Management Unit module"
	default y if ATM_VENDOR
```

## modules/hal_atmosic/ATMx2xx-x1x/src/Kconfig
```kconfig
# Copyright (c) 2025 Atmosic
#
# SPDX-License-Identifier: Apache-2.0

config POWER_OFF_SBRK
	bool "Power off unused SRAM during retention"
	default y if NEWLIB_LIBC
	depends on PM
```

## modules/hal_atmosic/drivers/atm_bp_clock/Kconfig
```kconfig
# Copyright (c) 2024-2025 Atmosic
#
# SPDX-License-Identifier: Apache-2.0

config ATM_BP_CLOCK
	bool "Atmosic Backplane Clock module"
	depends on SOC_FAMILY_ATM
	default y if (TRUSTED_EXECUTION_NONSECURE || ATM_NO_SPE) && (SOC_FLASH_ATM || BT || ATM_ATLC || DTOP_BYPASS || ENTROPY_ATM_TRNG || PM || ADC || ATM_SPI)
	default y if TRUSTED_EXECUTION_SECURE && !BOOTLOADER_MCUBOOT
```

## modules/hal_atmosic/drivers/batt_model_hsc_liion/Kconfig
```kconfig
# Copyright (c) 2024 Atmosic
#
# SPDX-License-Identifier: Apache-2.0

config BATT_MODEL_HSC_LIION
	bool "HSC/Li-ion Battery Model Driver"
	depends on ADC
	select BATT_MODEL
	help
	  Battery model driver for HSC (Hybrid Super Capacitor) and Li-ion batteries
	  with energy harvesting support. The driver uses device tree batt-type property
	  to determine the appropriate battery model at compile time.
```

## modules/hal_atmosic/drivers/radio_hal_ble_cs/Kconfig
```kconfig
# Copyright (c) 2024-2025 Atmosic
#
# SPDX-License-Identifier: Apache-2.0

config ATM_RADIO_HAL_BLE_CS
	bool "Atmosic radio_hal_ble_cs module"
	depends on ATM_ATLC
	default y if ATM_BLE

config ATM_RF_DELAY_ONE_EIGHTH_NS
	int "RF delay with a unit of 1/8 ns"
	depends on ATM_RADIO_HAL_BLE_CS
	default $(dt_nodelabel_int_prop,atm_antenna,rf-delay-one-eighth-ns) if $(dt_nodelabel_enabled,atm_antenna)
	default 22
	range 0 255

config ATM_REF_PHS_CORR_SUPP
	bool "Atmosic reflector phase correction"
	depends on ATM_RADIO_HAL_BLE_CS
```

## modules/hal_atmosic/drivers/sec_wdog_disable/Kconfig
```kconfig
# Copyright (c) 2025 Atmosic
#
# SPDX-License-Identifier: Apache-2.0


config ATM_SEC_WDOG_DISABLE
	bool "Disable Secure Watchdog"
	depends on TRUSTED_EXECUTION_NONSECURE || \
		(TRUSTED_EXECUTION_SECURE && !ATM_NO_SPE && !MCUBOOT) || \
		(ATM_NO_SPE && BOOTLOADER_MCUBOOT && \
		 !(WATCHDOG && DT_HAS_ARM_CMSDK_WATCHDOG_ENABLED))
	default y
	help
	  Enable the secure watchdog disable functionality. This allows
	  the non-secure side to request disabling of the secure watchdog
	  through a non-secure callable (NSC) function.
	  Runs in the following cases:
	  
	  MCUboot + SPE + NSPE:
	    Has NSPE automatically disable the Secure Watchdog from the SPE
	  SPE + NSPE:
	    Has NSPE automatically disable the Secure Watchdog from the SPE
	  
	  NO-TZ:
	    Does NOT Run
	  MCUboot + NO-TZ + Watchdog in Application:
	    Does NOT Run, Application responsible for resetting Secure Watchdog
	  MCUboot + No-TZ + No Watchdog in Application:
	    Has No-TZ app automatically disable the Secure Watchdog from MCUboot
```

## samples/basic/blinky_pwm/sample.yaml
```yaml
sample:
  name: Blink LED (PWM based)
tests:
  samples.basic.blinky_pwm.atm:
    sysbuild: true
    harness: console
    harness_config:
      type: one_line
      regex:
        - PWM-based blinky
    tags:
      - no_mcuboot
```

## samples/basic/fade_led/sample.yaml
```yaml
sample:
  name: Fade LED
tests:
  samples.basic.fade_led.atm:
    sysbuild: true
    harness: console
    harness_config:
      type: multi_line
      ordered: true
      regex:
        - "Using pulse width \\d+%"
    tags:
      - no_mcuboot
```

## samples/bluetooth/direction_finding_connectionless_tx/sample.yaml
```yaml
sample:
  name: Direction Finding Connectionless Beacon
common:
  sysbuild: true
  harness: console
  harness_config:
    type: one_line
    regex:
      - "Started extended advertising"
tests:
  samples.bluetooth.direction_finding_connectionless_tx.atm:
    tags:
      - bluetooth
      - no_mcuboot
    extra_args:
      - SB_CONFIG_ATMWSTK_FULL=y
      - CONFIG_BT_DF_CTE_TX_AOD=n
```

## samples/bluetooth/hci_uart/boards/ATMEVK-3405-PBV-5_ns.conf
```kconfig
CONFIG_BT_HCI_RAW=y
CONFIG_BT_MAX_CONN=16
CONFIG_BT_BUF_EVT_RX_COUNT=16
CONFIG_BT_BUF_EVT_RX_SIZE=255
CONFIG_BT_BUF_ACL_RX_SIZE=502
CONFIG_BT_BUF_ACL_TX_SIZE=502
CONFIG_BT_BUF_CMD_TX_SIZE=255
CONFIG_BT_HCI_RAW_H4_ENABLE=y
```

## samples/drivers/led/pwm/sample.yaml
```yaml
sample:
  description: Demonstration of the PWM LED driver
  name: PWM LED sample
common:
  sysbuild: true
  tags: LED
tests:
  samples.drivers.led.pwm.atm:
    timeout: 20
    harness: console
    harness_config:
      type: multi_line
      ordered: true
      regex:
        - "Testing LED \\d+"
        - "Turned on"
        - "Turned off"
        - "Increasing brightness gradually"
        - "Decreasing brightness gradually"
        - "Blinking on: ([0-9]+) msec, off: ([0-9]+) msec"
        - "(Blinking on: ([0-9]+) msec, off: ([0-9]+) msec|Cycle period not supported)"
        - "Turned off, loop end"
```

## samples/hello_world/sample.yaml
```yaml
sample:
  description: Hello World sample, the simplest Zephyr
    application
  name: hello world
common:
  tags: introduction
  integration_platforms:
    - native_sim
  harness: console
  harness_config:
    type: one_line
    regex:
      - "Hello World! (.*)"
tests:
  samples.hello_world.atm:
    sysbuild: true
    tags: introduction atm33 atm34 no_mcuboot
    extra_args:
      - SB_CONFIG_SPE=y
  samples.hello_world.atm.mcuboot.atmx2:
    sysbuild: true
    tags: introduction atmx2
    extra_args:
      - SB_CONFIG_BOOTLOADER_MCUBOOT=y
      - SB_CONFIG_BOOT_SIGNATURE_TYPE_ECDSA_P256=y
      - SB_CONFIG_MCUBOOT_MODE_SWAP_SCRATCH=y
```

## samples/nsc_hello_world/Kconfig
```kconfig
# Copyright (c) 2024 Atmosic
#
# SPDX-License-Identifier: Apache-2.0

source "Kconfig.zephyr"

config ATM_ENABLE_NSC_EXAMPLE
	bool "Enable NSC example function for extending SPE"
```

## samples/sensor/adt7420/sample.yaml
```yaml
sample:
  name: ADT7420 Sensor Sample
tests:
  sample.sensor.adt7420:
    harness: sensor
    tags:
      - samples
      - sensor
    depends_on:
      - i2c
  samples.sensor.adt7420.atm:
    sysbuild: true
    harness: console
    harness_config:
      type: one_line
      regex:
#        - Polling at 0.5 Hz
        - Booting Zephyr OS build
    tags:
      - no_mcuboot
```

## samples/sensor/lis2dh/sample.yaml
```yaml
sample:
  name: LIS2DH Accelerometer Monitor
tests:
  sample.sensor.lis2dh:
    harness: sensor
    tags:
      - samples
      - sensor
    depends_on:
      - i2c
      - lis2dh
  samples.sensor.lis2dh.atm:
    sysbuild: true
    harness: console
    harness_config:
      type: one_line
      regex:
        - Polling at 0.5 Hz
    tags: atm33 atm34 no_mcuboot
    extra_args:
      - SB_CONFIG_SPE=y
      - SB_CONFIG_ATMWSTK_FULL=y
```

## soc/atmosic/ATM34/Kconfig.defconfig
```kconfig
# Copyright (c) 2021-2025 Atmosic
#
# SPDX-License-Identifier: Apache-2.0

if SOC_SERIES_ATM34

config SYS_CLOCK_HW_CYCLES_PER_SEC
	int
	default 16000000 if CORTEX_M_SYSTICK_EXTERNAL_REF
	default 32000000

config NUM_IRQS
	int
	default 128

config HW_STACK_PROTECTION
	default y

endif # SOC_SERIES_ATM34
```

## subsys/Kconfig
```kconfig
# Copyright (c) 2024 Atmosic
#
# SPDX-License-Identifier: Apache-2.0

menu "Subsystems"

rsource "settings/Kconfig"

endmenu
```
