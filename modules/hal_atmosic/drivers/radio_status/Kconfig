## samples/bluetooth/peripheral_dis/sample.yaml
```yaml
sample:
  name: Bluetooth Peripheral DIS
common:
  tags:
    - bluetooth
    - role_peripheral
tests:
  samples.bluetooth.peripheral_dis.atm:
    sysbuild: true
    harness: console
    harness_config:
      type: one_line
      regex:
        - "Advertising successfully started"
```
