## modules/hal_atmosic/drivers/radio_status/Kconfig
```kconfig
# Copyright (c) 2024-2026 Atmosic
#
# SPDX-License-Identifier: LicenseRef-Atmosic
#

config ATM_RADIO_STATUS
	bool "Atmosic radio_status module"
	default y if ATM_ATLC || DTOP_BYPASS
```

## modules/hal_atmosic/drivers/reset/Kconfig
```kconfig
# Copyright (c) 2024-2026 Atmosic
#
# SPDX-License-Identifier: LicenseRef-Atmosic
#

config ATM_RESET
	bool "Atmosic Reset module"
	default y if ATM_ATLC
	default y if ATM_RWLC
	default y if DTOP_BYPASS
	default y if ENTROPY_ATM_TRNG
	default y if PM
	default y if ATM_BROWNOUT

config RESET_PRINT
	bool "Log reset reason on boot"
	default y if !MCUBOOT
```

## modules/hal_atmosic/drivers/rram_rom_prot/Kconfig
```kconfig
# Copyright (c) 2024-2026 Atmosic
#
# SPDX-License-Identifier: LicenseRef-Atmosic
#

config ATM_RRAM_ROM_PROT
	bool "Atmosic RRAM ROM Protect module"
	select DEPRECATED
	help
	  This module is deprecated. Use nv_mem_prot module instead.
```

## modules/hal_atmosic/drivers/sec_cache/Kconfig
```kconfig
# Copyright (c) 2024-2026 Atmosic
#
# SPDX-License-Identifier: LicenseRef-Atmosic
#

config ATM_SEC_CACHE
	bool "Atmosic Secure Cache module"
	default y if TRUSTED_EXECUTION_SECURE
```

## modules/hal_atmosic/drivers/sec_debug/Kconfig
```kconfig
# Copyright (c) 2024-2026 Atmosic
#
# SPDX-License-Identifier: LicenseRef-Atmosic
#

config ATM_SEC_DEBUG
	bool
	depends on TRUSTED_EXECUTION_SECURE
```

## modules/hal_atmosic/drivers/sec_jrnl_otp_flash/Kconfig
```kconfig
# Copyright (c) 2024-2026 Atmosic
#
# SPDX-License-Identifier: LicenseRef-Atmosic
#

config ATM_SEC_JRNL_OTP
	bool "Atmosic sec_jrnl OTP journal present"
	default y if $(dt_nodelabel_has_prop,sec_jrnl,otp-journal-size)
	help
	  Indicates that the sec_jrnl node in the Device Tree has an
	  otp-journal-size property, meaning OTP-based journal storage is
	  available on this platform.

if ATM_SEC_JRNL_OTP

config ATM_SEC_JRNL_PRESENT
	bool "Atmosic platform has access to sec_jrnl functions"
	default y
	help
	  Enable access to sec_jrnl API declarations (header + include path).

config ATM_SEC_JRNL
	bool "Atmosic sec_jrnl module"
	default y if !TRUSTED_EXECUTION_NONSECURE
	help
	  Build the sec_jrnl driver implementation.
	  On TrustZone-enabled SoCs this is compiled only in the secure (SPE)
	  image; the non-secure image calls it via Non-Secure Callable entries.
	  On non-TrustZone SoCs (or plain NS test images without TrustZone
	  Kconfig) the implementation is compiled directly into the image.

config ATM_SEC_JRNL_RAM
	bool "Enable RAM journal fallback"
	depends on ATM_SEC_JRNL && !TRUSTED_EXECUTION_SECURE
	help
	  When enabled, sec_jrnl_get() will fall back to a RAM-based
	  journal when a tag is not found in OTP (or Flash).  The RAM
	  journal must be populated at boot via sec_jrnl_ram_init().
	  This option is not available on TrustZone-enabled platforms

config ATM_SEC_JRNL_MOCK_DATA
	bool "Enable sec_jrnl mock-data mode"
	depends on ATM_SEC_JRNL
	help
	  For internal unit testing only. Not intended for customer use.

config ATM_SEC_JRNL_MOCK_DATA_MUTABLE
	bool "sec_jrnl mock-data is mutable"
	depends on ATM_SEC_JRNL_MOCK_DATA
	help
	  For internal unit testing only.  Allows the mock journal to be
	  mutable instead of a constant table.  Allows for tests that
	  need to assemble the journal at runtime.

endif # ATM_SEC_JRNL_OTP
```

## modules/hal_atmosic/drivers/sec_reset/Kconfig
```kconfig
# Copyright (c) 2024-2026 Atmosic
#
# SPDX-License-Identifier: LicenseRef-Atmosic
#

config ATM_SEC_RESET
	bool "Atmosic Secure Reset module"
	default y if TRUSTED_EXECUTION_SECURE

if ATM_SEC_RESET

config ATM_SEC_RESET_FULL_API_TEST
	bool "Enable full reset API testing"
	depends on ZTEST
	help
	  Use only for testing.

endif
```

## samples/basic/minimal/sample.yaml
```yaml
sample:
  description: minimal sample, the smallest possible Zephyr application
  name: minimal
tests:
  samples.basic.minimal.atm:
    sysbuild: true
    harness: console
    harness_config:
      type: one_line
      regex:
        - "Hello World from minimal!"
    extra_configs:
      - CONFIG_SAMPLE_DO_OUTPUT=y
```

## samples/bluetooth/broadcaster/sample.yaml
```yaml
sample:
  name: broadcaster
common:
  tags:
    - bluetooth
    - role_peripheral
    - role_broadcaster
tests:
  samples.bluetooth.broadcaster.atm:
    tags:
      - openair_release
    sysbuild: true
    harness: console
    harness_config:
      type: one_line
      regex:
        - Starting Broadcaster
```

## samples/bluetooth/broadcaster_multiple/sample.yaml
```yaml
sample:
  name: Bluetooth Multiple Extended Advertising Broadcaster
common:
  tags:
    - bluetooth
    - role_peripheral
    - role_broadcaster
tests:
  samples.bluetooth.broadcaster_multiple.atm:
    sysbuild: true
    harness: console
    harness_config:
      type: one_line
      regex:
        - Starting Multiple Broadcaster Demo
```

## samples/bluetooth/central_hr/sample.yaml
```yaml
sample:
  name: Bluetooth Central HR
common:
  tags:
    - bluetooth
    - role_central
tests:
  samples.bluetooth.central_hr.atm:
    tags:
      - openair_release
    sysbuild: true
    harness: console
    harness_config:
      type: one_line
      regex:
        - '\[DEVICE\]: .*RSSI -\d+|Scanning successfully started'
    extra_args:
      - SB_CONFIG_DTS_EXTRA_SELECT_CPD200_HINT=y
```

## samples/bluetooth/central_multilink/sample.yaml
```yaml
sample:
  name: Bluetooth Central Multilink
common:
  tags:
    - bluetooth
    - role_central
tests:
  samples.bluetooth.central_multilink.atm:
    sysbuild: true
    harness: console
    harness_config:
      type: one_line
      regex:
        - "Device found|Scanning successfully started"
    extra_args:
      - SB_CONFIG_DTS_EXTRA_SELECT_CPD200_HINT=y
```

## samples/bluetooth/extended_adv/advertiser/sample.yaml
```yaml
# Copyright (c) 2026 Atmosic
#
# SPDX-License-Identifier: LicenseRef-Atmosic

sample:
  name: Bluetooth Extended Advertising Advertiser
common:
  tags:
    - bluetooth
    - role_peripheral
    - role_broadcaster
tests:
  samples.bluetooth.extended_adv.advertiser.atm:
    sysbuild: true
    harness: console
    harness_config:
      type: one_line
      regex:
        - Starting Extended Advertising Demo
  samples.bluetooth.extended_adv.advertiser.atm.two_dev:
    sysbuild: true
    timeout: 60
    tags:
      - two_dev
    harness: console
    harness_config:
      type: one_line
      regex:
        - "Connected state!"
```

## samples/bluetooth/extended_adv/scanner/sample.yaml
```yaml
# Copyright (c) 2026 Atmosic
#
# SPDX-License-Identifier: LicenseRef-Atmosic

sample:
  name: Bluetooth Extended Advertising Scanner
common:
  tags:
    - bluetooth
    - role_central
tests:
  samples.bluetooth.extended_adv.scanner.atm:
    sysbuild: true
    harness: console
    harness_config:
      type: one_line
      regex:
        - Starting Extended Advertising Demo
    extra_args:
      - SB_CONFIG_DTS_EXTRA_SELECT_CPD200_HINT=y
  samples.bluetooth.extended_adv.scanner.atm.two_dev:
    sysbuild: true
    timeout: 60
    tags:
      - two_dev
    harness: console
    harness_config:
      type: one_line
      regex:
        - "Connected state!"
    extra_args:
      - SB_CONFIG_DTS_EXTRA_SELECT_CPD200_HINT=y
```

## samples/bluetooth/hci_uart/boards/ATMEVK-3325-LQK-6.conf
```kconfig
# Copyright (c) 2025-2026 Atmosic
#
# SPDX-License-Identifier: LicenseRef-Atmosic

CONFIG_BT_BUF_ACL_TX_COUNT=14
CONFIG_BT_BUF_EVT_RX_COUNT=15
```

## samples/bluetooth/hci_uart/sample.yaml
```yaml
common:
  tags:
    - introduction
    - bluetooth
    - atm_test_with_spe
    - role_all
tests:
  samples.bluetooth.hci_uart.atm:
    sysbuild: true
    harness: console
    harness_config:
      type: one_line
      regex:
        - "Booting Zephyr OS"
    tags:
      - openair_release
    extra_args:
      - SB_CONFIG_DTS_EXTRA_SELECT_CPD200_HINT=y
  samples.bluetooth.hci_uart.atm.mcuboot:
    sysbuild: true
    harness: console
    harness_config:
      type: one_line
      regex:
        - "Booting Zephyr OS"
    tags:
      - mcuboot
    extra_args:
      - SB_CONFIG_BOOTLOADER_MCUBOOT=y
      - SB_CONFIG_BOOT_SIGNATURE_TYPE_ECDSA_P256=y
      - SB_CONFIG_MCUBOOT_MODE_OVERWRITE_ONLY=y
      - SB_CONFIG_DTS_EXTRA_SELECT_CPD200_HINT=y
  samples.bluetooth.hci_uart.atm.mcuboot.atmwstk.pd50:
    sysbuild: true
    harness: console
    harness_config:
      type: one_line
      regex:
        - "Booting Zephyr OS"
    tags:
      - mcuboot
      - openair_release_mcuboot
    extra_args:
      - SB_CONFIG_BOOTLOADER_MCUBOOT=y
      - SB_CONFIG_BOOT_SIGNATURE_TYPE_ECDSA_P256=y
      - SB_CONFIG_MCUBOOT_MODE_SWAP_USING_OFFSET=y
      - SB_CONFIG_ATMWSTK_PD50=y
  samples.bluetooth.hci_uart.atm.mcuboot.atmwstk.pd50.legacy_scratch:
    sysbuild: true
    harness: console
    harness_config:
      type: one_line
      regex:
        - "Booting Zephyr OS"
    tags:
      - mcuboot
      - legacy
    extra_args:
      - SB_CONFIG_BOOTLOADER_MCUBOOT=y
      - SB_CONFIG_BOOT_SIGNATURE_TYPE_ECDSA_P256=y
      - SB_CONFIG_MCUBOOT_MODE_SWAP_SCRATCH=y
      - SB_ATM_DTS_EXTRA_CPPFLAGS="-DATM_MCUBOOT_SWAP_WITH_OFFSET=0"
      - SB_CONFIG_ATMWSTK_PD50=y
  samples.bluetooth.hci_uart.atm.mcuboot.atmwstk.pd50.overwrite:
    sysbuild: true
    harness: console
    harness_config:
      type: one_line
      regex:
        - "Booting Zephyr OS"
    tags:
      - mcuboot
      - overwrite_no_flash_xip
    extra_args:
      - SB_CONFIG_BOOTLOADER_MCUBOOT=y
      - SB_CONFIG_BOOT_SIGNATURE_TYPE_ECDSA_P256=y
      - SB_CONFIG_MCUBOOT_MODE_OVERWRITE_ONLY=y
      - SB_CONFIG_ATMWSTK_PD50=y
```

## samples/bluetooth/observer/sample.yaml
```yaml
sample:
  name: observer
common:
  tags:
    - bluetooth
    - role_observer
tests:
  samples.bluetooth.observer.atm:
    sysbuild: true
    harness: console
    harness_config:
      type: one_line
      regex:
        - Starting Observer Demo
    extra_args:
      - SB_CONFIG_DTS_EXTRA_SELECT_CPD200_HINT=y
  samples.bluetooth.observer.atm.two_dev.beacon: &two_dev_config
    sysbuild: true
    tags:
      - two_dev
    extra_args:
      - SB_CONFIG_DTS_EXTRA_SELECT_CPD200_HINT=y
    extra_configs:
      - CONFIG_BT_EXT_ADV=y
      - CONFIG_ATM_BLE_DUMP_HCI_ALL=y
    timeout: 90
    harness: pytest
    harness_config: &two_dev_harness_config
      pytest_root:
        - "pytest/test_observer.py"
      pytest_args:
        - '--expected-adv=1c 02 01 04 03 03 aa fe 14 16 aa fe 10 00 00 7a 65 70 68 79 72 70 72 6f 6a 65 63 74 08'
        - '--expected-rsp=0d 0c 09 54 65 73 74 20 62 65 61 63 6f 6e'
        - "--expected-adv-phy=Pri PHY: LE 1M, Sec PHY: No packets"
        - "--expected-rsp-phy=Pri PHY: LE 1M, Sec PHY: No packets"
  samples.bluetooth.observer.atm.two_dev.atm_beacon:
    <<: *two_dev_config
    harness_config:
      <<: *two_dev_harness_config
      pytest_args:
        - '--expected-adv=1f 02 01 06 03 03 aa fe 0e 16 aa fe 10 00 01 61 74 6d 6f 73 69 63 07 08 08 41 30 30 30 30 63 39'
        - '--expected-rsp=18 17 09 41 54 4d 78 78 78 78 20 4c 6f 77 65 73 74 20 2d 20 50 6f 77 65 72'
        - "--expected-adv-phy=Pri PHY: LE 1M, Sec PHY: No packets"
        - "--expected-rsp-phy=Pri PHY: LE 1M, Sec PHY: No packets"
  samples.bluetooth.observer.atm.two_dev.beacon.spe.flash_xip:
    <<: *two_dev_config
    tags:
      - two_dev
      - flash_xip
      - atm_test_with_spe
    extra_args:
      - SB_ATM_DTS_EXTRA_CPPFLAGS="-DATM_APP_FLASH_XIP"
      - SB_CONFIG_DTS_EXTRA_SELECT_CPD200_HINT=y
      - SB_CONFIG_SPE=y
  samples.bluetooth.observer.atm.two_dev.atm_beacon.sbcn:
    <<: *two_dev_config
    harness_config:
      <<: *two_dev_harness_config
      pytest_args:
        - '--expected-adv=1f 02 01 06 03 03 aa fe 0e 16 aa fe 10 00 01 61 74 6d 6f 73 69 63 07 08 08 41 74 6d 6f 73 69 63'
        - '--expected-rsp=10 0f 09 41 74 6d 6f 73 69 63 20 42 65 61 63 6f 6e'
        - "--expected-adv-phy=Pri PHY: LE 1M, Sec PHY: No packets"
        - "--expected-rsp-phy=Pri PHY: LE 1M, Sec PHY: No packets"
```

## samples/bluetooth/periodic_adv/sample.yaml
```yaml
sample:
  name: Bluetooth Periodic Advertising
common:
  tags:
    - bluetooth
    - role_peripheral
tests:
  samples.bluetooth.periodic_adv.atm:
    sysbuild: true
    harness: console
    harness_config:
      type: one_line
      regex:
        - Starting Periodic Advertising Demo
    extra_args:
      - SB_CONFIG_DTS_EXTRA_SELECT_CPD200_HINT=y
```

## samples/bluetooth/periodic_adv_conn/sample.yaml
```yaml
sample:
  name: Bluetooth Periodic Advertising Connection Procedure
common:
  tags:
    - bluetooth
    - role_peripheral
tests:
  samples.bluetooth.periodic_adv_conn.atm:
    sysbuild: true
    harness: console
    harness_config:
      type: one_line
      regex:
        - Starting Periodic Advertising Demo
    extra_args:
      - SB_CONFIG_DTS_EXTRA_SELECT_CPD200_HINT=y
```

## samples/bluetooth/periodic_adv_rsp/sample.yaml
```yaml
sample:
  name: Bluetooth Periodic Advertising with Responses Advertiser
common:
  tags:
    - bluetooth
    - role_peripheral
tests:
  samples.bluetooth.periodic_adv_rsp.atm:
    sysbuild: true
    harness: console
    harness_config:
      type: one_line
      regex:
        - Starting Periodic Advertising Demo
    extra_args:
      - SB_CONFIG_DTS_EXTRA_SELECT_CPD200_HINT=y
```

## samples/bluetooth/periodic_sync/sample.yaml
```yaml
sample:
  name: Bluetooth Periodic Advertising Synchronization
common:
  tags:
    - bluetooth
    - role_central
  sysbuild: true
  harness: console
  harness_config:
    type: one_line
    regex:
      - "Waiting for periodic advertising"
tests:
  samples.bluetooth.periodic_sync.atm:
    extra_args:
      - SB_CONFIG_DTS_EXTRA_SELECT_CPD200_HINT=y
```

## samples/bluetooth/periodic_sync_conn/sample.yaml
```yaml
sample:
  name: Bluetooth Periodic Advertising Sync Connection Procedure
common:
  tags:
    - bluetooth
    - role_central
tests:
  samples.bluetooth.periodic_sync_conn.atm:
    sysbuild: true
    harness: console
    harness_config:
      type: one_line
      regex:
        - Starting Periodic Advertising with Responses Synchronization Demo
    extra_args:
      - SB_CONFIG_DTS_EXTRA_SELECT_CPD200_HINT=y
```

## samples/bluetooth/peripheral/sample.yaml
```yaml
sample:
  name: Bluetooth Peripheral
  description: Demonstrates the BLE Peripheral role
common:
  tags:
    - bluetooth
    - role_peripheral
tests:
  samples.bluetooth.peripheral.atm:
    sysbuild: true
    harness: console
    harness_config:
      type: one_line
      regex:
        - "Indicate VND attr"
    tags:
      - openair_release
  samples.bluetooth.peripheral.atm.mcuboot:
    sysbuild: true
    harness: console
    harness_config:
      type: one_line
      regex:
        - "Indicate VND attr"
    tags:
      - mcuboot
      - openair_release_mcuboot
    extra_args:
      - SB_CONFIG_BOOTLOADER_MCUBOOT=y
      - SB_CONFIG_BOOT_SIGNATURE_TYPE_ECDSA_P256=y
      - SB_CONFIG_MCUBOOT_MODE_SWAP_USING_OFFSET=y
  samples.bluetooth.peripheral.atm.mcuboot.legacy_scratch:
    sysbuild: true
    harness: console
    harness_config:
      type: one_line
      regex:
        - "Indicate VND attr"
    tags:
      - mcuboot
      - legacy
    extra_args:
      - SB_CONFIG_BOOTLOADER_MCUBOOT=y
      - SB_CONFIG_BOOT_SIGNATURE_TYPE_ECDSA_P256=y
      - SB_CONFIG_MCUBOOT_MODE_SWAP_SCRATCH=y
      - SB_ATM_DTS_EXTRA_CPPFLAGS="-DATM_MCUBOOT_SWAP_WITH_OFFSET=0"
```

## samples/bluetooth/peripheral_accept_list/sample.yaml
```yaml
sample:
  name: Bluetooh Peripheral Accept List
common:
  tags:
    - bluetooth
    - role_peripheral
tests:
  samples.bluetooth.peripheral_accept_list.atm:
    sysbuild: true
    harness: console
    harness_config:
      type: one_line
      regex:
        - Advertising successfully started
```
