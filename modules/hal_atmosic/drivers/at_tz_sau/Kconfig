## modules/hal_atmosic/drivers/pc_ll_cfg/Kconfig
```kconfig
# Copyright (c) 2024-2026 Atmosic
#
# SPDX-License-Identifier: LicenseRef-Atmosic
#

config ATM_PC_LL_CFG
	bool "Atmosic pc_ll_cfg module"
	default y if ATM_BLE
	depends on ATM_PC_CTR

if ATM_PC_LL_CFG

config ATM_ENA_LL_FEAT_PEER_FILT
	bool "Enable Peer address filtering in whitelist and resolving lists"
	default y
	help
	  Enable support for the BLE peer filtering for whitelist
	  and resolvable address lists.  Required for BT scanning, connectivity,
	  scannable advertising and privacy.  Can be disabled if none of these
	  features are required.

config ATM_ENA_LL_FEAT_ENC_PRIV
	bool "When available, enable encryption and privacy"
	default y if (BT_PRIVACY || BT_SMP || BT_HCI_RAW || BT_EXT_ADV)
	depends on ATM_ENA_LL_FEAT_PEER_FILT
	help
	   Enable encryption and privacy support if used by
	   the BT host stack or application.

config ATM_ENA_LL_FEAT_PC
	bool "When available, enable LL power control feature"
	default n if ATMWSTK_PD50
	default y

config ATM_ENA_LL_FEAT_CENTRAL
	bool "When available, enable as capable of being a central"
	default y if BT_CENTRAL
	depends on !ATMWSTK_PD50

config ATM_ENA_LL_FEAT_PERIPHERAL
	bool "When available, enable as capable of being a peripheral"
	default y if (BT_PERIPHERAL || DTM_2WIRE)
	default y if (BT_BROADCASTER && ATM_LCROM_IFACE)
	default y if ATM_ENA_LL_FEAT_PAWR
	depends on ATM_ENA_LL_FEAT_BROADCASTER

config ATM_ENA_LL_FEAT_BROADCASTER
	bool "When available, enable as capable of being a broadcaster"
	default y if (BT_BROADCASTER || DTM_2WIRE)

config ATM_ENA_LL_FEAT_OBSERVER
	bool "When available, enable as capable of being an observer"
	default n if ATMWSTK_PD50
	default y if BT_OBSERVER

config ATM_ENA_LL_FEAT_CS
	bool "When available, enable LL channel sounding feature"
	default n if (ATMWSTK_PD50 || ATMWSTK_CPD200)
	default y if (BT_CHANNEL_SOUNDING || BT_HCI_RAW)

config ATM_ENA_LL_FEAT_CS_TEST
	bool "When available, enable LL channel sounding test feature"
	default y if BT_HCI_RAW
	depends on ATM_ENA_LL_FEAT_CS

config ATM_ENA_LL_FEAT_ISO
	bool "When available, enable LL ISO feature"
	default y if ATMWSTK_FULL

config ATM_ENA_LL_FEAT_BIS
	bool "When available, enable LL BIS (Broadcast Isochronous Stream) feature"
	depends on ATM_ENA_LL_FEAT_ISO
	default y if ATMWSTK_FULL

config ATM_ENA_LL_FEAT_CIS
	bool "When available, enable LL CIS (Connected Isochronous Stream) feature"
	depends on ATM_ENA_LL_FEAT_ISO
	default y if ATMWSTK_FULL

config ATM_ENA_LL_FEAT_PAWR
	bool "When available, enable LL PAWR (Periodic Advertising with Responses) feature"
	default n if ATMWSTK_PD50
	default y

config ATM_ENA_LL_FEAT_EXT
	bool "When available, enable LL EXTFEAT (Extended Features)"
	default y if ATMWSTK_FULL

config ATM_ENA_LL_FEAT_EXT_ADV
	bool "When available, enable LL Extended Advertising Features"
	default y if (BT_HCI_RAW || BT_EXT_ADV)

config ATM_ENA_LL_FEAT_DBAF
	bool "When available, enable LL DBAF (Decision Based Advertising Filtering) feature"
	default y if ATMWSTK_FULL

config ATM_ENA_LL_FEAT_MONADV
	bool "When available, enable LL MONADV (Monitored Advertisers) feature"
	default y if ATMWSTK_FULL

config ATM_ENA_LL_FEAT_FSU
	bool "When available, enable LL FSU (Frame Space Update) feature"
	default y if ATMWSTK_FULL

config ATM_BLE_CS_NUM_ANTENNAS
	int "Number of BLE CS antennas supported"
	range 1 4
	default 2 if $(dt_nodelabel_enabled,atm_antenna)
	default 1
	depends on ATM_ENA_LL_FEAT_CS

config ATM_LL_ECC_SUPPORT
	bool "Support HCI ECC commands in the LL"
	default y if BT_HCI_RAW || (BT_SMP && !BT_ECC)

config ATM_DTM_SUPPORT
	bool "Support LE directed test mode"
	default y if (BT_HCI_RAW || DTM_2WIRE)
	depends on !ATM_LCROM_IFACE || (ATM_LCROM_IFACE && (ATM_ENA_LL_FEAT_PERIPHERAL || ATM_ENA_LL_FEAT_CENTRAL))

endif # ATM_PC_LL_CFG
```

## modules/hal_atmosic/drivers/pc_vs_cmd/Kconfig
```kconfig
# Copyright (c) 2024-2026 Atmosic
#
# SPDX-License-Identifier: LicenseRef-Atmosic
#

config PC_VS_CMD
	bool "PacketCraft Vendor command module"
	default y if ATM_VENDOR
	depends on ATM_PC_CTR
```

## modules/hal_atmosic/drivers/radio_cal/Kconfig
```kconfig
# Copyright (c) 2025-2026 Atmosic
#
# SPDX-License-Identifier: LicenseRef-Atmosic
#

config ATM_RADIO_CAL
	bool "Atmosic Radio Calibration module"
	depends on ATM_HW_CFG && ATM_RADIO_HAL_MGR
	default y

if ATM_RADIO_CAL

config ATM_RADIO_CAL_REPEAT_MS
	int "Number of milliseconds between calibrations. 0 to disable"
	default 0

config ATM_RADIO_CAL_DECISION
	bool "Decide when to apply calibration on a per-packet basis"
	depends on ATM_RADIO_CAL_REPEAT_MS = 0
	default y

config ATM_RADIO_CAL_DEMAND
	bool "Enable on-demand RX DC offset calibration request API"
	depends on ATM_RADIO_CAL_REPEAT_MS = 0

endif
```

## modules/hal_atmosic/drivers/radio_hal_ble/Kconfig
```kconfig
# Copyright (c) 2024-2026 Atmosic
#
# SPDX-License-Identifier: LicenseRef-Atmosic
#

config ATM_RADIO_HAL_BLE
	bool "Atmosic radio_hal_ble module"
	default y if ATM_BLE
	depends on ATM_ATLC

config ATM_LDO_MODE
	bool "Atmosic LDO MODE Enable"
	default y if ATM_ENA_LL_FEAT_CS

if ATM_RADIO_HAL_BLE

config ATM_RADIO_HAL_BLE_LOG_STATISTICS_MS
	int "Log BLE packet statistics at this frequency. 0 to disable"
	default 0

endif
```

## modules/hal_atmosic/drivers/radio_hal_ble_cte/Kconfig
```kconfig
# Copyright (c) 2024-2026 Atmosic
#
# SPDX-License-Identifier: LicenseRef-Atmosic
#

config ATM_RADIO_HAL_BLE_CTE
	bool "Atmosic radio_hal_ble_cte module"
	depends on ATM_ATLC
	default y if ATM_BLE
```

## modules/hal_atmosic/drivers/radio_hal_common/Kconfig
```kconfig
# Copyright (c) 2024-2026 Atmosic
#
# SPDX-License-Identifier: LicenseRef-Atmosic
#

config ATM_RADIO_HAL_COMMON
	bool "Atmosic radio_hal_common module"
	default y
	depends on ATM_ATLC || DTOP_BYPASS
```

## modules/hal_atmosic/drivers/radio_hal_frc/Kconfig
```kconfig
# Copyright (c) 2024-2026 Atmosic
#
# SPDX-License-Identifier: LicenseRef-Atmosic
#

config ATM_RADIO_HAL_FRC
	bool "Atmosic radio_hal_frc module"
	default y if ATM_ATLC
```

## modules/hal_atmosic/drivers/radio_hal_log/Kconfig
```kconfig
# Copyright (c) 2024-2026 Atmosic
#
# SPDX-License-Identifier: LicenseRef-Atmosic
#

config ATM_RADIO_HAL_LOG
	bool "Atmosic radio_hal_log module"
	default y if ATM_ATLC || DTOP_BYPASS
```

## modules/hal_atmosic/drivers/radio_hal_mgr/Kconfig
```kconfig
# Copyright (c) 2024-2026 Atmosic
#
# SPDX-License-Identifier: LicenseRef-Atmosic
#

config ATM_RADIO_HAL_MGR
	bool "Atmosic combo BLE/15.4 radio manager"
	default y if ATM_BLE && IEEE802154_ATM34
	default y if ATM_BLE && SOC_FLASH_ATM
	default y if IEEE802154_ATM34 && SOC_FLASH_ATM
	depends on ATM_ATLC
```

## modules/hal_atmosic/drivers/radio_hal_prof/Kconfig
```kconfig
# Copyright (c) 2024-2026 Atmosic
#
# SPDX-License-Identifier: LicenseRef-Atmosic
#

config ATM_RADIO_HAL_PROF
	bool "Atmosic radio_hal_prof module"
	default y if ATM_ATLC || DTOP_BYPASS
```

## modules/hal_atmosic/drivers/radio_req_ble/Kconfig
```kconfig
# Copyright (c) 2024-2026 Atmosic
#
# SPDX-License-Identifier: LicenseRef-Atmosic
#

config ATM_RADIO_REQ_BLE
	bool "Atmosic radio_req_ble module"
	default y if ATM_BLE
	depends on ATM_ATLC
```
