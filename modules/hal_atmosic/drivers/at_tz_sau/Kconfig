## modules/hal_atmosic/drivers/at_tz_sau/Kconfig
```kconfig
# Copyright (c) 2024-2026 Atmosic
#
# SPDX-License-Identifier: LicenseRef-Atmosic
#

config ATM_TZ_SAU
	bool "Atmosic TrustZone Security Attribution Unit  module"
	default y if TRUSTED_EXECUTION_SECURE && !MCUBOOT
	depends on DT_HAS_ATMOSIC_SEC_TZ_ENABLED
```

## modules/hal_atmosic/drivers/atm_aes/Kconfig
```kconfig
# Copyright (c) 2024-2026 Atmosic
#
# SPDX-License-Identifier: LicenseRef-Atmosic
#

config ATM_AES
	bool "Atmosic AES module"
	default y if ATM_BLE || ATM_AES_HW

config ATM_AES_HW
	bool "PSA driver - hardware accelerator for AES"
	default y
	depends on $(dt_nodelabel_enabled,aes)
	depends on PSA_WANT_KEY_TYPE_AES
	depends on !USERSPACE

config ATM_AES_SUPPORTS_ECB_128
	bool

config ATM_AES_SUPPORTS_ECB_256
	bool

config ATM_AES_SUPPORTS_CTR_128
	bool

config ATM_AES_SUPPORTS_DECRYPT
	bool

config ATM_AES_ATM_CORE
	bool
	depends on $(dt_nodelabel_enabled,aes)
	help
	  Includes HAL driver for AES hardware engine.

choice ATM_AES_IMPL
	prompt "Atmosic AES default implementation"
	default ATM_AES_DEFAULT if ATM_AES
	default ATM_AES_NONE if !ATM_AES

config ATM_AES_DEFAULT
	bool "Atmosic AES default implementation"
	select ATM_AES_SUPPORTS_ECB_128
	select ATM_AES_SUPPORTS_ECB_256
	select ATM_AES_SUPPORTS_CTR_128
	select ATM_AES_SUPPORTS_DECRYPT
	select ATM_AES_ATM_CORE

config ATM_AES_IMPL_ECB_CTR_128_NO_DECRYPT
	bool "Atmosic AES 128-bit ECB and CTR encrypt only"
	select ATM_AES_SUPPORTS_ECB_128
	select ATM_AES_SUPPORTS_CTR_128
	select ATM_AES_ATM_CORE

config ATM_AES_NONE
	bool "No Atmosic AES implementation"

endchoice

if ATM_AES_ATM_CORE

# FIXME: move to device tree
config ATM_AES_CAN_REVERSE_BYTES
	bool "Atmosic AES can reverse byte order"
	default n if SOC_SERIES_ATM33
	default y

endif # ATM_AES_ATM_CORE

if ATM_AES_HW

config ATM_AES_HW_FALLBACK_ON_EXHAUSTION
	bool "Fall back to software when AES HW is busy"
	default y
	help
	  When the Atmosic AES hardware cannot accept a new operation
	  -- because it is already in use by another caller (e.g. the BLE
	  controller) and the HW mutex acquisition timed out -- transparently
	  route the request to the Mbed TLS software implementation instead
	  of returning PSA_ERROR_INSUFFICIENT_MEMORY. Disable to surface the
	  error to the caller (useful for diagnosing contention).

endif # ATM_AES_HW
```

## modules/hal_atmosic/drivers/atm_sha2/Kconfig
```kconfig
# Copyright (c) 2024-2026 Atmosic
#
# SPDX-License-Identifier: LicenseRef-Atmosic
#

config ATM_SHA2
	bool "Atmosic SHA2 module"
	default y if ATM_SHA2_HW
	depends on $(dt_nodelabel_enabled,sha2)

config ATM_SHA2_HW
	bool "Hardware accelerator for SHA256 hash"
	depends on $(dt_nodelabel_enabled,sha2)
	depends on PSA_WANT_ALG_SHA_256
	depends on !USERSPACE

if ATM_SHA2

config ATM_SHA2_KEY_SIDELOAD
	bool "Enable key sideload for HMAC key"
	depends on TRUSTED_EXECUTION_SECURE
	depends on ATM_KEY_SIDELOAD

choice ATM_SHA2_API
    prompt "ATM SHA2 API mode"
    default ATM_SHA2_API_SINGLE
    help
      Select whether to use single or multiple context API.

config ATM_SHA2_API_SINGLE
    bool "Single context mode"

config ATM_SHA2_API_MULTI
    bool "Multiple context mode"
endchoice

endif # ATM_SHA2

if ATM_SHA2_HW

choice ATM_SHA2_HW_DATA_PATH
	prompt "ATM SHA-2 HW data path"
	default ATM_SHA2_HW_DATA_PATH_PIO
	help
	  Select how the PSA wrapper feeds input bytes to the Atmosic
	  SHA-2 engine: via DMA (DMA channel 0) or via CPU FIFO writes
	  (PIO).

config ATM_SHA2_HW_DATA_PATH_DMA
	bool "DMA"

config ATM_SHA2_HW_DATA_PATH_PIO
	bool "PIO"
endchoice

config ATM_SHA2_HW_VERIFY_WITH_SW
	bool "Verify HW SHA-256 results against software"
	depends on ATM_SHA2_API_SINGLE
	help
	  For every hash operation dispatched to the SHA-2 hardware,
	  run a parallel software SHA-256 through the Mbed TLS PSA
	  fallback and compare the two digests at finish. On mismatch,
	  log the operation pointer and both digests. The wrapper still
	  returns the HW digest so downstream code observes the same
	  bytes it would without shadowing. Useful for diagnosing
	  HW-vs-SW divergences; leave disabled in normal builds because
	  of the significant per-op cost.

config ATM_SHA2_HW_MAX_CONTEXTS
	int "Maximum number of concurrent SHA-256 HW contexts"
	depends on ATM_SHA2_API_MULTI
	default 4
	help
	  Size of the static pool of Atmosic SHA-2 hardware contexts used by
	  the PSA driver wrapper in multi-context mode. Each entry holds one
	  in-flight SHA-256 operation's intermediate state. Operations beyond
	  this limit either fall back to the software implementation or fail,
	  depending on ATM_SHA2_HW_FALLBACK_ON_EXHAUSTION.

config ATM_SHA2_HW_FALLBACK_ON_EXHAUSTION
	bool "Fall back to software when SHA-256 HW resources are exhausted"
	default y
	help
	  When the Atmosic SHA-2 hardware cannot accept a new in-flight
	  operation -- because the multi-context pool is full
	  (ATM_SHA2_HW_MAX_CONTEXTS) or, in single-context mode, because the
	  HW is already in use by another operation -- transparently route
	  the new operation to the Mbed TLS software implementation instead
	  of returning PSA_ERROR_INSUFFICIENT_MEMORY. Disable to surface the
	  error to the caller (useful for diagnosing under-provisioned pools).

module = ATM_SHA2_PSA
module-str = atm_sha2_psa
source "subsys/logging/Kconfig.template.log_config"

endif # ATM_SHA2_HW
```

## modules/hal_atmosic/drivers/atm_spe_sec_fault_storage/Kconfig
```kconfig
# Copyright (c) 2024-2026 Atmosic
#
# SPDX-License-Identifier: LicenseRef-Atmosic
#

config ATM_SPE_FAULT_STORAGE
        bool "Atmosic SPE Secure Fault Storage module"
	default y if DT_HAS_ATMOSIC_SPE_FAULT_STORAGE_ENABLED
	depends on !MCUBOOT
```

## modules/hal_atmosic/drivers/batt_model/Kconfig
```kconfig
# Copyright (c) 2024-2026 Atmosic
#
# SPDX-License-Identifier: LicenseRef-Atmosic
#

choice BATT_MODEL_SELECTION
	prompt "Battery Model Selection"
	optional

config BATT_MODEL_COIN
	bool "Coin Cell Battery support"

config BATT_MODEL_DRY
	bool "Dry Battery support"

config BATT_MODEL_HSC_LIION
	bool "HSC/Li-ion Battery Model Driver"
	help
	  Battery model driver for HSC (Hybrid Super Capacitor) and Li-ion batteries
	  with energy harvesting support. The driver uses device tree batt-type property
	  to determine the appropriate battery model at compile time.

endchoice

config BATT_MODEL
	bool
	depends on ADC
	default y if BATT_MODEL_COIN || BATT_MODEL_DRY || BATT_MODEL_HSC_LIION

if BATT_MODEL

module = BATT_MODEL
module-str = Atmosic Battery Model
source "subsys/logging/Kconfig.template.log_config"

config BATT_MODEL_ADC_32_BITS
	bool
	default y if ADC_ATMx3 || ADC_ATM34

endif # BATT_MODEL
```

## modules/hal_atmosic/drivers/batt_model_coin/Kconfig
```kconfig
# Copyright (c) 2024-2026 Atmosic
#
# SPDX-License-Identifier: LicenseRef-Atmosic
#

config BATT_MODEL_COIN
	bool "Coin Cell Battery support"
	depends on ADC
	select BATT_MODEL
```

## modules/hal_atmosic/drivers/batt_model_dry/Kconfig
```kconfig
# Copyright (c) 2025-2026 Atmosic
#
# SPDX-License-Identifier: LicenseRef-Atmosic
#

config BATT_MODEL_DRY
	bool "Dry Battery support"
	depends on ADC
	select BATT_MODEL
```

## modules/hal_atmosic/drivers/ccbm/Kconfig
```kconfig
# Coin Cell Battery Management (CCBM) Driver
#
# Copyright (C) Atmosic 2026
# SPDX-License-Identifier: Apache-2.0

menuconfig ATM_CCBM
	bool "Coin Cell Battery Management (CCBM) Driver"
	depends on SOC_FAMILY_ATM
	select ADC
	select ATM_RADIO_HAL_MGR
	help
	  Enable the Coin Cell Battery Management driver for generating
	  high current through LNA attenuation and PA LDO settings.
	  This driver measures battery voltage before and during load
	  to assess coin cell battery health.

	  IMPORTANT: This driver only works with non-rechargeable coin cell
	  batteries (BATT_TYPE_NON_RECHARGEABLE). A compile-time assertion
	  will fail if used with other battery types.

if ATM_CCBM

config ATM_CCBM_AUTO_INIT
	bool "Auto-initialize CCBM driver"
	default y
	help
	  Automatically initialize the CCBM driver during system
	  initialization. If disabled, the application must call
	  ccbm_init() before using the driver.

module = CCBM
module-str = Coin Cell Battery Management
source "subsys/logging/Kconfig.template.log_config"

endif # ATM_CCBM
```

## modules/hal_atmosic/drivers/dma/Kconfig
```kconfig
# Copyright (c) 2024-2026 Atmosic
#
# SPDX-License-Identifier: LicenseRef-Atmosic
#

config ATM_DMA
	bool "Atmosic DMA module"
	depends on SOC_FAMILY_ATM
	default y if TRUSTED_EXECUTION_NONSECURE || MCUBOOT || ATM_NO_SPE

if ATM_DMA

config ATM_DMA_MINIMAL
	bool "Minimal DMA driver"
	default y if MCUBOOT
	default y if !BT && !ATM_ATLC && !ENTROPY_ATM_TRNG && !I2S_ATM && !PWM_ATM_FIFO

config ATM_DMA_FIFO_RX
	bool "Enable RX DMA"

config ATM_DMA_RELOC_SRAM
	bool
	help
	  Relocate performance and power critical functions to SRAM, while
	  still satisfying early init requirements.

config ATM_DMA_USE_FOR_MEMCPY
	bool
	default y
	depends on !USERSPACE
	help
	  Use DMA engine for libc memcpy().

config ATM_DMA_USE_FOR_MEMSET
	bool
	default y
	depends on !USERSPACE
	help
	  Use DMA engine for libc memset().

endif # ATM_DMA
```

## modules/hal_atmosic/drivers/eui/Kconfig
```kconfig
# Copyright (c) 2024-2026 Atmosic
#
# SPDX-License-Identifier: LicenseRef-Atmosic
#

config ATM_EUI
	bool "Atmosic EUI module"
	select SETTINGS

if ATM_EUI

config ATM_EUI_ALLOW_RANDOM
	bool "Permit eui driver to initialize using a random value"

config ATM_EUI48_ALLOW_BUILTIN
	bool "Allow eui driver to return no value."

endif # ATM_EUI
```

## modules/hal_atmosic/drivers/lpc/Kconfig
```kconfig
# Copyright (c) 2024-2026 Atmosic
#
# SPDX-License-Identifier: LicenseRef-Atmosic
#

config ATM_LPC
	bool "Atmosic Low Power Clock module"
	default y if ATM_BLE_DRIVER_SLEEP
	depends on !ATM_FORCE_LPC_RCOS
```

## modules/hal_atmosic/drivers/nv_mem_prot/Kconfig
```kconfig
# Copyright (c) 2025-2026 Atmosic
#
# SPDX-License-Identifier: LicenseRef-Atmosic
#

config ATM_NV_MEM_ROM_PROT
	bool "Atmosic ROM protection"
	depends on DT_HAS_ATMOSIC_SEC_NV_MEM_ROM_PROT_ENABLED
	default y
	help
	  This option enables the Atmosic ROM protection
	  driver

config ATM_NV_MEM_RRAM_PROT
	bool "Atmosic RRAM protection"
	depends on DT_HAS_ATMOSIC_SEC_NV_MEM_RRAM_PROT_ENABLED
	default y
	help
	  This option enables the Atmosic RRAM read/write
	  protection driver.

config ATM_NV_MEM_FLASH_PROT
	bool "Atmosic FLASH protection"
	depends on DT_HAS_ATMOSIC_SEC_NV_MEM_FLASH_PROT_ENABLED
	help
	  This option enables the Atmosic Flash read/write
	  protection driver.
```

## modules/hal_atmosic/drivers/pc_ctr/Kconfig
```kconfig
# Copyright (c) 2024-2026 Atmosic
#
# SPDX-License-Identifier: LicenseRef-Atmosic
#

config ATM_PC_CTR
	bool "Atmosic pc_ctr module"
	default y if ATM_BLE
	select ATM_UECC if ATM_LL_ECC_SUPPORT
	select ATM_UECC_VLI_API if ATM_LL_ECC_SUPPORT
	select ATM_UECC_SUPPORTS_SECP160R1 if ATM_LL_ECC_SUPPORT
	select ATM_UECC_SUPPORTS_SECP192R1 if ATM_LL_ECC_SUPPORT
	select ATM_UECC_SUPPORTS_SECP256R1 if ATM_LL_ECC_SUPPORT
	select ATM_UECC_SUPPORTS_SECP256K1 if ATM_LL_ECC_SUPPORT
	depends on ATM_ATLC

if ATM_PC_CTR
config ATM_MAX_ADV_DATA_LEN
	int "Override max adv data length"
	default 0

config ATM_MAX_SCAN_DATA_LEN
	int "Override max scan data length"
	default 0

config ATM_CLKPPM
	int "Override clkppm"
	default 500 if ATM_LPC_RCOS
	default 0

config ATM_MAX_ADV_SET
	int "Override max adv set"
	default 0

config ATM_PC_HIGH_THD
	int "Override power control high threshold"
	default 0

config ATM_PC_LOW_THD
	int "Override power control low threshold"
	default 0

config ATM_LL_HEAP_SIZE
	int "LL heap size"
	default 30000 if ATM_ENA_LL_FEAT_CS && ATMWSTK_PD50
	default 24000 if ATMWSTK_PD50
	default 80572

config ATM_ENA_DBG_PC_CTR_MEM_USAGE
	bool "Show pc_ctr memory usage information"

config ATM_PC_FSU_ACL_IFS_MIN
	int "Override minimum value of frame space update ACL IFS"
	default 0

config ATM_PC_FSU_CIS_IFS_MIN
	int "Override minimum value of frame space update CIS IFS"
	default 0

config ATM_DTM_PACKET_INTERVAL
	int "Override packet interval in DTM mode (slots, 0 = no override, 1 slot = 625us)"
	default 0

config ATM_ENA_BLE_CS_MANDATORY_TIMING_ONLY
	bool "Use channel sounding mandatory timing only"

config ATM_ENA_SCAN_RANDOM_BACKOFF
	bool "Enable scan random backoff"
	default y

config ATM_ENA_CONN_PARAM_REQ_PROC
	bool "Enable connection parameters request procedure"
	default y

config ATM_ENA_BLE_CS_DBG_VECTOR
	bool "Enable channel sounding debug vector"

config ATM_ENA_BLE_CS_TEST_UNSYNC_MODE
	bool "Enable channel sounding test unsync mode"

config ATM_MAX_ACL_TXBUF_SIZE
	int "Override max value of ACL Tx buffer size"
	default BT_BUF_ACL_TX_SIZE if BT_RAS
	default 0

config ATM_BLE_CS_SYNC_PHY_2M_ENABLE
	bool "Enable 2M PHY for Channel Sounding Sync exchanges"
	default y

config ATM_BLE_CS_SYNC_PHY_2M_BT2_ENABLE
	bool "Enable 2M BT 2.0 PHY for Channel Sounding Sync exchanges"
	default y

config ATM_BLE_CS_NUM_CONFIG_SUP
	int "Number of Channel Sounding configurations supported"
	default 1

config ATM_LL_MAX_CONN
	int "Link layer max connections"
	default BT_MAX_CONN if BT_CONN
	default 0
	help
	  Maximum number of connections supported by the link layer.

config ATM_ENA_LL_VS_CMD
	bool "Enable LL basic VS command support"

config ATM_BT_VER
	int "Override BT version"
	default 0

config ATM_ENA_SW_LA
	bool "Enable software logic analyzer"
	help
	  Enable software logic analyzer trace recording for the link layer
	  controller.

config ATM_SW_LA_TRACE_MASK
	hex "Software logic analyzer trace mask"
	default 0x3db
	range 0x0 0xffffffff
	depends on ATM_ENA_SW_LA
	help
	  Runtime trace mask passed to PalSwDbgInit(). See pal_sw_dbg.h for
	  the available trace bit definitions.

config ATM_SW_LA_ENTRY_NUM
	int "Software logic analyzer entry count"
	default 1024
	range 1 65535
	depends on ATM_ENA_SW_LA
	help
	  Number of entries in the caller-owned software logic analyzer trace
	  buffer.

config ATM_ENA_SW_LA_DUMP_ON_HARDFAULT
	bool "Dump software logic analyzer trace on hard fault"
	default y
	depends on ATM_ENA_SW_LA
	help
	  Dump the software logic analyzer trace when a CPU exception is
	  reported by the Zephyr fatal error handler.

config ATM_ENA_LL_PHY_2M
	bool "When available, enable 2M PHY support"
	default y
	help
	  Enable 2M PHY support in the link layer. When disabled,
	  phy2mSup is forced to false regardless of other feature flags.

config ATM_BLE_FILTER_PEER_SUBRATE_EVT
	bool "Filter LE Subrate Change Event for peer-initiated subrate changes"
	depends on ATM_ENA_LL_FEAT_ECU
	help
	  When enabled, filters LE Subrate Change Events that are initiated
	  by the peer device. Self-initiated subrate change events will still
	  be reported.

endif # ATM_PC_CTR
```

## modules/hal_atmosic/drivers/pc_ctr_sleep/Kconfig
```kconfig
# Copyright (c) 2024-2026 Atmosic
#
# SPDX-License-Identifier: LicenseRef-Atmosic
#

config ATM_PC_CTR_SLEEP
	bool "Atmosic pc_ctr_sleep module"
	default y
	depends on ATM_ATLC
```
