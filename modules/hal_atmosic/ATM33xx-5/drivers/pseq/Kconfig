## modules/hal_atmosic/ATM33xx-5/drivers/pseq/Kconfig
```kconfig
# Copyright (c) 2024 Atmosic
#
# SPDX-License-Identifier: Apache-2.0

config ATM_PSEQ
	bool "Atmosic Power Sequencer module"
	default y
```

## modules/hal_atmosic/ATM33xx-5/drivers/reset/Kconfig
```kconfig
# Copyright (c) 2024 Atmosic
#
# SPDX-License-Identifier: Apache-2.0

config ATM_RESET
	bool "Atmosic Reset module"
	default y if ADC
	default y if BT
	default y if ENTROPY_ATM_TRNG
	default y if PM
```

## modules/hal_atmosic/ATM33xx-5/drivers/rf/Kconfig
```kconfig
# Copyright (c) 2024-2025 Atmosic
#
# SPDX-License-Identifier: Apache-2.0

config ATM_RF
	bool "Atmosic RF module"
	default y if ATM_RWLC
	default y if ENTROPY_ATM_TRNG

config MAX_TX_PWR
	int "Maximum TX power"
	depends on ATM_RF
	range -20 10
	default 0
	help
	    Configure the maximum transmit power (dBm) for both advertising and
	    connection.

config FORCE_TX_PWR
	int "Force TX power"
	default 255
	help
	    This setting forces a fixed transmit power. It is the highest-priority
		option and should be used for RF test purposes only.
	    The value 255 is reserved and indicates that forced TX power is disabled.
	    Use values in the range -20 to 10 (dBm) to enable forced TX power.
```

## modules/hal_atmosic/ATM33xx-5/drivers/rram_rom_prot/Kconfig
```kconfig
# Copyright (c) 2024 Atmosic
#
# SPDX-License-Identifier: Apache-2.0

config ATM_RRAM_ROM_PROT
	bool "Atmosic RRAM ROM Protect module"
	default y if TRUSTED_EXECUTION_SECURE
	default y if SOC_FLASH_ATM_RRAM
```

## modules/hal_atmosic/ATM33xx-5/drivers/sec_hw_cfg/Kconfig
```kconfig
# Copyright (c) 2024 Atmosic
#
# SPDX-License-Identifier: Apache-2.0

config ATM_SEC_HW_CFG
	bool "Atmosic Secure Hardware Configuration module"
	default y if TRUSTED_EXECUTION_SECURE && !BOOTLOADER_MCUBOOT
```

## modules/hal_atmosic/ATM33xx-5/drivers/sec_jrnl/Kconfig
```kconfig
# Copyright (c) 2024-2025 Atmosic
#
# SPDX-License-Identifier: Apache-2.0

config ATM_SEC_JRNL_PRESENT
	bool "Atmosic platform has access to sec_jrnl functions"
	default y if TRUSTED_EXECUTION_NONSECURE || TRUSTED_EXECUTION_SECURE

config ATM_SEC_JRNL
	bool "Atmosic sec_jrnl module"
	default y if TRUSTED_EXECUTION_SECURE
```

## modules/hal_atmosic/ATM33xx-5/drivers/spi/Kconfig
```kconfig
# Copyright (c) 2024-2025 Atmosic
#
# SPDX-License-Identifier: Apache-2.0

config ATM_SPI
	bool "Atmosic SPI module"
	default y if (TRUSTED_EXECUTION_NONSECURE || ATM_NO_SPE) && (SOC_FLASH_ATM || BT || ENTROPY_ATM_TRNG || PM || ADC || ATM_PMU)
	default y if TRUSTED_EXECUTION_SECURE && !BOOTLOADER_MCUBOOT
```

## modules/hal_atmosic/ATM33xx-5/src/Kconfig
```kconfig
# Copyright (c) 2025 Atmosic
#
# SPDX-License-Identifier: Apache-2.0

config POWER_OFF_SBRK
	bool "Power off unused SRAM during retention"
	default y if NEWLIB_LIBC
	depends on PM

config ATM_SOCOFF_MAX_DURATION_SEC
	int "Maximum SOC off duration in seconds"
	depends on PM
	default 0
	help
	  Maximum duration to remain in SOC off state, in seconds. When set to a non-zero
	  value, this acts as a cap on the SOC off duration regardless of the requested
	  idle time. This is useful for periodically waking up to service the PMU watchdog
	  when using non-timer based wakeup sources (LPCOMP, GPIO). When set to 0 (default),
	  no maximum duration limit is applied.
```

## modules/hal_atmosic/ATM34xx/Kconfig
```kconfig
# Copyright (c) 2024-2025 Atmosic
#
# SPDX-License-Identifier: Apache-2.0

if SOC_SERIES_ATM34

rsource "drivers/Kconfig"
rsource "drivers/ble/Kconfig"
rsource "lib/Kconfig"
rsource "src/Kconfig"

if TRUSTED_EXECUTION_SECURE

config SOC_RESET_HOOK
	# if bootloader is set and the SPE, leave bp_init to MCUBOOT
	default n if BOOTLOADER_MCUBOOT && ARM_FIRMWARE_HAS_SECURE_ENTRY_FUNCS
	# if bootloader is set and the ATM_NO_TZ, leave bp_init to MCUBOOT
	default n if BOOTLOADER_MCUBOOT && ATM_NO_TZ
	default y

config ATM_HAL_ENABLE_NSC_IN_RAM
	bool
	depends on $(dt_nodelabel_bool_prop,sec_tz,allow_nsc_in_ram)
	help
	  Support non-secure callable API relocation to RAM.  This includes
	  moving performance critical HAL functions to RAM.

endif # TRUSTED_EXECUTION_SECURE

endif # SOC_SERIES_ATM34
```

## modules/hal_atmosic/ATM34xx/drivers/pc_ctr/Kconfig
```kconfig
# Copyright (c) 2024-2025 Atmosic
#
# SPDX-License-Identifier: Apache-2.0

config ATM_PC_CTR
	bool "Atmosic pc_ctr module"
	default y if ATM_BLE

if ATM_PC_CTR
config ATM_MAX_ADV_DATA_LEN
	int "Override max adv data length"
	default 0

config ATM_MAX_SCAN_DATA_LEN
	int "Override max scan data length"
	default 0

config ATM_CLKPPM
	int "Override clkppm"
	default 0

config ATM_MAX_ADV_SET
	int "Override max adv set"
	default 0

config ATM_PC_HIGH_THD
	int "Override power control high threshold"
	default 0

config ATM_PC_LOW_THD
	int "Override power control low threshold"
	default 0

config ATM_LL_HEAP_SIZE
	int "Override LL heap size"
	default 0

config ATM_ENA_DBG_PC_CTR_MEM_USAGE
	bool "Show pc_ctr memory usage information"

config ATM_PC_FSU_ACL_IFS_MIN
	int "Override minimum value of frame space update ACL IFS"
	default 0

config ATM_PC_FSU_CIS_IFS_MIN
	int "Override minimum value of frame space update CIS IFS"
	default 0

config ATM_ENA_BLE_CS_MANDATORY_TIMING_ONLY
	bool "Use channel sounding mandatory timing only"

config ATM_ENA_SCAN_RANDOM_BACKOFF
	bool "Enable scan random backoff"
	default y
endif # ATM_PC_CTR
```

## modules/hal_atmosic/ATM34xx/drivers/pc_ll_cfg/Kconfig
```kconfig
# Copyright (c) 2024-2025 Atmosic
#
# SPDX-License-Identifier: Apache-2.0

config ATM_PC_LL_CFG
	bool "Atmosic pc_ll_cfg module"
	default y if ATM_BLE

if ATM_PC_LL_CFG

config ATM_ENA_LL_FEAT_PC
	bool "When available, enable LL power control feature"
	default n if SOC_SERIES_ATM34 && ATMWSTK_PD50
	default y

config ATM_ENA_LL_FEAT_CS
	bool "When available, enable LL channel sounding feature"
	default n if SOC_SERIES_ATM34 && ATMWSTK_PD50
	default y

config ATM_ENA_LL_FEAT_ISO
	bool "When available, enable LL ISO feature"
	default y if SOC_SERIES_ATM34 && ATMWSTK_FULL
	default n

endif # ATM_PC_LL_CFG
```

## modules/hal_atmosic/ATM34xx/drivers/pc_vs_cmd/Kconfig
```kconfig
# Copyright (c) 2024 Atmosic
#
# SPDX-License-Identifier: Apache-2.0

config PC_VS_CMD
	bool "PacketCraft Vendor command module"
	depends on ATM_BLE
	default y if ATM_VENDOR
```

## modules/hal_atmosic/ATM34xx/drivers/pmu/Kconfig
```kconfig
# Copyright (c) 2024-2025 Atmosic
#
# SPDX-License-Identifier: Apache-2.0

config ATM_PMU
	bool "Atmosic Power Management Unit module"
	default y if ATM_ATLC
	default y if DTOP_BYPASS
	default y if ENTROPY_ATM_TRNG
	default y if PM
	default y if ATM_BROWNOUT
	default y if ATM_RESET

config PMU_WDOG_TIMEOUT
	int "PMU watchdog timeout"
	default 0
	help
	   A value of 0 implies 1 sec.
	   A value of 1 implies 32 sec.
```

## modules/hal_atmosic/ATM34xx/drivers/pseq/Kconfig
```kconfig
# Copyright (c) 2024-2025 Atmosic
#
# SPDX-License-Identifier: Apache-2.0

config ATM_PSEQ
	bool "Atmosic Power Sequencer module"
	default y
```

## modules/hal_atmosic/ATM34xx/drivers/radio_hal_154/Kconfig
```kconfig
# Copyright (c) 2024 Atmosic
#
# SPDX-License-Identifier: Apache-2.0

config ATM_RADIO_HAL_154
	bool "Atmosic 15.4 Radio module"
	default y if IEEE802154_ATM34
```

## modules/hal_atmosic/ATM34xx/drivers/radio_hal_ble/Kconfig
```kconfig
# Copyright (c) 2024 Atmosic
#
# SPDX-License-Identifier: Apache-2.0

config ATM_RADIO_HAL_BLE
	bool "Atmosic radio_hal_ble module"
	default y if ATM_BLE

config ATM_LDO_MODE
	bool "Atmosic LDO MODE Enable"
```

## modules/hal_atmosic/ATM34xx/drivers/radio_hal_ble_cs/Kconfig
```kconfig
# Copyright (c) 2024-2025 Atmosic
#
# SPDX-License-Identifier: Apache-2.0

config ATM_RADIO_HAL_BLE_CS
	bool "Atmosic radio_hal_ble_cs module"
	depends on SOC_ATM34XX_5
	default y if ATM_BLE

config ATM_RF_DELAY_ONE_EIGHTH_NS
	int "RF delay with a unit of 1/8 ns"
	depends on ATM_RADIO_HAL_BLE_CS
	default 18
	range 0 255
```

## modules/hal_atmosic/ATM34xx/drivers/radio_hal_ble_cte/Kconfig
```kconfig
# Copyright (c) 2024 Atmosic
#
# SPDX-License-Identifier: Apache-2.0

config ATM_RADIO_HAL_BLE_CTE
	bool "Atmosic radio_hal_ble_cte module"
	depends on SOC_ATM34XX_5
	default y if ATM_BLE
```

## modules/hal_atmosic/ATM34xx/drivers/radio_hal_log/Kconfig
```kconfig
# Copyright (c) 2024 Atmosic
#
# SPDX-License-Identifier: Apache-2.0

config ATM_RADIO_HAL_LOG
	bool "Atmosic radio_hal_log module"
	default y if ATM_ATLC || DTOP_BYPASS
```

## modules/hal_atmosic/ATM34xx/drivers/radio_hal_mgr/Kconfig
```kconfig
# Copyright (c) 2024 Atmosic
#
# SPDX-License-Identifier: Apache-2.0

config ATM_RADIO_HAL_MGR
	bool "Atmosic combo BLE/15.4 radio manager"
	default y if ATM_BLE && IEEE802154_ATM34
	depends on ATM_ATLC
```

## modules/hal_atmosic/ATM34xx/drivers/radio_req_154/Kconfig
```kconfig
# Copyright (c) 2024 Atmosic
#
# SPDX-License-Identifier: Apache-2.0

config ATM_RADIO_REQ_154
	bool "Atmosic 15.4 Radio Request module"
	default y if IEEE802154_ATM34
```

## modules/hal_atmosic/ATM34xx/drivers/radio_req_ble/Kconfig
```kconfig
# Copyright (c) 2024 Atmosic
#
# SPDX-License-Identifier: Apache-2.0

config ATM_RADIO_REQ_BLE
	bool "Atmosic radio_req_ble module"
	default y if ATM_BLE
```

## modules/hal_atmosic/ATM34xx/drivers/radio_status/Kconfig
```kconfig
# Copyright (c) 2024 Atmosic
#
# SPDX-License-Identifier: Apache-2.0

config ATM_RADIO_STATUS
	bool "Atmosic radio_status module"
	default y if ATM_ATLC || DTOP_BYPASS
```

## modules/hal_atmosic/ATM34xx/drivers/rf/Kconfig
```kconfig
# Copyright (c) 2025 Atmosic
#
# SPDX-License-Identifier: Apache-2.0

config ATM_RF
	bool "Atmosic RF module"
	default y if BT

config MAX_TX_PWR
	int "Maximum TX power"
	depends on ATM_RF
	range -20 10
	default 10
	help
	    Configure the maximum transmit power (dBm) for both advertising and
	    connection.

config FORCE_TX_PWR
	int "Force TX power"
	default 255
	help
	    This setting forces a fixed transmit power. It is the highest-priority
		option and should be used for RF test purposes only.
	    The value 255 is reserved and indicates that forced TX power is disabled.
	    Use values in the range -20 to 10 (dBm) to enable forced TX power.
```

## modules/hal_atmosic/ATM34xx/drivers/sec_cache/Kconfig
```kconfig
# Copyright (c) 2024 Atmosic
#
# SPDX-License-Identifier: Apache-2.0

config ATM_SEC_CACHE
	bool "Atmosic Secure Cache module"
	default y if TRUSTED_EXECUTION_SECURE
```
