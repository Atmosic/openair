/*
 * Copyright (c) 2025 Atmosic
 *
 * SPDX-License-Identifier: Apache-2.0
 */

&arduino_i2c {
	status = "okay";
	clock-frequency = <I2C_BITRATE_STANDARD>;

	adt7420@4b {
		compatible = "adi,adt7420";
		reg = <0x4b>;
		label = "ADT7420";
	};
};
