/*
 * Copyright (c) 2025 Atmosic
 *
 * SPDX-License-Identifier: Apache-2.0
 */

&arduino_i2c {
	status = "okay";
	clock-frequency = <I2C_BITRATE_STANDARD>;

	bme280: bme280@76 {
		compatible = "bosch,bme280";
		reg = <0x76>;
		status = "okay";
	};
};

