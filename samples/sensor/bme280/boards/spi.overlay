/*
 * Copyright (c) 2026 Atmosic
 *
 * SPDX-License-Identifier: Apache-2.0
 */

&spi0 {
	status = "okay";

	bme280: bme280@0 {
	    compatible = "bosch,bme280";
	    reg = <0>;
	    spi-max-frequency = <1000000>;
	    status = "okay";
	};
};
