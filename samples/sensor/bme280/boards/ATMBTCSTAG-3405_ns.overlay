/*
 * Copyright (c) 2025 Atmosic
 *
 * SPDX-License-Identifier: Apache-2.0
 */

&i2c0 {
	status = "okay";
	clock-frequency = <I2C_BITRATE_FAST>;
	bme280@76 {
		compatible = "bosch,bme280";
		reg = <0x76>;
		label = "mikroBUS_Weather_click_I2C";
	};
};
