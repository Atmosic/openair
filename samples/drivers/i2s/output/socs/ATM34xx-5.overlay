/*
 * Copyright (c) 2025 Atmosic
 *
 * SPDX-License-Identifier: Apache-2.0
 *
 * I2S pin assignments for ATM34xx-5 SOC boards
 */

&i2s {
	sck-out-pin = <3>;
	ws-out-pin = <4>;
	sd-out-pin = <5>;
	status = "okay";
};

/ {
	aliases {
		i2s-tx = &i2s;
	};
};
