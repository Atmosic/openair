## CMakeLists.txt
```
#
# Copyright (c) 2022-2025 Atmosic
#
# SPDX-License-Identifier: Apache-2.0
#

cmake_minimum_required(VERSION 3.20.0)

list(APPEND DTS_EXTRA_CPPFLAGS "-DATM_SPE_APP")
find_package(Zephyr REQUIRED HINTS $ENV{ZEPHYR_BASE})
project(bootloader)

target_sources(app PRIVATE
    src/main.c
)

target_sources_ifdef(CONFIG_ATM_ENABLE_NSC_EXAMPLE app PRIVATE src/cust_sec_func/cust_sec_func.c)

zephyr_compile_options(
    -DSECURE_PROC_ENV=1
    -include ${CMAKE_CURRENT_SOURCE_DIR}/include/atm_spe_exception_override.h
)
```

## Kconfig
```
# Copyright (c) 2024-2025 Atmosic
#
# SPDX-License-Identifier: Apache-2.0

source "Kconfig.zephyr"

config ATM_SPE_DISABLE_SAU
	bool "Disable SAU"

config ATM_ENABLE_NSC_EXAMPLE
	bool "Enable NSC example function for extending SPE"

config ATM_SPE_DEBUG_TZ
	bool "Enable verbose TrustZone configuration debug"

config ATM_SPE_SECURE_MEM_AREAS
	bool "Secure memory areas"
	default y
	select ATM_PROT
	select ATM_PROT_WP_ATMWSTK
	select ATM_PROT_RP_MCUBOOT
	select ATM_PROT_RP_BOOT_ROM
	select ATM_PROT_DISABLE_OTP
	select ATM_PROT_DISABLE_ROM_PATCH
	select ATM_PROT_DISABLE_SHUB
	select ATM_NV_MEM_FLASH_PROT if DT_HAS_ATMOSIC_SEC_NV_MEM_FLASH_PROT_ENABLED

config ATM_SPE_DISABLE_SYSTICK
	bool "Disable secure SysTick"
	depends on SYSTEM_TIMER_HAS_DISABLE_SUPPORT
	default y

config ATM_SPE_NSC_ENTRY_IN_RAM
	bool "Place SPE NSC entry points in RAM"
	default $(dt_nodelabel_bool_prop,sec_tz,allow_nsc_in_ram)
	depends on ARM_FIRMWARE_HAS_SECURE_ENTRY_FUNCS
	depends on XIP
	select ARM_NSC_REGION_IN_RAM
	select ATM_HAL_ENABLE_NSC_IN_RAM
	help
	  Configure non-secure entry points in the SPE to RAM.  This will select
	  the TrustZone support option as well as enable any HAL specific support

config ATM_SPE_WATCHDOG_TIMEOUT_SECONDS
	int "Number of seconds for SPE watchdog"
	default 3
	range 1 30
```

## sample.yaml
```
# Copyright (c) 2022-2025 Atmosic
#
# SPDX-License-Identifier: Apache-2.0

common:
  tags:
    - requires_trustzone
    - introduction
sample:
  description: Openair SPE
  name: Secure Processing Env. sample
tests:
  sample.spe: {}
```

## prj.conf
```kconfig
#
# Copyright (c) 2022-2025 Atmosic
#
# SPDX-License-Identifier: Apache-2.0
#

# Single-threaded, no timer support in the kernel
CONFIG_MULTITHREADING=n
CONFIG_KERNEL_MEM_POOL=n
# Designate bootloader as a spe
CONFIG_TRUSTED_EXECUTION_SECURE=y
CONFIG_ARM_FIRMWARE_HAS_SECURE_ENTRY_FUNCS=y

# Minimize size of bootloader
CONFIG_ASSERT=n
CONFIG_BOOT_BANNER=n
CONFIG_ERRNO=n
CONFIG_PM=n
CONFIG_CBPRINTF_NANO=y
CONFIG_NULL_POINTER_EXCEPTION_DETECTION_MPU=y

# Flash driver debug
#CONFIG_LOG=y
#CONFIG_LOG_MODE_IMMEDIATE=y
#CONFIG_FLASH_LOG_LEVEL_INF=y
```

## src/main.c
```c
/*
 * Copyright (c) 2022-2026 Atmosic
 *
 * SPDX-License-Identifier: Apache-2.0
 */
#include <errno.h>
#include <zephyr/kernel.h>
#include <assert.h>
#include "arch.h"
#include <zephyr/devicetree.h>
#include <zephyr/arch/cpu.h>
#include <zephyr/init.h>
#include <soc.h>
#include <zephyr/storage/flash_map.h>
#include "vectors.h"
#include <zephyr/irq.h>
#include <zephyr/drivers/timer/system_timer.h>
#include "at_tz_sau.h"
#include "at_tz_ppc.h"
#include "at_tz_mpc.h"

#include "at_wrpr.h"
#include "at_pinmux.h"
#include "sec_assert.h"
#ifdef CONFIG_ATM_PROT
#include "sec_service.h"
#endif
#if DT_NODE_EXISTS(DT_NODELABEL(spe_fault_storage))
#include <zephyr/sys/reboot.h>
#include <atm_spe_sec_fault_storage.h>
#endif
#include "atm_sec_wdog_disable.h"

#ifdef CONFIG_ATM_SPE_DEBUG_TZ
#define TRACE_TZ_CFG printk
#else
#define TRACE_TZ_CFG(s, ...) \
    do { \
    } while (0)
#endif

extern irq_target_state_t irq_target_state_set(unsigned int irq,
    irq_target_state_t target_state);

#ifndef CONFIG_BOOTLOADER_MCUBOOT
#define PART_ADDR(label) ( \
    DT_REG_ADDR(DT_MTD_FROM_FIXED_PARTITION(DT_NODELABEL(label))) + \
    DT_REG_ADDR(DT_NODELABEL(label)) \
)
#else
// The MCUboot dtsi arranges code into subpartitions
#define PART_ADDR(label) ( \
    DT_REG_ADDR(DT_MTD_FROM_FIXED_SUBPARTITION(DT_NODELABEL(label))) + \
    DT_REG_ADDR(DT_NODELABEL(label)) \
)
#endif

#define PART_OFFSET(label) (DT_REG_ADDR(DT_NODELABEL(label)))

#ifndef CONFIG_BOOTLOADER_MCUBOOT
#define PART_SPE_ADDR() PART_ADDR(spe_partition)
#define PART_NSPE_ADDR() PART_ADDR(nspe_partition)
#define PART_FAST_CODE_ADDR() PART_ADDR(fast_code_partition)
#elif DT_NODE_EXISTS(DT_NODELABEL(slot2_partition)) && \
    DT_NODE_EXISTS(DT_NODELABEL(slot3_partition))
// This is an implicit MCUBOOT configuration
// the NSPE is now in slot2 with the OTA area in slot3
#define PART_SPE_ADDR() PART_ADDR(spe_partition)
#define PART_NSPE_ADDR() PART_ADDR(nspe_partition)
// fast code is in slot 0
#define PART_FAST_CODE_ADDR() PART_ADDR(fast_code_partition)
#else // CONFIG_BOOTLOADER_MCUBOOT
#define PART_SPE_ADDR() PART_ADDR(spe_partition)
#define PART_NSPE_ADDR() PART_ADDR(nspe_partition)
#endif // CONFIG_BOOTLOADER_MCUBOOT

#ifndef NSPE_APP_START_OFFSET
#define NSPE_APP_START_OFFSET 0
#endif

#define PART_SPE_SIZE() DT_REG_SIZE(DT_NODELABEL(spe_partition))
#define PART_NSPE_SIZE() DT_REG_SIZE(DT_NODELABEL(nspe_partition))

#if DT_NODE_EXISTS(DT_NODELABEL(fast_code_partition))
#define PART_FAST_CODE_SIZE() DT_REG_SIZE(DT_NODELABEL(fast_code_partition))
#ifdef CONFIG_BOOTLOADER_MCUBOOT
#define FAST_CODE_APP_START_OFFSET CONFIG_ROM_START_OFFSET
#else
#define FAST_CODE_APP_START_OFFSET 0
#endif
#endif // DT_NODE_EXISTS(DT_NODELABEL(fast_code_partition))

#define PROG_MPC_PARTITION(part, base_partition)                                                   \
	do {                                                                                       \
		at_tz_mpc_ret_t __ret;                                                             \
		uint32_t part_baddr = DT_REG_ADDR(DT_MTD_FROM_FIXED_PARTITION(base_partition)) +   \
				      DT_REG_ADDR(part);                                           \
		uint32_t part_laddr = part_baddr + DT_REG_SIZE(part) - 1;                          \
		TRACE_TZ_CFG("MPC NS: [0x%08x - 0x%08x]\n", part_baddr, part_laddr);               \
		__ret = at_tz_mpc_config_region(part_baddr, part_laddr, AT_TZ_MPC_ATTR_NONSECURE); \
		SEC_ASSERT(__ret == AT_TZ_MPC_RET_OK);                                             \
	} while (0)

#define PROG_MPC_PARTITION_ENTRY(part, base_partition)  \
COND_CODE_1(DT_PROP(part, secure), (), ( \
	PROG_MPC_PARTITION(part, base_partition); \
 )) // !secure

#define MPC_PARTITION_ENTRY(part) \
COND_CODE_0(DT_CHILD_NUM(part),( \
        PROG_MPC_PARTITION_ENTRY(part, part) \
    ),( \
        DT_FOREACH_CHILD_VARGS( \
	    part, PROG_MPC_PARTITION_ENTRY, part \
	) \
    )) \

#define FIXED_PARTS_CHILDS(n) DT_FOREACH_CHILD(n, MPC_PARTITION_ENTRY)

#define CONFIGURE_MPC_FLASH_PARTITIONS() do { \
    DT_FOREACH_STATUS_OKAY(atmosic_tz_fixed_partitions, FIXED_PARTS_CHILDS) \
} while(0)

static void mpc_cfg(void)
{
    at_tz_mpc_ret_t ret;

    // Configuring MPC of Flash
    ret = at_tz_mpc_enable_int(AT_TZ_MPC_DEV_FLASH);
    SEC_ASSERT(ret == AT_TZ_MPC_RET_OK);

#ifdef CONFIG_BOOTLOADER_MCUBOOT
#if CONFIG_ROM_START_OFFSET % AT_TZ_MPC_FLS_BLK_SIZE != 0
#error CONFIG_ROM_START_OFFSET must be aligned to 2k boundary
#endif
    // Allow mcumgr to read image header.
    uint32_t boot_hdr_baddr = PART_SPE_ADDR();
    uint32_t boot_hdr_laddr = boot_hdr_baddr + CONFIG_ROM_START_OFFSET - 1;
    TRACE_TZ_CFG("MPC BOOT hdr: [0x%08x - 0x%08x]\n", boot_hdr_baddr,
	boot_hdr_laddr);
    ret = at_tz_mpc_config_region(boot_hdr_baddr, boot_hdr_laddr,
	AT_TZ_MPC_ATTR_NONSECURE);
    SEC_ASSERT(ret == AT_TZ_MPC_RET_OK);
#endif // CONFIG_BOOTLOADER_MCUBOOT

#if !DT_NODE_EXISTS(DT_NODELABEL(rram_controller))
    // FIXME, mark the region after the SPE up to the max. flash MPC
    // configurable region as non-secure
    uint32_t flash_ns_baddr =
	PART_SPE_ADDR() + DT_REG_SIZE(DT_NODELABEL(spe_partition));
    uint32_t flash_ns_laddr = DT_REG_ADDR(DT_NODELABEL(flash_controller)) +
	AT_TZ_MPC_EXT_FLASH_MPC_SIZE - 1;
    TRACE_TZ_CFG("MPC FLASH NS: [0x%08x - 0x%08x]\n", flash_ns_baddr,
	flash_ns_laddr);
    ret = at_tz_mpc_config_region(flash_ns_baddr, flash_ns_laddr,
	AT_TZ_MPC_ATTR_NONSECURE);
    SEC_ASSERT(ret == AT_TZ_MPC_RET_OK);
#endif

    // Configure remaining flash partitions.
    CONFIGURE_MPC_FLASH_PARTITIONS();
#if DT_NODE_EXISTS(DT_NODELABEL(rram_controller))
    // Permit access to RRAM registers
    ret = at_tz_mpc_config_region(ROM_RRAM_SIZE, ROM_RRAM_SIZE + 0x800 - 1,
	AT_TZ_MPC_ATTR_NONSECURE);
    SEC_ASSERT(ret == AT_TZ_MPC_RET_OK);
    // permit AT_PRRF_NONSECURE access and external Flash
    ret = at_tz_mpc_config_region(CMSDK_EXT_FLASH_NONSECURE_BASE - 0x800,
	CMSDK_EXT_FLASH_NONSECURE_BASE + AT_TZ_MPC_EXT_FLASH_MPC_SIZE - 1,
	AT_TZ_MPC_ATTR_NONSECURE);
    SEC_ASSERT(ret == AT_TZ_MPC_RET_OK);
#endif
    ret = at_tz_mpc_config_remaining_ext_flash(AT_TZ_MPC_ATTR_NONSECURE);
    SEC_ASSERT(ret == AT_TZ_MPC_RET_OK);

    // Configuring MPC of RAM
    ret = at_tz_mpc_enable_int(AT_TZ_MPC_DEV_RAM);
    SEC_ASSERT(ret == AT_TZ_MPC_RET_OK);
#if DT_NODE_EXISTS(DT_NODELABEL(spe_fault_storage))
    ret = at_tz_mpc_config_region(DT_REG_ADDR(DT_NODELABEL(sram0)) +
	DT_REG_SIZE(DT_NODELABEL(sram0)) + DT_REG_SIZE(
	DT_NODELABEL(spe_fault_storage)), DT_REG_ADDR(DT_NODELABEL(sram0)) +
	RAM_SIZE - 1, AT_TZ_MPC_ATTR_NONSECURE);
#else
    ret = at_tz_mpc_config_region(DT_REG_ADDR(DT_NODELABEL(sram0)) +
	    DT_REG_SIZE(DT_NODELABEL(sram0)),
	DT_REG_ADDR(DT_NODELABEL(sram0)) + RAM_SIZE - 1,
	AT_TZ_MPC_ATTR_NONSECURE);
#endif
    SEC_ASSERT(ret == AT_TZ_MPC_RET_OK);
    ret = at_tz_mpc_enable_bus_fault(AT_TZ_MPC_DEV_FLASH);
    SEC_ASSERT(ret == AT_TZ_MPC_RET_OK);
    ret = at_tz_mpc_enable_bus_fault(AT_TZ_MPC_DEV_RAM);
    SEC_ASSERT(ret == AT_TZ_MPC_RET_OK);

    return;
}

// Strip off IDAU bit to get physical address
#define GET_PHYS_ADDR(addr) ((addr) & ~0x10000000)

extern uint32_t __sg_start;
extern uint32_t __sg_end;
#define NSC_EN_REGION_START ((uint32_t)&__sg_start)
#define NSC_EN_REGION_END ((uint32_t)&__sg_end - 1)

static void sau_cfg(void)
{
#ifdef CONFIG_ATM_SPE_DISABLE_SAU
    at_tz_sau_disable();
#else
    at_tz_sau_enable();

    uint8_t sau_region = 0;
    at_tz_sau_ret_t ret;

#if DT_NODE_EXISTS(DT_NODELABEL(lc_partition))
    uint32_t phys_lc_baddr = GET_PHYS_ADDR(DT_REG_ADDR(DT_NODELABEL(rom0))) +
	DT_REG_ADDR(DT_NODELABEL(lc_partition));
    uint32_t phys_lc_laddr = phys_lc_baddr +
	DT_REG_SIZE(DT_NODELABEL(lc_partition)) - 1;
    ret = at_tz_sau_enable_region(sau_region++,
	AT_TZ_SAU_BADDR_MASK(phys_lc_baddr),
	AT_TZ_SAU_LADDR_MASK(phys_lc_laddr), AT_TZ_SAU_NS);
    SEC_ASSERT(ret == AT_TZ_SAU_OK);
#endif

#if DT_NODE_EXISTS(DT_NODELABEL(rram_controller))
    // Allocate RRAM, RRAM regs, prrf, and ext_flash as NS to save on SAU regions
    // Relies on NS region immediately following SPE.
    uint32_t rram_ns_start =
	PART_SPE_ADDR() + DT_REG_SIZE(DT_NODELABEL(spe_partition));
    uint32_t rram_flash_baddr = GET_PHYS_ADDR(rram_ns_start);
    uint32_t rram_flash_laddr =
#if DT_NODE_EXISTS(DT_NODELABEL(flash_controller))
	GET_PHYS_ADDR(DT_REG_ADDR(DT_NODELABEL(flash_controller))) +
	DT_REG_SIZE(DT_NODELABEL(flash_controller)) - 1;
#else
	CMSDK_EXT_FLASH_NONSECURE_BASE - 1; // end just shy of ext_flash start
#endif
    TRACE_TZ_CFG("SAU RRAM NS: [0x%08x - 0x%08x]\n", rram_flash_baddr,
	rram_flash_laddr);
    ret = at_tz_sau_enable_region(sau_region++,
	AT_TZ_SAU_BADDR_MASK(rram_flash_baddr),
	AT_TZ_SAU_LADDR_MASK(rram_flash_laddr), AT_TZ_SAU_NS);
    SEC_ASSERT(ret == AT_TZ_SAU_OK);
#else
    // flash (no RRAM) system
    // map everything after the SPE as non-secure to save on SAU entries
    uint32_t flash_ns_start =
	PART_SPE_ADDR() + DT_REG_SIZE(DT_NODELABEL(spe_partition));
    uint32_t flash_baddr = GET_PHYS_ADDR(flash_ns_start);
    // get the end of the flash address region (limited by the size of the
    // device)
    uint32_t flash_laddr =
	GET_PHYS_ADDR(DT_REG_ADDR(DT_NODELABEL(flash_controller))) +
	DT_REG_SIZE(DT_NODELABEL(flash_controller)) - 1;
    TRACE_TZ_CFG("SAU FLASH NS: [0x%08x - 0x%08x]\n", flash_baddr, flash_laddr);
    ret =
	at_tz_sau_enable_region(sau_region++, AT_TZ_SAU_BADDR_MASK(flash_baddr),
	    AT_TZ_SAU_LADDR_MASK(flash_laddr), AT_TZ_SAU_NS);
    SEC_ASSERT(ret == AT_TZ_SAU_OK);
#endif //  DT_NODE_EXISTS(DT_NODELABEL(rram_controller))

    uint32_t ns_sram_baddr = GET_PHYS_ADDR(DT_REG_ADDR(DT_NODELABEL(sram0))) +
	DT_REG_SIZE(DT_NODELABEL(sram0));
    uint32_t ns_sram_laddr =
	GET_PHYS_ADDR(DT_REG_ADDR(DT_NODELABEL(sram0))) + RAM_SIZE - 1;
    ret = at_tz_sau_enable_region(sau_region++,
	AT_TZ_SAU_BADDR_MASK(ns_sram_baddr),
	AT_TZ_SAU_LADDR_MASK(ns_sram_laddr), AT_TZ_SAU_NS);
    SEC_ASSERT(ret == AT_TZ_SAU_OK);

    // Allocate non-secure callable region
    ret = at_tz_sau_enable_region(sau_region++,
	AT_TZ_SAU_BADDR_MASK((unsigned int)NSC_EN_REGION_START),
	AT_TZ_SAU_LADDR_MASK((unsigned int)NSC_EN_REGION_END), AT_TZ_SAU_NSC);
    SEC_ASSERT(ret == AT_TZ_SAU_OK);

    // Allocate peripheral region
    uint32_t peripheral_baddr = GET_PHYS_ADDR(
	DT_RANGES_PARENT_BUS_ADDRESS_BY_IDX(DT_PATH(soc, peripheral_50000000),
	    0));
    uint32_t peripheral_laddr = peripheral_baddr +
	DT_RANGES_LENGTH_BY_IDX(DT_PATH(soc, peripheral_50000000), 0) - 1;
    TRACE_TZ_CFG("SAU PERIPH NS: [0x%08x - 0x%08x]\n", peripheral_baddr,
	peripheral_laddr);
    ret = at_tz_sau_enable_region(sau_region++,
	AT_TZ_SAU_BADDR_MASK(peripheral_baddr),
	AT_TZ_SAU_LADDR_MASK(peripheral_laddr), AT_TZ_SAU_NS);
    SEC_ASSERT(ret == AT_TZ_SAU_OK);

#ifdef CONFIG_BOOTLOADER_MCUBOOT
    // Allow mcumgr to read image header.
    uint32_t boot_hdr_baddr = GET_PHYS_ADDR(PART_SPE_ADDR());
    uint32_t boot_hdr_laddr = boot_hdr_baddr + CONFIG_ROM_START_OFFSET - 1;
    ret = at_tz_sau_enable_region(sau_region++,
	AT_TZ_SAU_BADDR_MASK(boot_hdr_baddr),
	AT_TZ_SAU_LADDR_MASK(boot_hdr_laddr), AT_TZ_SAU_NS);
    SEC_ASSERT(ret == AT_TZ_SAU_OK);
#endif // CONFIG_BOOTLOADER_MCUBOOT
#endif // CONFIG_ATM_SPE_DISABLE_SAU
    __DSB();
    __ISB();
    // SAU programming done early enough that only secure code has executed.
    // No need to invalidate the caches.
}

// security lockdowns before the SAU is enabled
// At this stage all peripherals can be accessed by
// both their SECURE and NON-SECURE aliases
static void pre_sau_security_lockdown(void)
{
#ifdef CONFIG_ATM_PROT
	sec_lockdown();
#endif
    // NOTE: primary slot locking happens in MCUBOOT
}

// Perform any post-SAU security lock down.
// At this point memory/peripherals have been assigned to secure or non-secure.
static void post_sau_security_lockdown(void)
{
}

static int secure_watchdog_init(void)
{
	// Enable Secure Watchdog for 1 long period, lasts whole boot process
	SECURE_WATCHDOG->LOCK = ATM_WATCHDOG_LOCK_MAGIC;
#ifdef CONFIG_BOOTLOADER_MCUBOOT
	SECURE_WATCHDOG->CTRL = 0; // Ensure MCUboot watchdog disabled so we can re-setup
#endif
	uint32_t clock_freq_hz = DT_PROP(DT_NODELABEL(sysclk), clock_frequency);
	uint32_t wdog_seconds = CONFIG_ATM_SPE_WATCHDOG_TIMEOUT_SECONDS * clock_freq_hz;

	SECURE_WATCHDOG->LOAD = wdog_seconds;
	SECURE_WATCHDOG->CTRL = CMSDK_Watchdog_CTRL_RESEN_Msk | CMSDK_Watchdog_CTRL_INTEN_Msk;
	SECURE_WATCHDOG->LOCK = 0;

	return 0;
}

// Run as early as possible to cover as much as possible
SYS_INIT(secure_watchdog_init, EARLY, 0);

FUNC_NORETURN void spe_main(void)
{
    printk("*** Zephyr SPE ***\n");
    printk("* SPE range: [0x%08x - 0x%08x]\n", (unsigned int)PART_SPE_ADDR(),
	(unsigned int)PART_SPE_ADDR() + (unsigned int)PART_SPE_SIZE() - 1);
#if DT_NODE_EXISTS(DT_NODELABEL(fast_code_partition))
    printk("* NSPE Fast Code range: [0x%08x - 0x%08x]\n",
	(unsigned int)PART_FAST_CODE_ADDR(),
	(unsigned int)PART_FAST_CODE_ADDR() +
	    (unsigned int)PART_FAST_CODE_SIZE() - 1);
#endif
    printk("* NSPE range: [0x%08x - 0x%08x]\n", (unsigned int)PART_NSPE_ADDR(),
	(unsigned int)PART_NSPE_ADDR() + (unsigned int)PART_NSPE_SIZE() - 1);
    uint32_t *application_addr =
#if DT_NODE_EXISTS(DT_NODELABEL(fast_code_partition))
	(uint32_t *)((PART_FAST_CODE_ADDR() + FAST_CODE_APP_START_OFFSET) &
	    ~0x10000000);
    // vector table is in the fast code partition
    printk("* Fast Code start addr %p \n", application_addr);
#else
	(uint32_t *)((
	    (PART_NSPE_ADDR() + NSPE_APP_START_OFFSET) & ~0x10000000));
    printk("* NSPE non-sec start addr: %p \n", application_addr);
#endif
    printk("***\n");

    // Enables BusFault, MemFault, UsageFault and SecureFault
    SCB->SHCSR |= SCB_SHCSR_USGFAULTENA_Msk | SCB_SHCSR_MEMFAULTENA_Msk |
	SCB_SHCSR_BUSFAULTENA_Msk | SCB_SHCSR_SECUREFAULTENA_Msk;

    // Allow fpu access in nonsecure mode.
    SCB->NSACR |= (1UL << SCB_NSACR_CP10_Pos) | (1UL << SCB_NSACR_CP11_Pos);

    // Permit NS Watchdog to reset system
    SYS_CTRL_REG->RESET_MASK |= SYS_CTRL_REG_SSE200_RESET_MASK_NSWD_EN_Msk;

    pre_sau_security_lockdown();

    // Enable and configure security controllers (SAU and MPC)
    sau_cfg();
    mpc_cfg();

#ifdef CONFIG_ATM_SPE_DISABLE_SYSTICK
    // Disable secure SysTick
    sys_clock_disable();
#else
    NVIC_SetPriority(SysTick_IRQn, IRQ_PRI_MID);
#endif

    // Redirect interrupts to non-secure handlers
    IRQn_Type irq;
    for (irq = NSECUREWDOG_RESETREQ_IRQn; irq <= DUALTIMER_IRQn; irq++) {
	irq_target_state_set(irq, IRQ_TARGET_STATE_NON_SECURE);
    }
    for (irq = RESERVED_14_IRQn; irq <= PORT1_15_IRQn; irq++) {
	irq_target_state_set(irq, IRQ_TARGET_STATE_NON_SECURE);
    }
    // configure PPC to set peripherals to NS space.
    at_tz_ppc_init_ns_cfg();

    post_sau_security_lockdown();

    // // jump to application image.
    SCB_NS->VTOR = (uint32_t)application_addr;
    __TZ_set_MSP_NS(application_addr[0]);
    register uint32_t addr = application_addr[1] & ~0x1; // S->NS: clear LSB
    __ASM volatile("BXNS %0" : : "r"(addr));
    __builtin_unreachable();
}

#define CFSR_MMFSR_READ(cfsr) ((uint8_t)(cfsr & 0xff))
#define CFSR_BFSR_READ(cfsr) ((uint8_t)((cfsr >> 8) & 0xff))

void k_sys_fatal_error_handler(unsigned int reason, const struct arch_esf *pEsf)
{
    sec_switch_console();

    switch (reason) {
	case K_ERR_ARM_SECURE_ATTRIBUTION_UNIT: {
	    printk("**SecFault\n");
	    uint32_t sfar = SAU->SFAR;
	    if (sfar < ROM_SIZE) {
		// ROM starts at 0x0 - ROM_SIZE, this area is marked secure.
		// NS images will secure fault to here if it tries to access.
		// This could be a NULL pointer access or just accessing a
		// secured ROM location covered by the SAU
		printk("  NULL access to 0x%" PRIx32 "?\n", sfar);
	    }
	} break;
	default: {
	    printk("**Caught fatal system error -- reason %d\n", reason);
	} break;
    }

    printk("  xpsr: 0x%" PRIx32 "\n", pEsf->basic.xpsr);
    printk("  lr  : 0x%" PRIx32 "\n", pEsf->basic.lr);
    printk("  pc  : 0x%" PRIx32 "\n", pEsf->basic.pc);
    printk("  r0  : 0x%" PRIx32 "\n", pEsf->basic.r0);
    printk("  r1  : 0x%" PRIx32 "\n", pEsf->basic.r1);
    printk("  r2  : 0x%" PRIx32 "\n", pEsf->basic.r2);
    printk("  r3  : 0x%" PRIx32 "\n", pEsf->basic.r3);

    uint32_t _cfsr = SCB->CFSR;
    printk("  CFSR : 0x%" PRIx32 "\n", _cfsr);
    printk("  BFSR : 0x%x\n", CFSR_BFSR_READ(_cfsr));
    printk("  BFAR : 0x%" PRIx32 "\n", SCB->BFAR);
    printk("  MMFSR: 0x%x\n", CFSR_MMFSR_READ(_cfsr));
    printk("  MMFAR: 0x%" PRIx32 "\n", SCB->MMFAR);
    printk("  HFSR : 0x%" PRIx32 "\n", SCB->HFSR);
    printk("  SFSR : 0x%" PRIx32 "\n", SAU->SFSR);
    printk("  SFAR : 0x%" PRIx32 "\n", SAU->SFAR);

    // Some non-secure faults can be escalated to the secure side.
    // Dump non-secure status registers to help with debug.
    // Note:  the MMFSR may get cleared by the NS exception handler
    // before it escalates to the secure side.
    uint32_t _cfsr_ns = SCB_NS->CFSR;
    printk("  CFSR_NS : 0x%" PRIx32 "\n", _cfsr_ns);
    printk("  BFSR_NS : 0x%x\n", CFSR_BFSR_READ(_cfsr_ns));
    printk("  BFAR_NS : 0x%" PRIx32 "\n", SCB_NS->BFAR);
    printk("  MMFSR_NS: 0x%x\n", CFSR_MMFSR_READ(_cfsr_ns));
    printk("  MMFAR_NS: 0x%" PRIx32 "\n", SCB_NS->MMFAR);
    printk("  BFSR_NS : 0x%x\n", CFSR_BFSR_READ(_cfsr_ns));
    printk("  HFSR_NS : 0x%" PRIx32 "\n", SCB_NS->HFSR);

#if DT_NODE_EXISTS(DT_NODELABEL(spe_fault_storage))
    atm_spe_secure_fault_record(reason, pEsf);
    sys_reboot(SYS_REBOOT_WARM);
#else
    printk("**Halting\n");
    k_fatal_halt(reason);
#endif
}

int main(void)
{
    spe_main();
    return 0;
}
```

## include/atm_spe_exception_override.h
```c
/*
 * Copyright (c) 2025 Atmosic
 *
 * SPDX-License-Identifier: Apache-2.0
 *
 * Override EXCEPTION_DUMP macro for SPE TrustZone environment.
 *
 * In TrustZone-M, UART is configured as Non-Secure after sec_switch_console().
 * If a fault occurs after this, the fault handler must not use printk, as
 * accessing Non-Secure UART from Secure state triggers another fault.
 *
 * This file must be force-included via compiler -include option to override
 * the original EXCEPTION_DUMP before fault.c includes exception.h.
 */

#ifndef ATM_SPE_EXCEPTION_OVERRIDE_H
#define ATM_SPE_EXCEPTION_OVERRIDE_H

/*
 * Pre-include the kernel headers required by <zephyr/arch/exception.h>
 * (specifically <zephyr/arch/arm/arm-m-switch.h>) in the same order used
 * by <zephyr/kernel_includes.h>. <zephyr/arch/cpu.h> must be included
 * before <zephyr/kernel/thread.h> so that arm-m-switch.h's own include
 * of <zephyr/kernel/thread.h> is the first visit and fully defines
 * struct k_thread before the inline arm_m_switch() body is parsed.
 *
 * <zephyr/kernel.h> is deliberately avoided so the generated
 * <zephyr/heap_constants.h> is not pulled into this force-included file;
 * see the Zephyr 4.4 migration guide.
 */
#include <zephyr/kernel_structs.h>
#include <zephyr/arch/cpu.h>

#include <zephyr/arch/exception.h>

#ifndef _ASMLANGUAGE

#ifdef EXCEPTION_DUMP
#undef EXCEPTION_DUMP
#endif

/* Helper to consume variadic arguments and avoid unused variable warnings */
static inline int __atm_exception_dump_unused(const char *fmt, ...)
{
	(void)fmt;
	return 0;
}

#define EXCEPTION_DUMP(fmt, ...) \
	do { \
		(void)__atm_exception_dump_unused(fmt, ##__VA_ARGS__); \
	} while (0)

#endif /* !_ASMLANGUAGE */

#endif /* ATM_SPE_EXCEPTION_OVERRIDE_H */
```
