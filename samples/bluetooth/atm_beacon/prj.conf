## Kconfig
```
# Copyright (c) 2024-2026 Atmosic
#
# SPDX-License-Identifier: LicenseRef-Atmosic

module = ATM_BEACON
module-str = atm_beacon
source "subsys/logging/Kconfig.template.log_config"

choice
	prompt "Select beacon"
	default REFBCN_POWER_PROFILE

#
# power_profile
#
# Send one scannable legacy Eddystone beacon each second until 30 are sent.
# Between beacons, use the retain w/ voltage drop power mode.
# Then hibernate for 30 seconds, and repeat.
#
# This is a good example for measuring the device's low power performance.
#
config REFBCN_POWER_PROFILE
	bool "hibernate beacon demo"
	select ADV_OPTS_USE_IDENTITY
	select ADV_OPTS_SCANNABLE
	select ADV_OPTS_FILTER_SCAN_REQ
	select ADV_FLAGS_LE_ONLY_GENERAL_DISC
	help
	  Select this option to enable power profile.

#
# socoff_beacon_demo
#
# Sends scannable beacon for 30s and goes to soc_off.
# Then socoff for 30 seconds, and repeat.
#
config REFBCN_SOCOFF_BEACON
	bool "socoff beacon demo"
	select ADV_OPTS_USE_IDENTITY
	select ADV_OPTS_SCANNABLE
	select SOFT_OFF
	help
	  Select this option to see the 30s beacon and 30s soc off.

#
# Wakeup receiver beacon
#
# Sends scannable beacon for configurable time and goes to hibernation.
# Wakes up on WURX signal detection and repeats.
#
config REFBCN_WURX_BEACON
	bool "WURX beacon demo"
	select ADV_OPTS_USE_IDENTITY
	select ADV_OPTS_SCANNABLE
	select ADV_FLAGS_LE_ONLY_GENERAL_DISC
	select ATM_SETTINGS
	select WURX if DT_HAS_ATMOSIC_WURX_ENABLED
	select SOFT_OFF
	select ATM_RESET
	help
	  Select this option to enable WURX beacon mode. The device will
	  advertise for a configurable time period, then enter hibernation
	  and wait for WURX wake-up signals.

	  On platforms without WURX hardware, the beacon payload is still
	  emitted but without WURX wake-up capability after hibernation.

	  For information on enabling WURX support, see openair/doc/wurx/wurx.rst

#
# simple_harv_beacon
#
# Beacon example when using Harvesting.
#
# Sends scannable beacon forever without hibernation.
# Uses 1 second advertising interval for energy harvesting optimization.
# This will allow mobile applications on iOS and Android to always see
# the device when scanning.
#
config REFBCN_SIMPLE_HARV_BEACON
	bool "simple harvesting beacon"
	select ADV_OPTS_USE_IDENTITY
	select ADV_OPTS_SCANNABLE
	help
	  Select this option to enable simple harvesting beacon mode.
	  The device will advertise with 1 second interval indefinitely,
	  optimized for energy harvesting applications.

#
# extended_scn
#
# Send one extended scannable advertisement each half second.
# The extended scan response will contain an Eddystone beacon.
# Between beacons, use the retain w/ voltage drop power mode.
#
config REFBCN_EXTENDED_SCN
	bool "extended scannable beacon"
	select ADV_OPTS_USE_IDENTITY
	select ADV_OPTS_SCANNABLE
	select ADV_OPTS_EXT_ADV
	select ADV_OPTS_NO_2M
	select ADV_FLAGS_LE_ONLY_GENERAL_DISC
	help
	  Select this option to enable extended scannable beacon mode.
	  The device will send extended scannable advertisements every 500ms
	  with an Eddystone beacon in the scan response.

#
# iBeacon
#
# Apple iBeacon format beacon.
# Sends non-connectable iBeacon advertisements with UUID, Major, Minor.
#
config REFBCN_IBEACON
	bool "iBeacon demo"
	select ADV_OPTS_USE_IDENTITY
	select ADV_FLAGS_LE_ONLY_GENERAL_DISC
	help
	  Select this option to enable iBeacon mode.
	  The device will advertise using Apple iBeacon format with
	  manufacturer-specific data containing UUID, Major, Minor values.

#
# extended_adv
#
# Send one extended Eddystone beacon each half second.
# Between beacons, use the retain w/ voltage drop power mode.
#
config REFBCN_EXTENDED_ADV
	bool "extended advertising beacon"
	select ADV_OPTS_USE_IDENTITY
	select ADV_OPTS_EXT_ADV
	select ADV_OPTS_NO_2M
	select ADV_FLAGS_LE_ONLY_GENERAL_DISC
	help
	  Select this option to enable extended advertising beacon mode.
	  The device will send extended non-connectable non-scannable
	  advertisements every 500ms with a large Eddystone URL beacon.

#
# extended_con
#
# Send one extended connectable Eddystone beacon each half second.
# Between beacons, use the retain w/ voltage drop power mode.
#
config REFBCN_EXTENDED_CON
	bool "extended connectable beacon"
	select ADV_OPTS_USE_IDENTITY
	select ADV_OPTS_CONNECTABLE
	select ADV_OPTS_EXT_ADV
	select ADV_OPTS_NO_2M
	select ADV_FLAGS_LE_ONLY_GENERAL_DISC
	help
	  Select this option to enable extended connectable beacon mode.
	  The device will send extended connectable non-scannable
	  advertisements every 500ms with a large Eddystone URL beacon.

# LR_coded
#
# Long Range coded PHY beacon.
# Sends extended advertisements on LE Coded PHY for increased range.
#
config REFBCN_LR_CODED
	bool "Long Range coded PHY beacon demo"
	select ADV_OPTS_USE_IDENTITY
	select ADV_OPTS_SCANNABLE
	select ADV_OPTS_EXT_ADV
	select ADV_OPTS_CODED
	select ADV_FLAGS_LE_ONLY_GENERAL_DISC
	help
	  Select this option to enable Long Range coded PHY beacon mode.
	  The device will advertise on LE Coded PHY for extended range
	  with the trade-off of lower data rate and higher power consumption.

# 2M_secondary
#
# Send one extended Eddystone beacon each second via the 2M phy.
# Between beacons, use the hibernate power mode.
#
config REFBCN_2M_SECONDARY
	bool "2M PHY secondary advertising beacon"
	select ADV_OPTS_USE_IDENTITY
	select ADV_OPTS_EXT_ADV
	select ADV_FLAGS_LE_ONLY_GENERAL_DISC
	help
	  Select this option to enable 2M PHY secondary advertising.
	  Sends extended Eddystone beacon each second using 2M PHY,
	  then hibernates for 1 second and repeats.

# LR500_coded
#
# Long Range 500kbps coded PHY beacon.
# Sends extended advertisements on LE Coded PHY with S=2 coding (500kbps).
#
config REFBCN_LR500_CODED
	bool "Long Range 500kbps coded PHY beacon demo"
	select ADV_OPTS_USE_IDENTITY
	select ADV_OPTS_SCANNABLE
	select ADV_OPTS_EXT_ADV
	select ADV_OPTS_CODED
	select ADV_OPTS_REQUIRE_S2_CODING
	select ADV_FLAGS_LE_ONLY_GENERAL_DISC
	help
	  Select this option to enable Long Range 500kbps coded PHY beacon mode.
	  The device will advertise on LE Coded PHY with S=2 coding for
	  500kbps data rate, offering higher throughput than S=8 (125kbps)
	  with a trade-off of reduced range.

endchoice

config REFBCN_IBEACON_RSSI
	hex "iBeacon calibrated RSSI at 1m"
	default 0xff
	depends on REFBCN_IBEACON
	help
	  Calibrated RSSI value at 1 meter distance.
	  This is a signed 8-bit value (0xff = -1 dBm).
	  Used by receiving devices to estimate distance from the beacon.

config BT_DEVICE_NAME
	default "ATMxxxx Lowest - Power" if REFBCN_POWER_PROFILE || REFBCN_EXTENDED_SCN || \
					    REFBCN_EXTENDED_ADV  || REFBCN_EXTENDED_CON || \
					    REFBCN_LR_CODED || REFBCN_2M_SECONDARY || \
					    REFBCN_LR500_CODED
	default "Atmosic Beacon" if REFBCN_SOCOFF_BEACON || REFBCN_WURX_BEACON
	default "Atmosic Harvesting" if REFBCN_SIMPLE_HARV_BEACON
	default "Atmosic iBeacon" if REFBCN_IBEACON

config REFBCN_SHORT_NAME
	string "Beacon shortened name"
	default "A0000c9" if REFBCN_POWER_PROFILE
	default "Atmosic" if REFBCN_SOCOFF_BEACON || REFBCN_WURX_BEACON
	default ""
	help
	  Shortened name advertised in advertising data.
	  Leave empty if not using shortened name.

#
# Add the simple beacon profile if Button 1 is not present or not pressed at
# boot; otherwise, use the other enabled profile. The simple beacon sends
# scannable beacon forever without hibernation.
#

config REFBCN_SIMPLE_BEACON
	bool "simple beacon"
	select ATM_RESET
	select RETAINED_MEM
	help
	  Add simple beacon profile if Button 1 is not present or not pressed
	  at boot; otherwise, use the other enabled profile.

config REFBCN_SIMPLE_BEACON_NAME
	string "Simple beacon complete name"
	default "Atmosic Beacon"
	depends on REFBCN_SOCOFF_BEACON || REFBCN_SIMPLE_BEACON || REFBCN_WURX_BEACON

config REFBCN_SIMPLE_BEACON_SHORT_NAME
	string "Simple beacon shortened name"
	default "Atmosic"
	depends on REFBCN_SOCOFF_BEACON || REFBCN_SIMPLE_BEACON || REFBCN_WURX_BEACON || REFBCN_SIMPLE_HARV_BEACON

config REFBCN_SIMPLE_BEACON_INTV
	hex "Simple beacon advertising interval"
	range 0x14 0x2710
	default 0x64 # 100 ms
	depends on REFBCN_SIMPLE_BEACON
	help
	  This parameter is specified in units of 1 ms, rather than 0.625 ms.
	  However, the final value will be rounded to the nearest multiple of 0.625 ms.

# for Create
# ATM5 SOC series has more caps on the power, so to see true power draw
# consumption during sleep modes, increase adv interval beyond 1 second
# Keeping default adv interval as 2 sec for ATM5; 1 sec for others
config ADV_INTV
	hex "Advertising interval in 0.625ms units"
	range 0x20 0x4000
	default 0x320 if REFBCN_EXTENDED_SCN || REFBCN_EXTENDED_ADV || REFBCN_EXTENDED_CON # 500ms
	default 0xC80 if SOC_SERIES_ATM5 && (REFBCN_POWER_PROFILE || REFBCN_SOCOFF_BEACON || REFBCN_WURX_BEACON || \
			 REFBCN_SIMPLE_HARV_BEACON || REFBCN_2M_SECONDARY) # 2s
	default 0x640 if REFBCN_POWER_PROFILE || REFBCN_SOCOFF_BEACON || REFBCN_WURX_BEACON || \
			 REFBCN_SIMPLE_HARV_BEACON || REFBCN_2M_SECONDARY # 1s

	default 0x20
	help
	  Configures the advertising interval in units of 0.625ms.
	  Range: 0x20 (20ms) to 0x4000 (10240ms).

config ADV_MAX_EVT
	int "Maximum number of advertising events"
	default 1 if REFBCN_2M_SECONDARY
	default 30 if REFBCN_POWER_PROFILE || REFBCN_SOCOFF_BEACON || REFBCN_WURX_BEACON # 30s_adv (30 * 1s)
	default 0
	help
	  Specifies the maximum number of advertising events to send before stopping.
	  0 means unlimited advertising.

config ADV_RSTRT_DUR_MS
	int "Advertising restart duration (milliseconds)"
	default 1000 if REFBCN_2M_SECONDARY # 1s
	default 30000 if REFBCN_POWER_PROFILE || REFBCN_SOCOFF_BEACON # 30s
	default 0
	help
	  Specifies the duration in milliseconds to wait before restarting advertising.
	  0 means no restart delay.

# for Low power
config SOFT_OFF
	bool "Enable soft-off low power mode"
	depends on PM
	select EXT_WAKEUP_ENABLE_INDEFINITE
	default y if REFBCN_POWER_PROFILE || REFBCN_2M_SECONDARY
	help
	  Enables the soft-off low power mode for the beacon application.
	  When enabled, the device will enter a low power state between advertising cycles.

# for hibernation
config SOFT_OFF_SUBID
	int "Soft-off substate ID"
	depends on SOFT_OFF
	default 0 if REFBCN_POWER_PROFILE || REFBCN_WURX_BEACON || REFBCN_2M_SECONDARY
	default 1
	help
	  Specifies the substate ID to use in low power state
	  1:soc-off 0:hibernation

#
# Invisible Kconfig symbols
#

rsource "Kconfig.adv_opts"
rsource "Kconfig.adv_flags"

config ADV_FLAGS
	hex
	default 0x4 if ADV_FLAGS_LE_ONLY_NON_DISC
	default 0x5 if ADV_FLAGS_LE_ONLY_LIMITED_DISC
	default 0x6 if ADV_FLAGS_LE_ONLY_GENERAL_DISC
	default 0

# for Start
config ADV_TOUT
	int
	default 0

config BT_FILTER_ACCEPT_LIST
	default y

config ATM_PLF_DEBUG
	default n # Debug printing can disturb power measurements

source "Kconfig.zephyr"
```

## Kconfig.adv_flags
```
# Copyright (c) 2025-2026 Atmosic
#
# SPDX-License-Identifier: LicenseRef-Atmosic

# the following options are used to select the default value of ADV_FLAGS
# default 0 if none of them are selected.
# if multiple options are selected, the first matched default value will be applied.

config ADV_FLAGS_LE_ONLY_NON_DISC
	bool "set flags to 0x04"

config ADV_FLAGS_LE_ONLY_LIMITED_DISC
	bool "set flags to 0x05"

config ADV_FLAGS_LE_ONLY_GENERAL_DISC
	bool "set flags to 0x06"
```

## Kconfig.adv_opts
```
# Copyright (c) 2025-2026 Atmosic
#
# SPDX-License-Identifier: LicenseRef-Atmosic

config ADV_OPTS_CONN
	bool

config ADV_OPTS_USE_IDENTITY
	bool

config ADV_OPTS_DIR_MODE_LOW_DUTY
	bool

config ADV_OPTS_DIR_ADDR_RPA
	bool

config ADV_OPTS_FILTER_SCAN_REQ
	bool

config ADV_OPTS_FILTER_CONN
	bool

config ADV_OPTS_NOTIFY_SCAN_REQ
	bool

config ADV_OPTS_SCANNABLE
	bool
	depends on !(ADV_OPTS_CONN && ADV_OPTS_EXT_ADV)

config ADV_OPTS_EXT_ADV
	bool

if ADV_OPTS_EXT_ADV

config ADV_OPTS_NO_2M
	bool
	depends on !ADV_OPTS_CODED

config ADV_OPTS_CODED
	bool

config ADV_OPTS_REQUIRE_S2_CODING
	bool
	depends on ADV_OPTS_CODED

config ADV_OPTS_ANONYMOUS
	bool

config ADV_OPTS_USE_TX_POWER
	bool

endif # ADV_OPTS_EXT_ADV

config ADV_OPTS_DISABLE_CHAN_37
	bool

config ADV_OPTS_DISABLE_CHAN_38
	bool

config ADV_OPTS_DISABLE_CHAN_39
	bool

config ADV_OPTS_USE_NRPA
	bool
	depends on !ADV_OPTS_USE_IDENTITY
```

## sample.yaml
```
sample:
  description: Atmosic beacon adv sample
  name: Atmosic beacon sample
common:
  tags:
    - bluetooth
    - role_peripheral
    - role_broadcaster
tests:
  sample.bluetooth.atm_beacon:
    tags:
      - introduction
  samples.bluetooth.atm_beacon.atm: &atm_base
    sysbuild: true
    harness: console
    harness_config: &harness_config_base
      type: one_line
      regex:
        - Booting Zephyr OS
  samples.bluetooth.atm_beacon.atm.socoff: &socoff_base
    <<: *atm_base
    extra_configs:
      - CONFIG_REFBCN_SOCOFF_BEACON=y
  samples.bluetooth.atm_beacon.atm.sbcn: &sbcn_base
    <<: *atm_base
    extra_configs:
      - &sbcn_conf CONFIG_REFBCN_SIMPLE_BEACON=y
  samples.bluetooth.atm_beacon.atm.sbcn_nobut:
    <<: *sbcn_base
    # no_button.overlay disables &button0, so the overlay only compiles on a
    # board declaring that node.
    depends_on:
      - &button0 button0
    extra_args:
      - EXTRA_DTC_OVERLAY_FILE=no_button.overlay
  samples.bluetooth.atm_beacon.atm.sbcn_noled:
    <<: *sbcn_base
    extra_args:
      - EXTRA_DTC_OVERLAY_FILE=no_led.overlay
  samples.bluetooth.atm_beacon.atm.sbcn_nosocoff:
    <<: *sbcn_base
    extra_configs:
      - *sbcn_conf
      - CONFIG_SOFT_OFF=n
  samples.bluetooth.atm_beacon.atm.sbcn_nobut_noled: &sbcn_nobut_noled_base
    <<: *sbcn_base
    depends_on:
      - *button0
    extra_args:
      - &sbcn_nobut_noled_args EXTRA_DTC_OVERLAY_FILE=no_button.overlay;no_led.overlay
  samples.bluetooth.atm_beacon.atm.sbcn_nobut_noled.short:
    <<: *sbcn_nobut_noled_base
    extra_configs:
      - *sbcn_conf
      - CONFIG_SOFT_OFF=n
      - CONFIG_ADV_INTV=0x20
      - CONFIG_ADV_MAX_EVT=20
      - CONFIG_ADV_RSTRT_DUR_MS=0
      - CONFIG_ATM_TEST_UTIL=y
      - CONFIG_SOFT_OFF_SUBID=0
  samples.bluetooth.atm_beacon.atm.sbcn_nobut_noled.mcuboot.flash_xip:
    <<: *sbcn_nobut_noled_base
    tags:
      - mcuboot
      - flash_xip
    depends_on:
      - *button0
      - flash
      - rram
      - xip
    extra_args:
      - *sbcn_nobut_noled_args
      - SB_CONFIG_BOOTLOADER_MCUBOOT=y
      - SB_CONFIG_BOOT_SIGNATURE_TYPE_ECDSA_P256=y
      - SB_CONFIG_MCUBOOT_MODE_SWAP_USING_OFFSET=y
      - SB_ATM_DTS_EXTRA_CPPFLAGS="-DATM_APP_FLASH_XIP"
      - mcuboot_CONFIG_UPDATEABLE_IMAGE_NUMBER=2
  samples.bluetooth.atm_beacon.atm.wurx_bcn:
    <<: *atm_base
    tags:
      - wurx
    depends_on:
      - wurx
    extra_configs:
      - &wurx_bcn_conf CONFIG_REFBCN_WURX_BEACON=y
  samples.bluetooth.atm_beacon.atm.shbcn: &shbcn_base
    <<: *atm_base
    extra_configs:
      - &shbcn_conf CONFIG_REFBCN_SIMPLE_HARV_BEACON=y
  samples.bluetooth.atm_beacon.atm.ext_scn:
    <<: *atm_base
    extra_configs:
      - &ext_scn_conf CONFIG_REFBCN_EXTENDED_SCN=y
  samples.bluetooth.atm_beacon.atm.ibeacon: &ibeacon_base
    <<: *atm_base
    extra_configs:
      - &ibeacon_conf CONFIG_REFBCN_IBEACON=y
  samples.bluetooth.atm_beacon.atm.ext_adv:
    <<: *atm_base
    extra_configs:
      - &ext_adv_conf CONFIG_REFBCN_EXTENDED_ADV=y
  samples.bluetooth.atm_beacon.atm.ext_con:
    <<: *atm_base
    extra_configs:
      - &ext_con_conf CONFIG_REFBCN_EXTENDED_CON=y
  samples.bluetooth.atm_beacon.atm.lr_coded: &lr_coded_base
    <<: *atm_base
    extra_configs:
      - &lr_coded_conf CONFIG_REFBCN_LR_CODED=y
  samples.bluetooth.atm_beacon.atm.2m_secondary: &2m_secondary_base
    <<: *atm_base
    extra_configs:
      - &2m_secondary_conf CONFIG_REFBCN_2M_SECONDARY=y
      - &2m_secondary_data_len CONFIG_ATM_MAX_ADV_DATA_LEN=990
  samples.bluetooth.atm_beacon.atm.lr500_coded:
    <<: *atm_base
    extra_configs:
      - &lr500_coded_conf CONFIG_REFBCN_LR500_CODED=y
  samples.bluetooth.atm_beacon.atm.two_dev: &two_dev_base
    <<: *atm_base
    harness_config:
      <<: *harness_config_base
      regex:
        - "Identity:"
    tags:
      - two_dev
    # Expected log as <inf> bt_hci_core: Identity: for observer to parse BD ADDR
    extra_configs:
      - &log_conf CONFIG_LOG=y
      - &hci_conf CONFIG_BT_HCI_CORE_LOG_LEVEL_INF=y
      - &filter_conf CONFIG_BT_FILTER_ACCEPT_LIST=n
  samples.bluetooth.atm_beacon.atm.two_dev.pp_bcn: # power profile
    <<: *two_dev_base
  samples.bluetooth.atm_beacon.atm.two_dev.sbcn: # simple beacon
    <<: *two_dev_base
    extra_configs:
      - *sbcn_conf
      - *log_conf
      - *hci_conf
      - *filter_conf
  samples.bluetooth.atm_beacon.atm.two_dev.shbcn: # simple harvesting beacon
    <<: *two_dev_base
    extra_configs:
      - *shbcn_conf
      - *log_conf
      - *hci_conf
      - *filter_conf
  samples.bluetooth.atm_beacon.atm.two_dev.ext_scn: # extended scannable beacon
    <<: *two_dev_base
    extra_configs:
      - *ext_scn_conf
      - *log_conf
      - *hci_conf
      - *filter_conf
  samples.bluetooth.atm_beacon.atm.two_dev.ibeacon: # iBeacon
    <<: *two_dev_base
    extra_configs:
      - *ibeacon_conf
      - *log_conf
      - *hci_conf
      - *filter_conf
  samples.bluetooth.atm_beacon.atm.two_dev.ext_adv: # extended advertising beacon
    <<: *two_dev_base
    extra_configs:
      - *ext_adv_conf
      - *log_conf
      - *hci_conf
      - *filter_conf
  samples.bluetooth.atm_beacon.atm.two_dev.ext_con: # extended connectable beacon
    <<: *two_dev_base
    extra_configs:
      - *ext_con_conf
      - *log_conf
      - *hci_conf
      - *filter_conf
  samples.bluetooth.atm_beacon.atm.two_dev.wurx_bcn: # WURX beacon
    <<: *two_dev_base
    tags:
      - two_dev
      - wurx
    depends_on:
      - wurx
    extra_configs:
      - *wurx_bcn_conf
      - *log_conf
      - *hci_conf
      - *filter_conf
  samples.bluetooth.atm_beacon.atm.two_dev.lr_coded: # Long Range coded PHY
    <<: *two_dev_base
    extra_configs:
      - *lr_coded_conf
      - *log_conf
      - *hci_conf
      - *filter_conf
  samples.bluetooth.atm_beacon.atm.two_dev.2m_secondary: # 2M secondary beacon
    <<: *two_dev_base
    extra_configs:
      - *2m_secondary_conf
      - *log_conf
      - *hci_conf
      - *filter_conf
      - *2m_secondary_data_len
      - CONFIG_ADV_MAX_EVT=60 # extend adv max evt to 60 for the test
  samples.bluetooth.atm_beacon.atm.two_dev.lr500_coded: # Long Range 500kbps coded PHY
    <<: *two_dev_base
    extra_configs:
      - *lr500_coded_conf
      - *log_conf
      - *hci_conf
      - *filter_conf
```

## prj.conf
```kconfig
CONFIG_BT=y
CONFIG_BT_EXT_ADV=y
# The beacon demos drive the low power states directly
CONFIG_PM=y
```

## app.overlay
```dts
/* Copyright (c) 2025-2026 Atmosic
 *
 * SPDX-License-Identifier: LicenseRef-Atmosic
 */

&soc_off {
	status = "okay";
};

&cpu0 {
	cpu-power-states = <&idle &sleep &retain &hibernate &soc_off>;
};
```

## no_button.overlay
```dts
/*
 * Copyright (c) 2025-2026 Atmosic
 *
 * SPDX-License-Identifier: LicenseRef-Atmosic
 */

/*
 * Test overlay to disable button0 for testing beacon sample
 * without button hardware
 */

&button0 {
	status = "disabled";
};
```

## no_led.overlay
```dts
/*
 * Copyright (c) 2025-2026 Atmosic
 *
 * SPDX-License-Identifier: LicenseRef-Atmosic
 */

/*
 * Test overlay to disable led0 for testing beacon sample
 * without LED hardware
 */

&led0 {
	status = "disabled";
};
```

## src/main.c
```c
/* main.c - Application main entry point */

/*
 * Copyright (c) 2015-2016 Intel Corporation
 * Copyright (c) 2024-2026 Atmosic
 *
 * SPDX-License-Identifier: Apache-2.0
 */

#include <zephyr/bluetooth/bluetooth.h>
#include <zephyr/logging/log.h>
#include "compiler.h"

LOG_MODULE_REGISTER(beacon, CONFIG_ATM_BEACON_LOG_LEVEL);

#ifdef CONFIG_PM
#include <zephyr/pm/pm.h>
#endif

#ifdef CONFIG_SOFT_OFF
#include <zephyr/pm/policy.h>
#include "power.h"
#endif
#if CONFIG_ATM_TEST_UTIL
#include "atm_test_common.h"
#endif

#ifdef CONFIG_REFBCN_WURX_BEACON
#include "reset.h"
#endif
#ifdef CONFIG_WURX
#include "wurx.h"
#endif

#ifdef CONFIG_REFBCN_SIMPLE_BEACON
static bool using_simple_beacon;
#include <zephyr/drivers/gpio.h>
#include "reset.h"
#if DT_NODE_HAS_STATUS_OKAY(DT_NODELABEL(button0))
#define BUTTON_1_EXIST
#endif
#if DT_NODE_HAS_STATUS_OKAY(DT_NODELABEL(led0))
#define LED_1_EXIST
#endif
#endif // CONFIG_REFBCN_SIMPLE_BEACON

#define PMU_NODE DT_NODELABEL(pmu)

#define PMU_BATT_LIION_HARV_ENABLED ((DT_NODE_HAS_PROP(PMU_NODE, batt_type) && (DT_PROP(PMU_NODE, batt_type) == BATT_TYPE_LI_ION)) && (DT_PROP_OR(PMU_NODE, rf_harv, 0) || DT_PROP_OR(PMU_NODE, nonrf_harv, 0)))

#if defined(CONFIG_REFBCN_SIMPLE_BEACON) && defined(CONFIG_RETAINED_MEM_ATM_HIB)
#define REFBCN_PROFILE_RETENTION
#endif

#if defined(REFBCN_PROFILE_RETENTION) || PMU_BATT_LIION_HARV_ENABLED
#include <zephyr/drivers/retained_mem.h>
#include <zephyr/device.h>

static const struct device *retained_mem_dev;

struct retained_state {
#if PMU_BATT_LIION_HARV_ENABLED
	uint32_t batt;
#endif
#ifdef REFBCN_PROFILE_RETENTION
	uint32_t profile;
#endif
};

static struct retained_state retained_state;
#define RETAINED_MEM_STATE_OFFSET 0
#endif

#if PMU_BATT_LIION_HARV_ENABLED
#include "pmu.h"
#include "reset.h"
#include "batt_model.h"
static dev_state_t batt_state;

#define BATT_PERSIST_TAG 0x1E3C0000
#endif

#ifdef REFBCN_PROFILE_RETENTION
#define PROFILE_BASE_MAGIC   0x42434E30
#define PROFILE_SIMPLE_MAGIC 0x42434E31

static bool simple_beacon_profile_restore(void)
{
	int ret = retained_mem_read(retained_mem_dev, RETAINED_MEM_STATE_OFFSET,
				    (uint8_t *)&retained_state, sizeof(retained_state));
	if (ret) {
		LOG_WRN("Failed to restore beacon profile (err %d)", ret);
		return false;
	}

	if (retained_state.profile == PROFILE_SIMPLE_MAGIC) {
		using_simple_beacon = true;
	} else if (retained_state.profile == PROFILE_BASE_MAGIC) {
		using_simple_beacon = false;
	} else {
		return false;
	}

	return true;
}

static void simple_beacon_profile_save(void)
{
	retained_state.profile = using_simple_beacon ? PROFILE_SIMPLE_MAGIC : PROFILE_BASE_MAGIC;
	int ret = retained_mem_write(retained_mem_dev, RETAINED_MEM_STATE_OFFSET,
				     (const uint8_t *)&retained_state, sizeof(retained_state));
	if (ret) {
		LOG_WRN("Failed to retain beacon profile (err %d)", ret);
	}
}
#endif

#if defined(CONFIG_REFBCN_SOCOFF_BEACON) || defined(CONFIG_REFBCN_SIMPLE_BEACON) ||                \
	defined(CONFIG_REFBCN_WURX_BEACON) || defined(CONFIG_REFBCN_SIMPLE_HARV_BEACON)
static struct bt_data const simple_bcn_ad[] = {
	BT_DATA_BYTES(BT_DATA_FLAGS, CONFIG_ADV_FLAGS),
	BT_DATA_BYTES(BT_DATA_UUID16_ALL, 0xaa, 0xfe),
	BT_DATA_BYTES(BT_DATA_SVC_DATA16, 0xaa, 0xfe,           /* Eddystone ID */
		      0x10,                                     /* Frame type: URL */
		      0x00,                                     /* Power */
		      0x01,                                     /* http://www. */
		      'a', 't', 'm', 'o', 's', 'i', 'c', 0x07), /* .com */
	BT_DATA(BT_DATA_NAME_SHORTENED, CONFIG_REFBCN_SIMPLE_BEACON_SHORT_NAME,
		sizeof(CONFIG_REFBCN_SIMPLE_BEACON_SHORT_NAME) - 1)};
#endif

#if defined(CONFIG_REFBCN_SOCOFF_BEACON) || defined(CONFIG_REFBCN_SIMPLE_BEACON) ||                \
	defined(CONFIG_REFBCN_WURX_BEACON)
static struct bt_data const simple_bcn_sd[] = {
	BT_DATA(BT_DATA_NAME_COMPLETE, CONFIG_REFBCN_SIMPLE_BEACON_NAME,
		sizeof(CONFIG_REFBCN_SIMPLE_BEACON_NAME) - 1),
};
#endif

#ifdef CONFIG_REFBCN_SIMPLE_HARV_BEACON
static struct bt_data const data_sd[] = {
	BT_DATA(BT_DATA_NAME_COMPLETE, CONFIG_BT_DEVICE_NAME, sizeof(CONFIG_BT_DEVICE_NAME) - 1),
};
#elif defined(CONFIG_REFBCN_POWER_PROFILE)
static struct bt_data const data_ad[] = {
	BT_DATA_BYTES(BT_DATA_FLAGS, CONFIG_ADV_FLAGS),
	BT_DATA_BYTES(BT_DATA_UUID16_ALL, 0xaa, 0xfe),
	BT_DATA_BYTES(BT_DATA_SVC_DATA16, 0xaa, 0xfe,           /* Eddystone ID */
		      0x10,                                     /* Frame type: URL */
		      0x00,                                     /* Power */
		      0x01,                                     /* http://www. */
		      'a', 't', 'm', 'o', 's', 'i', 'c', 0x07), /* .com */
	BT_DATA(BT_DATA_NAME_SHORTENED, CONFIG_REFBCN_SHORT_NAME,
		sizeof(CONFIG_REFBCN_SHORT_NAME) - 1)};

static struct bt_data const data_sd[] = {
	BT_DATA(BT_DATA_NAME_COMPLETE, CONFIG_BT_DEVICE_NAME, sizeof(CONFIG_BT_DEVICE_NAME) - 1),
};
#elif defined(CONFIG_REFBCN_IBEACON)
/*
 * iBeacon advertisement data (non-scannable, no scan response)
 * UUID:  fb0b57a2-8228-44cd-913a-94a122ba1206
 * Major: 1
 * Minor: 2
 */
static struct bt_data const data_ad[] = {
	BT_DATA_BYTES(BT_DATA_FLAGS, CONFIG_ADV_FLAGS),
	BT_DATA_BYTES(BT_DATA_MANUFACTURER_DATA, 0x4c, 0x00, /* Apple Company ID */
		      0x02, 0x15,                            /* iBeacon type and length */
		      0xfb, 0x0b, 0x57, 0xa2,                /* UUID[15..12] */
		      0x82, 0x28,                            /* UUID[11..10] */
		      0x44, 0xcd,                            /* UUID[9..8] */
		      0x91, 0x3a,                            /* UUID[7..6] */
		      0x94, 0xa1, 0x22, 0xba, 0x12, 0x06,    /* UUID[5..0] */
		      0x00, 0x01,                            /* Major */
		      0x00, 0x02,                            /* Minor */
		      CONFIG_REFBCN_IBEACON_RSSI)            /* Calibrated RSSI @ 1m */
};

#elif defined(CONFIG_REFBCN_EXTENDED_SCN) || defined(CONFIG_REFBCN_LR_CODED) ||                    \
	defined(CONFIG_REFBCN_LR500_CODED)
/* Extended scannable beacon - scan response contains flags, name, and Eddystone URL */
static struct bt_data const data_sd[] = {
	BT_DATA_BYTES(BT_DATA_FLAGS, CONFIG_ADV_FLAGS),
	BT_DATA(BT_DATA_NAME_COMPLETE, CONFIG_BT_DEVICE_NAME, sizeof(CONFIG_BT_DEVICE_NAME) - 1),
	BT_DATA_BYTES(BT_DATA_UUID16_ALL, 0xaa, 0xfe),
	BT_DATA_BYTES(BT_DATA_SVC_DATA16, 0xaa, 0xfe,           /* Eddystone ID */
		      0x10,                                     /* Frame type: URL */
		      0x00,                                     /* Power */
		      0x01,                                     /* http://www. */
		      'a', 't', 'm', 'o', 's', 'i', 'c', 0x07), /* .com */
};
#elif defined(CONFIG_REFBCN_EXTENDED_ADV) || defined(CONFIG_REFBCN_EXTENDED_CON)
/* Extended advertising/connectable beacon - large Eddystone URL in advertising data */
/* Manufacturer-specific padding data to reach 242 bytes total (0x8b = 139 bytes) */
static uint8_t const mfg_pad[138] = {0};
static struct bt_data const data_ad[] = {
	BT_DATA_BYTES(BT_DATA_FLAGS, CONFIG_ADV_FLAGS),
	BT_DATA(BT_DATA_NAME_COMPLETE, CONFIG_BT_DEVICE_NAME, sizeof(CONFIG_BT_DEVICE_NAME) - 1),
	BT_DATA_BYTES(BT_DATA_UUID16_ALL, 0xaa, 0xfe),
	BT_DATA_BYTES(BT_DATA_SVC_DATA16, 0xaa, 0xfe, /* Eddystone UUID */
		      0x10,                           /* Frame type: URL */
		      0x00,                           /* Power */
		      0x01,                           /* http://www. */
		      'a', 't', 'm', 'o', 's', 'i', 'c', '.', 'c', 'o', 'm', '/', 'w', 'p', '-',
		      'c', 'o', 'n', 't', 'e', 'n', 't', '/', 'u', 'p', 'l', 'o', 'a', 'd', 's',
		      '/', '2', '0', '1', '8', '/', '1', '0', '/', 'D', 'a', 'v', 'i', 'd', '-',
		      'S', 'u', '-', '5', '0', '0', 'x', '5', '0', '0', '-', '3', '0', '0', 'x',
		      '3', '0', '0', '.', 'j', 'p', 'g'),
	/* PAD to 242 bytes with manufacturer-specific data */
	BT_DATA(BT_DATA_MANUFACTURER_DATA, mfg_pad, sizeof(mfg_pad)),
};
#elif defined(CONFIG_REFBCN_2M_SECONDARY)
/*
 * Extended advertising data:
 * - Complete Local Name: "ATMxxxx Lowest - Power"
 * - Service List: Eddystone UUID
 * - Service Data: Eddystone URL with long path
 * - PAD: Manufacturer Specific Data to fill up to 986 bytes total
 *
 * PAD length fields from TDS (data size = length field - 1):
 * - PAD1: 0x8b -> 138 bytes data
 * - PAD2: 0xf7 -> 246 bytes data
 * - PAD3: 0xf7 -> 246 bytes data
 * - PAD4: 0xf7 -> 246 bytes data
 */

/* Eddystone URL service data */
static uint8_t const ext_2m_eddystone_url[] = {
	0xaa, 0xfe,           /* Eddystone ID */
	0x10,                 /* Frame type: URL */
	0x00,                 /* Power */
	0x01,                 /* http://www. */
	/* "atmosic.com/wp-content/uploads/2018/10/David-Su-500x500-300x300.jpg" */
	'a', 't', 'm', 'o', 's', 'i', 'c', '.', 'c', 'o', 'm', '/',
	'w', 'p', '-', 'c', 'o', 'n', 't', 'e', 'n', 't', '/',
	'u', 'p', 'l', 'o', 'a', 'd', 's', '/',
	'2', '0', '1', '8', '/', '1', '0', '/',
	'D', 'a', 'v', 'i', 'd', '-', 'S', 'u', '-',
	'5', '0', '0', 'x', '5', '0', '0', '-',
	'3', '0', '0', 'x', '3', '0', '0', '.', 'j', 'p', 'g',
};

/*
 * PAD data: Manufacturer Specific Data (all zeros)
 *
 * AD structure: [length][type][data...] where data size = length - 1
 */
#define EXT_2M_PAD1_LEN_FIELD   0x8b
#define EXT_2M_PAD234_LEN_FIELD 0xf7

static uint8_t const ext_2m_pad1[EXT_2M_PAD1_LEN_FIELD - 1] = {0};
static uint8_t const ext_2m_pad2[EXT_2M_PAD234_LEN_FIELD - 1] = {0};
static uint8_t const ext_2m_pad3[EXT_2M_PAD234_LEN_FIELD - 1] = {0};
static uint8_t const ext_2m_pad4[EXT_2M_PAD234_LEN_FIELD - 1] = {0};

static struct bt_data const data_ad[] = {
	BT_DATA(BT_DATA_NAME_COMPLETE, CONFIG_BT_DEVICE_NAME, sizeof(CONFIG_BT_DEVICE_NAME) - 1),
	BT_DATA_BYTES(BT_DATA_UUID16_ALL, 0xaa, 0xfe),
	BT_DATA(BT_DATA_SVC_DATA16, ext_2m_eddystone_url, sizeof(ext_2m_eddystone_url)),
	BT_DATA(BT_DATA_MANUFACTURER_DATA, ext_2m_pad1, sizeof(ext_2m_pad1)),
	BT_DATA(BT_DATA_MANUFACTURER_DATA, ext_2m_pad2, sizeof(ext_2m_pad2)),
	BT_DATA(BT_DATA_MANUFACTURER_DATA, ext_2m_pad3, sizeof(ext_2m_pad3)),
	BT_DATA(BT_DATA_MANUFACTURER_DATA, ext_2m_pad4, sizeof(ext_2m_pad4)),
};
#endif

#if defined(CONFIG_ATM_TEST_UTIL)
#if defined(CONFIG_ATM_IS_FOR_SIM)
#define INDEFINITE_NUM_EVENTS 10
#else
#define INDEFINITE_NUM_EVENTS 40
#endif
#else
#define INDEFINITE_NUM_EVENTS 0
#endif

#if defined(CONFIG_REFBCN_SIMPLE_BEACON) || defined(CONFIG_REFBCN_SIMPLE_HARV_BEACON)
static struct bt_le_ext_adv_start_param const indefinite = {
	.num_events = INDEFINITE_NUM_EVENTS,
};
#endif
static struct bt_le_ext_adv_start_param const ext_adv_start_param = {
	.timeout = CONFIG_ADV_TOUT,
	.num_events = CONFIG_ADV_MAX_EVT,
};

static struct bt_le_ext_adv *adv_set;

#ifdef CONFIG_WURX
static const struct device *wurx_dev;
#endif

static void restart_adv(struct k_work *work)
{
	/* only happen when SOFT_OFF is not enabled */
	bt_le_ext_adv_start(adv_set, &ext_adv_start_param);
}

static void adv_sent_cb(struct bt_le_ext_adv *adv, struct bt_le_ext_adv_sent_info *info)
{
#ifdef CONFIG_REFBCN_WURX_BEACON
	LOG_INF("Advertising period complete");
	LOG_INF("Entering hibernation");
	LOG_INF("Waiting for WuRx wake-up signal...");
#endif

#ifdef CONFIG_SOFT_OFF
#ifndef CONFIG_SOFT_OFF_SUBID
#define CONFIG_SOFT_OFF_SUBID PM_ALL_SUBSTATES
#endif
	if (pm_policy_state_lock_is_active(PM_STATE_SOFT_OFF, CONFIG_SOFT_OFF_SUBID)) {
		pm_policy_state_lock_put(PM_STATE_SOFT_OFF, CONFIG_SOFT_OFF_SUBID);
	}
#endif
	if (CONFIG_ADV_RSTRT_DUR_MS) {
		static struct k_work_delayable work;
		k_work_init_delayable(&work, restart_adv);
		k_work_schedule(&work, K_MSEC(CONFIG_ADV_RSTRT_DUR_MS));
#if CONFIG_ATM_TEST_UTIL
	} else {
		ATM_TEST_PASSED();
#endif
	}
}

static struct bt_le_ext_adv_cb adv_cbs = {
	.sent = adv_sent_cb,
};

static int get_ad_sd(const struct bt_data **ad, const struct bt_data **sd, size_t *ad_len,
		     size_t *sd_len)
{
#ifdef CONFIG_REFBCN_SIMPLE_BEACON
	if (using_simple_beacon) {
		*ad = simple_bcn_ad;
		*sd = simple_bcn_sd;
		*ad_len = ARRAY_SIZE(simple_bcn_ad);
		*sd_len = ARRAY_SIZE(simple_bcn_sd);
		return 0;
	}
#endif
#if defined(CONFIG_REFBCN_POWER_PROFILE)
	*ad = data_ad;
	*sd = data_sd;
	*ad_len = ARRAY_SIZE(data_ad);
	*sd_len = ARRAY_SIZE(data_sd);
#elif defined(CONFIG_REFBCN_2M_SECONDARY)
	*ad = data_ad;
	*sd = NULL;
	*ad_len = ARRAY_SIZE(data_ad);
	*sd_len = 0;
#elif defined(CONFIG_REFBCN_SOCOFF_BEACON) || defined(CONFIG_REFBCN_WURX_BEACON)
	*ad = simple_bcn_ad;
	*sd = simple_bcn_sd;
	*ad_len = ARRAY_SIZE(simple_bcn_ad);
	*sd_len = ARRAY_SIZE(simple_bcn_sd);
#elif defined(CONFIG_REFBCN_SIMPLE_HARV_BEACON)
	*ad = simple_bcn_ad;
	*sd = data_sd;
	*ad_len = ARRAY_SIZE(simple_bcn_ad);
	*sd_len = ARRAY_SIZE(data_sd);
#elif defined(CONFIG_REFBCN_EXTENDED_SCN) || defined(CONFIG_REFBCN_LR_CODED) ||                    \
	defined(CONFIG_REFBCN_LR500_CODED)
	/* Extended scannable: no advertising data, only scan response */
	*ad = NULL;
	*sd = data_sd;
	*ad_len = 0;
	*sd_len = ARRAY_SIZE(data_sd);
#elif defined(CONFIG_REFBCN_EXTENDED_ADV) || defined(CONFIG_REFBCN_EXTENDED_CON) ||                \
	defined(CONFIG_REFBCN_IBEACON)
	/* Extended advertising/connectable: advertising data only, no scan response */
	/* iBeacon: non-scannable, no scan response */
	*ad = data_ad;
	*sd = NULL;
	*ad_len = ARRAY_SIZE(data_ad);
	*sd_len = 0;
#else
	return -EINVAL;
#endif
	return 0;
}

static int get_start_param(struct bt_le_ext_adv_start_param const **st_param)
{
#if defined(CONFIG_REFBCN_SIMPLE_HARV_BEACON)
	*st_param = &indefinite;
#elif defined(CONFIG_REFBCN_SIMPLE_BEACON)
	*st_param = using_simple_beacon ? &indefinite : &ext_adv_start_param;
#else
	*st_param = &ext_adv_start_param;
#endif
	return 0;
}

static void bt_ready(int err)
{
	if (err) {
		LOG_ERR("Bluetooth init failed (err %d)", err);
		return;
	}

	uint32_t CONFIG_ADV_OPTS = (0
#ifdef CONFIG_ADV_OPTS_CONN
				    | BT_LE_ADV_OPT_CONN
#endif
#ifdef CONFIG_ADV_OPTS_USE_IDENTITY
				    | BT_LE_ADV_OPT_USE_IDENTITY
#endif
#ifdef CONFIG_ADV_OPTS_DIR_MODE_LOW_DUTY
				    | BT_LE_ADV_OPT_DIR_MODE_LOW_DUTY
#endif
#ifdef CONFIG_ADV_OPTS_DIR_ADDR_RPA
				    | BT_LE_ADV_OPT_DIR_ADDR_RPA
#endif
#ifdef CONFIG_ADV_OPTS_FILTER_SCAN_REQ
				    | BT_LE_ADV_OPT_FILTER_SCAN_REQ
#endif
#ifdef CONFIG_ADV_OPTS_FILTER_CONN
				    | BT_LE_ADV_OPT_FILTER_CONN
#endif
#ifdef CONFIG_ADV_OPTS_NOTIFY_SCAN_REQ
				    | BT_LE_ADV_OPT_NOTIFY_SCAN_REQ
#endif
#ifdef CONFIG_ADV_OPTS_SCANNABLE
				    | BT_LE_ADV_OPT_SCANNABLE
#endif
#ifdef CONFIG_ADV_OPTS_EXT_ADV
				    | BT_LE_ADV_OPT_EXT_ADV
#endif
#ifdef CONFIG_ADV_OPTS_NO_2M
				    | BT_LE_ADV_OPT_NO_2M
#endif
#ifdef CONFIG_ADV_OPTS_CODED
				    | BT_LE_ADV_OPT_CODED
#endif
#ifdef CONFIG_ADV_OPTS_REQUIRE_S2_CODING
				    | BT_LE_ADV_OPT_REQUIRE_S2_CODING
#endif
#ifdef CONFIG_ADV_OPTS_ANONYMOUS
				    | BT_LE_ADV_OPT_ANONYMOUS
#endif
#ifdef CONFIG_ADV_OPTS_USE_TX_POWER
				    | BT_LE_ADV_OPT_USE_TX_POWER
#endif
#ifdef CONFIG_ADV_OPTS_DISABLE_CHAN_37
				    | BT_LE_ADV_OPT_DISABLE_CHAN_37
#endif
#ifdef CONFIG_ADV_OPTS_DISABLE_CHAN_38
				    | BT_LE_ADV_OPT_DISABLE_CHAN_38
#endif
#ifdef CONFIG_ADV_OPTS_DISABLE_CHAN_39
				    | BT_LE_ADV_OPT_DISABLE_CHAN_39
#endif
#ifdef CONFIG_ADV_OPTS_USE_NRPA
				    | BT_LE_ADV_OPT_USE_NRPA
#endif
	);

	uint16_t adv_intv = CONFIG_ADV_INTV;

#ifdef CONFIG_REFBCN_SIMPLE_BEACON
	if (using_simple_beacon) {
		CONFIG_ADV_OPTS = BT_LE_ADV_OPT_USE_IDENTITY | BT_LE_ADV_OPT_SCANNABLE;
		adv_intv = BT_GAP_MS_TO_ADV_INTERVAL(CONFIG_REFBCN_SIMPLE_BEACON_INTV);
	}
#endif
	LOG_INF("CONFIG_ADV_OPTS = %#" PRIx32, CONFIG_ADV_OPTS);
	LOG_INF("CONFIG_ADV_FLAGS = %#" PRIx32, CONFIG_ADV_FLAGS);

	/* Start advertising */
	err = bt_le_ext_adv_create(BT_LE_ADV_PARAM(CONFIG_ADV_OPTS, adv_intv, adv_intv, NULL),
				   &adv_cbs, &adv_set);

	if (err) {
		LOG_ERR("Failed to create advertising set (err %d)", err);
		return;
	}

	const struct bt_data *ad;
	const struct bt_data *sd;
	size_t ad_len;
	size_t sd_len;

	err = get_ad_sd(&ad, &sd, &ad_len, &sd_len);
	if (err) {
		LOG_ERR("Failed to get advertising data (err %d)", err);
		return;
	}

	err = bt_le_ext_adv_set_data(adv_set, ad, ad_len, sd, sd_len);

	if (err) {
		LOG_ERR("Failed to set advertising data (err %d)", err);
		return;
	}

	struct bt_le_ext_adv_start_param const *st_param;

	err = get_start_param(&st_param);
	if (err) {
		LOG_ERR("Failed to get start parameter(err %d)", err);
		return;
	}

	err = bt_le_ext_adv_start(adv_set, st_param);

	if (err) {
		LOG_ERR("Failed to start advertising (err %d)", err);
		return;
	}

	/* print the BT address */
	char addr_s[BT_ADDR_LE_STR_LEN];
	bt_addr_le_t addr = {0};
	size_t count = 1;

	bt_id_get(&addr, &count);
	bt_addr_le_to_str(&addr, addr_s, sizeof(addr_s));

#ifdef CONFIG_REFBCN_WURX_BEACON
	LOG_INF("WURX mode enabled - advertising for %d events before hibernation",
		CONFIG_ADV_MAX_EVT);
#endif
}

static void print_profile(void)
{
#ifdef CONFIG_REFBCN_SIMPLE_BEACON
	if (using_simple_beacon) {
		LOG_INF("<Simple Beacon Profile>");
		return;
	}
#endif
#ifdef CONFIG_REFBCN_POWER_PROFILE
	LOG_INF("<Power Profile>");
#elif defined(CONFIG_REFBCN_SOCOFF_BEACON)
	LOG_INF("<Socoff Beacon Profile>");
#elif defined(CONFIG_REFBCN_WURX_BEACON)
	LOG_INF("<WURX Beacon Profile>");
#elif defined(CONFIG_REFBCN_SIMPLE_HARV_BEACON)
	LOG_INF("<Simple Harvesting Beacon Profile>");
#elif defined(CONFIG_REFBCN_EXTENDED_SCN)
	LOG_INF("<Extended Scannable Beacon Profile>");
#elif defined(CONFIG_REFBCN_IBEACON)
	LOG_INF("<iBeacon Profile>");
#elif defined(CONFIG_REFBCN_EXTENDED_ADV)
	LOG_INF("<Extended Advertising Beacon Profile>");
#elif defined(CONFIG_REFBCN_EXTENDED_CON)
	LOG_INF("<Extended Connectable Beacon Profile>");
#elif defined(CONFIG_REFBCN_LR_CODED)
	LOG_INF("<Long Range Coded PHY Beacon Profile>");
#elif defined(CONFIG_REFBCN_2M_SECONDARY)
	LOG_INF("<2M Secondary Profile>");
#elif defined(CONFIG_REFBCN_LR500_CODED)
	LOG_INF("<Long Range 500kbps Coded PHY Beacon Profile>");
#endif
}

#if defined(CONFIG_REFBCN_SIMPLE_BEACON) && defined(LED_1_EXIST) && defined(CONFIG_PM)
static const struct gpio_dt_spec led = GPIO_DT_SPEC_GET(DT_NODELABEL(led0), gpios);
/*
 * For better visuals, we do not want too frequent LED toggles
 */
static int led_toggle_count;
#define LED_TOGGLE_SKIP_COUNT 30
static void notify_pm_state_exit(enum pm_state state)
{
	if (state == PM_STATE_SUSPEND_TO_RAM &&
			++led_toggle_count >= LED_TOGGLE_SKIP_COUNT) {
		gpio_pin_toggle_dt(&led);
		led_toggle_count = 0;
	}
}
#endif

#if PMU_BATT_LIION_HARV_ENABLED
static void batt_sample_cb(uint16_t lvl_bp, int32_t mvolt)
{
	LOG_INF("Battery: Level(%u%%) mVolt(%d)", lvl_bp / 100, mvolt);
}

static void batt_flag_set(uint8_t idx, bool value)
{
	ASSERT_INFO(idx < 16, idx, 16);

	int ret = retained_mem_read(retained_mem_dev, RETAINED_MEM_STATE_OFFSET,
				    (uint8_t *)&retained_state, sizeof(retained_state));
	if (ret) {
		LOG_INF("Failed to restore data from the retained memory");
		return;
	}
	LOG_INF("Battery flag set: %u %u", idx, value);
	if ((retained_state.batt & 0xFFFF0000) != BATT_PERSIST_TAG) {
		retained_state.batt = BATT_PERSIST_TAG;
	}
	if (value) {
		retained_state.batt |= (1 << idx);
	} else {
		retained_state.batt &= ~(1 << idx);
	}
	ret = retained_mem_write(retained_mem_dev, RETAINED_MEM_STATE_OFFSET,
				 (uint8_t *)&retained_state, sizeof(retained_state));
	if (ret) {
		LOG_ERR("Failed to save data to the retained memory (err %d)", ret);
	}
}

static bool batt_flag_get(uint8_t idx)
{
	bool flag;
	ASSERT_INFO(idx < 16, idx, 16);

	int ret = retained_mem_read(retained_mem_dev, RETAINED_MEM_STATE_OFFSET,
				    (uint8_t *)&retained_state, sizeof(retained_state));
	if (ret) {
		LOG_ERR("Failed to restore data from the retained memory (err %d)", ret);
		return false;
	}
	if ((retained_state.batt & 0xFFFF0000) != BATT_PERSIST_TAG) {
		retained_state.batt = BATT_PERSIST_TAG;
	}
	flag = !!(retained_state.batt & (1 << idx));
	ret = retained_mem_write(retained_mem_dev, RETAINED_MEM_STATE_OFFSET,
				 (uint8_t *)&retained_state, sizeof(retained_state));
	if (ret) {
		LOG_ERR("Failed to save data to the retained memory (err %d)", ret);
	}
	LOG_INF("Battery flag get: %u %u %u", idx, flag, retained_state.batt);

	return flag;
}

static void batt_state_set(dev_state_t state)
{
	LOG_INF("Battery state set: %u", state);
	batt_state = state;
}

static dev_state_t batt_state_get(void)
{
	LOG_INF("Battery state get: %u", batt_state);
	return batt_state;
}
#endif

int main(void)
{
#if defined(REFBCN_PROFILE_RETENTION) || PMU_BATT_LIION_HARV_ENABLED
	retained_mem_dev = DEVICE_DT_GET(DT_NODELABEL(retained_mem_hib));
	if (!device_is_ready(retained_mem_dev)) {
		LOG_ERR("Retained memory device not ready");
		return -ENODEV;
	}
#endif

#ifdef CONFIG_REFBCN_SIMPLE_BEACON
	bool profile_restored = false;
#ifdef REFBCN_PROFILE_RETENTION
	if (!is_boot_unretained()) {
		profile_restored = simple_beacon_profile_restore();
	}
#endif
	if (!profile_restored) {
		using_simple_beacon = is_boot_type(TYPE_POWER_ON);
#ifdef BUTTON_1_EXIST
		static const struct gpio_dt_spec button =
			GPIO_DT_SPEC_GET(DT_NODELABEL(button0), gpios);
		int ret = gpio_pin_configure_dt(&button, GPIO_INPUT);
		if (ret) {
			LOG_ERR("button error (err %d)", ret);
			return ret;
		}
		if (using_simple_beacon && gpio_pin_get_dt(&button)) {
			using_simple_beacon = false;
		}
#endif
#ifdef REFBCN_PROFILE_RETENTION
		simple_beacon_profile_save();
#endif
	}
#if defined(LED_1_EXIST) && defined(CONFIG_PM)
	if (using_simple_beacon) {
		int ret = gpio_pin_configure_dt(&led, GPIO_OUTPUT_INACTIVE);
		if (ret) {
			LOG_ERR("led error (err %d)", ret);
			return ret;
		}
		static struct pm_notifier notifier = {
			.state_exit = notify_pm_state_exit,
		};
		pm_notifier_register(&notifier);
	}
#endif
#endif // CONFIG_REFBCN_SIMPLE_BEACON
	print_profile();

#if PMU_BATT_LIION_HARV_ENABLED
	batt_state = is_boot_type(TYPE_SOCOFF) ? DEV_SOCOFF :
		((is_boot_type(TYPE_RESET) || is_boot_type(TYPE_POWER_ON)) ?
		DEV_RESET : DEV_HIB);

	static batt_cbs const cbs = {
		.state = {
			.get = batt_state_get,
			.set = batt_state_set,
		},
		.flag = {
			.set = batt_flag_set,
			.get = batt_flag_get,
		},
	};

	batt_model()->init(&cbs);
	if (!batt_model()->sample(batt_sample_cb)) {
		LOG_ERR("Battery monitoring failed");
	}
#endif

#ifdef CONFIG_SOFT_OFF
#define LOW_POWER_MODE (CONFIG_SOFT_OFF_SUBID ? "socoff" : "hib")
#else
#define LOW_POWER_MODE "ret"
#endif
	LOG_INF("Interval: %d Ms, Max events: %d, Low power: %s, Restart: %d ms",
		(CONFIG_ADV_INTV * 625) / 1000, CONFIG_ADV_MAX_EVT, LOW_POWER_MODE,
		CONFIG_ADV_RSTRT_DUR_MS);

#ifdef CONFIG_WURX
	LOG_INF("Starting Beacon with WURX support: %#x", boot_status());

	/* Get WURX device */
	wurx_dev = DEVICE_DT_GET(DT_NODELABEL(wurx));
	if (!device_is_ready(wurx_dev)) {
		LOG_INF("WuRx device not ready");
		return -ENODEV;
	}

	LOG_INF("WuRx device initialized");
#endif

	/* Initialize the Bluetooth Subsystem */
	int err = bt_enable(bt_ready);

	if (err) {
		LOG_ERR("Bluetooth init failed (err %d)", err);
	}

	return err;
}
```
