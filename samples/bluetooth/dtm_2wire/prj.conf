## CMakeLists.txt
```
# DTM 2-wire sample application
# Copyright (C) Atmosic 2025

cmake_minimum_required(VERSION 3.20.0)

find_package(Zephyr REQUIRED HINTS $ENV{ZEPHYR_BASE})
project(dtm_2wire)

target_sources(app PRIVATE src/main.c)
```

## sample.yaml
```
sample:
  description: DTM 2-wire Direct Test Mode sample
  name: DTM 2-wire
common:
  sysbuild: true
  tags:
    - bluetooth
    - dtm
tests:
  samples.bluetooth.dtm_2wire.atm: &dtm_2wire_console
    tags:
      - openair_release
    harness: console
    harness_config: &dtm_2wire_console_harness
      type: one_line
      regex:
        - "DTM 2-wire application started"
    extra_configs:
      - CONFIG_LOG=y
      - CONFIG_LOG_MODE_IMMEDIATE=y
  samples.bluetooth.dtm_2wire.atm.debug:
    tags:
      - openair_release
    harness: console
    harness_config: *dtm_2wire_console_harness
    extra_configs:
      - CONFIG_LOG=y
      - CONFIG_ASSERT=y
      - CONFIG_LOG_MODE_IMMEDIATE=y
      - CONFIG_DTM_2WIRE_LOG_LEVEL_DBG=y
  samples.bluetooth.dtm_2wire.atm.rx_dc_cal:
    <<: *dtm_2wire_console
    extra_configs:
      - CONFIG_LOG=y
      - CONFIG_LOG_MODE_IMMEDIATE=y
      - CONFIG_DTM_2WIRE_RESET_RX_DC_CAL=y
  samples.bluetooth.dtm_2wire.atm.pytest_single:
    harness: pytest
    timeout: 300
    harness_config:
      pytest_root: ["pytest/test_dtm_single.py"]
      pytest_dut_scope: class
      pytest_args:
        - "-v"
    extra_configs:
      - CONFIG_LOG=y
      - CONFIG_LOG_MODE_IMMEDIATE=y
  samples.bluetooth.dtm_2wire.atm.pytest_dual:
    harness: pytest
    timeout: 600
    tags:
      - two_dev
    harness_config:
      pytest_root: ["pytest/test_dtm_dual.py"]
      pytest_dut_scope: class
      pytest_args:
        - "-v"
    extra_configs:
      - CONFIG_LOG=y
      - CONFIG_LOG_MODE_IMMEDIATE=y
```

## prj.conf
```kconfig
# DTM 2-wire sample configuration

# Enable Bluetooth
CONFIG_BT=y

# Enable UART
CONFIG_UART_CONSOLE=y
CONFIG_UART_INTERRUPT_DRIVEN=y

# Enable DTM 2-wire library
CONFIG_DTM_2WIRE=y

# DTM 2-wire UART configuration
# UART device and baudrate are configured via devicetree overlay (app.overlay)

# Disable features not needed for DTM
CONFIG_BT_PERIPHERAL=n
CONFIG_BT_CENTRAL=n
CONFIG_BT_OBSERVER=n
CONFIG_BT_BROADCASTER=n

# Optimize for DTM testing
CONFIG_BT_BUF_EVT_RX_COUNT=8
CONFIG_BT_BUF_EVT_DISCARDABLE_COUNT=8
CONFIG_BT_BUF_CMD_TX_COUNT=8

# Disable power management for consistent timing
CONFIG_PM=n
```

## app.overlay
```dts
/*
 * Copyright (c) 2025-2026 Atmosic
 *
 * SPDX-License-Identifier: LicenseRef-Atmosic
 */

/ {
	chosen {
		zephyr,dtm-2wire-uart = &uart0;  /* or &uart1, &uart2, etc. */
	};
};

&uart0 {
	status = "okay";
	current-speed = <115200>;  /* Change baudrate: 115200, 57600, 38400, etc. */
	/delete-property/ hw-flow-control;  /* Disable hardware flow control for DTM 2-wire */
};

&uart1 {
	status = "okay";
	current-speed = <115200>;  /* Change baudrate: 115200, 57600, 38400, etc. */
	/delete-property/ hw-flow-control;  /* Disable hardware flow control for DTM 2-wire */
};
```

## src/main.c
```c
/*
 * Copyright (c) 2025-2026 Atmosic
 *
 * SPDX-License-Identifier: LicenseRef-Atmosic
 */

#include <zephyr/kernel.h>
#include <zephyr/logging/log.h>
#include <zephyr/bluetooth/bluetooth.h>

#include "dtm_mgr.h"

LOG_MODULE_REGISTER(dtm_2wire_main, CONFIG_DTM_2WIRE_LOG_LEVEL);

int main(void)
{
	int err;

	LOG_INF("Starting DTM 2-wire application");

	/* Initialize the Bluetooth Subsystem */
	err = bt_enable(NULL);
	if (err) {
		LOG_ERR("Bluetooth init failed (err %d)", err);
		return err;
	}

	LOG_INF("Bluetooth initialized");

	/* Initialize DTM manager */
	err = dtm_mgr_init();
	if (err) {
		LOG_ERR("DTM manager init failed (err %d)", err);
		return err;
	}

	LOG_INF("DTM 2-wire application started");

	return 0;
}
```
