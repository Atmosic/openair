## CMakeLists.txt
```
# SPDX-License-Identifier: Apache-2.0

cmake_minimum_required(VERSION 3.20.0)

find_package(Zephyr REQUIRED HINTS $ENV{ZEPHYR_BASE})
project(atm_ble_peripheral)

target_sources(app PRIVATE
  src/main.c
  src/periodic_adv.c
)

zephyr_library_include_directories(
        ${ZEPHYR_BASE}/samples/bluetooth
        ${CMAKE_CURRENT_LIST_DIR}/../include
)
```

## Kconfig
```
source "Kconfig.zephyr"

menu "Atmosic BLE peripheral mode"

config ATM_CONN_TX_POWER_DBM
    int "BLE connection TX power in DBM"
    default 6

config ATM_ADV_TX_POWER_DBM
    int "BLE advertise TX power in DBM"
    default 6

config ATM_DYN_TX_POWER_DBM
    int "Dynamic TX power in DBM used during connection for power adjustment"
    default 2

config ATM_BT_APP_PERIPHERAL_LOG_LEVEL
        int "Atmosic BLE application peripheral log level"
        default 3  # LOG_LEVEL_INF
        range 0 4

endmenu
```

## sample.yaml
```
sample:
  name: ATM BLE peripheral sample
common:
  tags:
    - atm_test_with_spe
    - bluetooth
    - role_peripheral
tests:
  samples.bluetooth.atm_ble.atm_ble_peripheral.atm:
    tags:
      - openair_release
    sysbuild: true
    harness: console
    harness_config:
      type: one_line
      regex:
      - "Advertising successfully started"
```

## prj.conf
```kconfig
CONFIG_BT=y
CONFIG_BT_PERIPHERAL=y
CONFIG_BT_DEVICE_NAME="ATM Peripheral"
CONFIG_BT_MAX_CONN=1

CONFIG_LOG=y
CONFIG_BT_L2CAP_LOG_LEVEL_DBG=n

CONFIG_BT_BUF_ACL_RX_SIZE=251
CONFIG_BT_L2CAP_TX_MTU=147

CONFIG_BT_USER_PHY_UPDATE=y
CONFIG_BT_PHY_UPDATE=y

CONFIG_ATM_VENDOR_API=y
CONFIG_VND_API_SET_ADV_TX_POWER=y
CONFIG_VND_API_SET_CON_TX_POWER=y
CONFIG_MAX_TX_PWR=6

CONFIG_ATM_CONN_TX_POWER_DBM=4
CONFIG_ATM_ADV_TX_POWER_DBM=4

CONFIG_BT_SUBRATING=y
```

## periodic_adv.conf
```kconfig
CONFIG_BT_EXT_ADV=y
CONFIG_BT_PER_ADV=y
CONFIG_BT_DEVICE_NAME="Test Periodic Advertising"
```

## src/main.c
```c
/*
 * Copyright (c) 2025-2026 Atmosic
 *
 * SPDX-License-Identifier: LicenseRef-Atmosic
 */

#include <zephyr/kernel.h>
#include <zephyr/logging/log.h>
#include <zephyr/bluetooth/bluetooth.h>
#include <zephyr/bluetooth/conn.h>
#include <zephyr/bluetooth/gatt.h>
#include <zephyr/bluetooth/hci.h>

#include "atm_vendor_api.h"
#include "atm_ble_headers.h"
#if defined(CONFIG_BT_PER_ADV)
#include "periodic_adv.h"
#endif

LOG_MODULE_REGISTER(atm_ble_peripheral, CONFIG_ATM_BT_APP_PERIPHERAL_LOG_LEVEL);

/* Buffer size for received data from central device */
#define DATA_BUF_SIZE    64

#if !defined(CONFIG_BT_PER_ADV)
static const struct bt_data ad[] = {
	BT_DATA_BYTES(BT_DATA_FLAGS, (BT_LE_AD_GENERAL | BT_LE_AD_NO_BREDR)),
	BT_DATA_BYTES(BT_DATA_UUID128_ALL, ATM_BLE_TEST_SERVICE_UUID_VAL),
};

static const struct bt_data sd[] = {
	BT_DATA(BT_DATA_NAME_COMPLETE, CONFIG_BT_DEVICE_NAME, sizeof(CONFIG_BT_DEVICE_NAME) - 1),
};
#endif

static struct bt_conn *default_conn;

/* GATT notification management */
static struct bt_gatt_attr *notify_crch;
static bool notify_enabled;

/* Connection handle for vendor API calls */
static uint16_t conn_hdl;

static void ccc_cfg_changed(const struct bt_gatt_attr *attr, uint16_t value);
static ssize_t custom_write_cb(struct bt_conn *conn, const struct bt_gatt_attr *attr,
			       const void *buf, uint16_t len, uint16_t offset, uint8_t flags);

BT_GATT_SERVICE_DEFINE(atm_ble_test, BT_GATT_PRIMARY_SERVICE(ATM_BLE_TEST_SERVICE_UUID),
		       BT_GATT_CHARACTERISTIC(ATM_WRITE_TEST_CHAR_UUID,
					      BT_GATT_CHRC_NOTIFY | BT_GATT_CHRC_WRITE,
					      BT_GATT_PERM_WRITE, NULL, custom_write_cb, NULL),
		       BT_GATT_CCC(ccc_cfg_changed, BT_GATT_PERM_READ | BT_GATT_PERM_WRITE), );

/**
 * @brief Callback for Client Characteristic Configuration changes
 *
 * @param attr GATT attribute that changed (the CCC descriptor)
 * @param value New CCC value (BT_GATT_CCC_NOTIFY=1 for enabled, 0 for disabled)
 */
static void ccc_cfg_changed(const struct bt_gatt_attr *attr, uint16_t value)
{
	ARG_UNUSED(attr);

	notify_enabled = (value == BT_GATT_CCC_NOTIFY);

	LOG_INF("MTU Test Update: notifications %s", notify_enabled ? "enabled" : "disabled");

	if (!notify_crch) {
		notify_crch =
			bt_gatt_find_by_uuid(atm_ble_test.attrs, 0xffff, ATM_WRITE_TEST_CHAR_UUID);
	}
}

/**
 * @brief GATT write callback for the custom characteristic
 *
 * @param conn Connection handle for the BLE connection
 * @param attr GATT attribute being written (the custom characteristic)
 * @param buf Data buffer received from central device
 * @param len Length of received data in bytes
 * @param offset Write offset (unused in this implementation)
 * @param flags Write flags (unused in this implementation)
 *
 * @return Number of bytes processed (always returns len)
 */
static ssize_t custom_write_cb(struct bt_conn *conn, const struct bt_gatt_attr *attr,
			       const void *buf, uint16_t len, uint16_t offset, uint8_t flags)
{
	char data[DATA_BUF_SIZE] = {0};
	char notify_data[] = STR_PERIPHERAL_TO_CENTRAL;

	memcpy(data, buf, len);
	data[len] = '\0';
	LOG_INF("Received from central:%s", data);

	if (strncmp(data, STR_TEST_COMPLETE, len) == 0) {
		LOG_INF("All process are done...");
		return len;
	}

	LOG_INF("Change the TX power in peripheral...");

	int err = atm_vendor_set_con_tx_power(conn_hdl, CONFIG_ATM_DYN_TX_POWER_DBM);
	if (err) {
		LOG_ERR("Failed to set connection TX power level %d", CONFIG_ATM_DYN_TX_POWER_DBM);
	} else {
		LOG_INF("Successfully set connection TX power level %d",
			CONFIG_ATM_DYN_TX_POWER_DBM);
	}

	/* Send notification back to central with confirmation message */
	bt_gatt_notify(default_conn, &atm_ble_test.attrs[2], notify_data, sizeof(notify_data));

	return len;
}

/**
 * @brief Callback for MTU update notification
 *
 * @param conn Connection handle for the BLE connection
 * @param tx Maximum transmission unit for TX direction in bytes
 * @param rx Maximum transmission unit for RX direction in bytes
 */
void mtu_updated(struct bt_conn *conn, uint16_t tx, uint16_t rx)
{
	LOG_INF("Updated MTU: TX: %d RX: %d bytes", tx, rx);
}

#if !defined(CONFIG_BT_PER_ADV)
static struct bt_gatt_cb gatt_callbacks = {
	.att_mtu_updated = mtu_updated,
};
#endif

/**
 * @brief Callback for BLE connection establishment
 *
 * @param conn Connection handle for the new BLE connection
 * @param err Error code (0 for success, non-zero for connection failure)
 */
static void connected(struct bt_conn *conn, uint8_t err)
{
	if (err != 0) {
		return;
	}

	char addr[BT_ADDR_LE_STR_LEN];

	bt_addr_le_to_str(bt_conn_get_dst(conn), addr, sizeof(addr));

	if (default_conn) {
		bt_conn_unref(default_conn);
	}
	default_conn = bt_conn_ref(conn);

	err = bt_hci_get_conn_handle(default_conn, &conn_hdl);
	if (err) {
		LOG_ERR("No connection handle (err %d)", err);
		return;
	}

	err = atm_vendor_set_con_tx_power(conn_hdl, CONFIG_ATM_CONN_TX_POWER_DBM);
	if (err) {
		LOG_ERR("Failed to set conn TX power level %d", CONFIG_ATM_CONN_TX_POWER_DBM);
	} else {
		LOG_INF("Successfully set conn TX power level %d", CONFIG_ATM_CONN_TX_POWER_DBM);
	}

	struct bt_conn_info conn_info;

	err = bt_conn_get_info(conn, &conn_info);
	if (err) {
		LOG_ERR("Failed to retrieve connection info, err = %d", err);
	} else {
		LOG_INF("connection parameters: type = %d, role = %d, id = %d", conn_info.type,
			conn_info.role, conn_info.id);
		LOG_INF("interval = %d, latency = %d, timeout = %d",
			conn_info.le.interval_us / BT_HCI_LE_INTERVAL_UNIT_US,
			conn_info.le.latency, conn_info.le.timeout);
	}

	LOG_INF("Connected: %s", addr);
}

/**
 * @brief Callback for BLE connection termination
 *
 * @param conn Connection handle for the terminated connection
 * @param reason HCI reason code for disconnection (see BT spec)
 */
static void disconnected(struct bt_conn *conn, uint8_t reason)
{
	char addr[BT_ADDR_LE_STR_LEN];

	if (conn != default_conn) {
		return;
	}

	bt_addr_le_to_str(bt_conn_get_dst(conn), addr, sizeof(addr));

	LOG_INF("Disconnected: %s, reason 0x%02x %s", addr, reason, bt_hci_err_to_str(reason));

	bt_conn_unref(conn);
	default_conn = NULL;
}

/**
 * @brief Callback for BLE PHY update completion
 *
 * @param conn Connection handle for the BLE connection
 * @param param PHY information containing new RX and TX PHY values
 */
static void le_phy_updated(struct bt_conn *conn, struct bt_conn_le_phy_info *param)
{
	LOG_INF("PHY UPDATED RX PHY %d, TX PHY %d", param->rx_phy, param->tx_phy);
}

/**
 * @brief Callback for BLE connection subrating changes
 *
 * @param conn Connection handle for the BLE connection
 * @param params Subrating parameters containing status, factor, latency, etc.
 *
 * @note BLE 5.3 feature - not supported on ATM33xx (BLE 5.2)
 */
static void subrate_changed_cb(struct bt_conn *conn,
			       const struct bt_conn_le_subrate_changed *params)
{
	LOG_INF("Subrate changed: ");
	LOG_INF("status = %d, factor = %d, continuation_number = %d, peri_latency = %d, "
		"sup_timeout = %d",
		params->status, params->factor, params->continuation_number,
		params->peripheral_latency, params->supervision_timeout);
}

BT_CONN_CB_DEFINE(conn_callbacks) = {.connected = connected,
				     .disconnected = disconnected,
				     .le_phy_updated = le_phy_updated,
				     .subrate_changed = subrate_changed_cb};

int main(void)
{
	int err;

	err = bt_enable(NULL);
	if (err) {
		LOG_ERR("Bluetooth init failed (err %d)", err);
		return 0;
	}

#if defined(CONFIG_BT_PER_ADV)
	periodic_adv();
#else
	bt_gatt_cb_register(&gatt_callbacks);

#if defined(CONFIG_SOC_SERIES_ATM34) || defined(CONFIG_SOC_SERIES_ATM5)
	err = atm_vendor_set_adv_tx_power(CONFIG_ATM_ADV_TX_POWER_DBM);
	if (err) {
		LOG_ERR("Failed to set adv TX power level %d", CONFIG_ATM_ADV_TX_POWER_DBM);
	} else {
		LOG_INF("Successfully set adv TX power level to %d", CONFIG_ATM_ADV_TX_POWER_DBM);
	}
#endif
	err = bt_le_adv_start(BT_LE_ADV_CONN_FAST_1, ad, ARRAY_SIZE(ad), sd, ARRAY_SIZE(sd));
	if (err) {
		LOG_ERR("Advertising failed to start (err %d)", err);
		return 0;
	}

	LOG_INF("Advertising successfully started");
#endif
	return 0;
}
```

## src/periodic_adv.c
```c
/*
 * Copyright (c) 2025-2026 Atmosic
 *
 * SPDX-License-Identifier: LicenseRef-Atmosic
 */

#include <zephyr/logging/log.h>
#include <zephyr/bluetooth/bluetooth.h>
#include "periodic_adv.h"

LOG_MODULE_REGISTER(periodic_adv, LOG_LEVEL_INF);

static uint8_t mfg_data[] = {0xff, 0xff, 0x00};

static const struct bt_data per_adv_ad[] = {
	BT_DATA(BT_DATA_MANUFACTURER_DATA, mfg_data, 3),
};

static const struct bt_data ad[] = {
	BT_DATA(BT_DATA_NAME_COMPLETE, CONFIG_BT_DEVICE_NAME, sizeof(CONFIG_BT_DEVICE_NAME) - 1),
};

int periodic_adv(void)
{
	struct bt_le_ext_adv *adv;
	int err;

	LOG_INF("Starting Periodic Advertising Demo\n");

	/* Create a non-connectable advertising set */
	err = bt_le_ext_adv_create(BT_LE_EXT_ADV_NCONN, NULL, &adv);
	if (err) {
		LOG_ERR("Failed to create advertising set (err %d)\n", err);
		return 0;
	}

	/* Set advertising data to have complete local name set */
	err = bt_le_ext_adv_set_data(adv, ad, ARRAY_SIZE(ad), NULL, 0);
	if (err) {
		LOG_ERR("Failed to set advertising data (err %d)\n", err);
		return 0;
	}

	/* Set periodic advertising parameters */
#ifdef CONFIG_SOC_SERIES_ATM33
	/*
	 * ATM33 does not support ADI
	 * could attempt a runtime check with BT_FEAT_LE_PER_ADV_ADI_SUPP()
	 */
	const struct bt_le_per_adv_param *per_adv_param = BT_LE_PER_ADV_DEFAULT;
#else
	const struct bt_le_per_adv_param *per_adv_param =
		BT_LE_PER_ADV_PARAM(BT_GAP_PER_ADV_SLOW_INT_MIN, BT_GAP_PER_ADV_SLOW_INT_MAX,
				    BT_LE_PER_ADV_OPT_INCLUDE_ADI);
#endif
	err = bt_le_per_adv_set_param(adv, per_adv_param);

	if (err) {
		LOG_ERR("Failed to set periodic advertising parameters"
			" (err %d)\n",
			err);
		return 0;
	}

	/* Enable Periodic Advertising */
	err = bt_le_per_adv_start(adv);
	if (err) {
		LOG_ERR("Failed to enable periodic advertising (err %d)\n", err);
		return 0;
	}

	while (true) {
		LOG_INF("Start Extended Advertising...");
		err = bt_le_ext_adv_start(adv, BT_LE_EXT_ADV_START_DEFAULT);
		if (err) {
			LOG_ERR("Failed to start extended advertising (err %d)", err);
			return 0;
		}
		LOG_INF("Done");

		for (int i = 0; i < 3; i++) {
			k_sleep(K_SECONDS(10));

			mfg_data[2]++;

			LOG_INF("Set Periodic Advertising Data...");
			err = bt_le_per_adv_set_data(adv, per_adv_ad, ARRAY_SIZE(per_adv_ad));
			if (err) {
				LOG_ERR("Failed (err %d)", err);
				return 0;
			}
			LOG_INF("Done");
		}

		k_sleep(K_SECONDS(10));

		LOG_INF("Stop Extended Advertising...");
		err = bt_le_ext_adv_stop(adv);
		if (err) {
			LOG_ERR("Failed to stop extended advertising (err %d)", err);
			return 0;
		}
		LOG_INF("Done");

		k_sleep(K_SECONDS(10));
	}
	return 0;
}
```

## src/periodic_adv.h
```c
/*
 * Copyright (c) 2025-2026 Atmosic
 *
 * SPDX-License-Identifier: LicenseRef-Atmosic
 */

#ifndef PERIODIC_ADV_H
#define PERIODIC_ADV_H

/**
 * @file periodic_adv.h
 * @brief Periodic advertising functionality for ATM BLE peripheral sample
 */

/**
 * @brief Start periodic advertising demonstration
 *
 * This function initializes and starts periodic advertising with extended
 * advertising support. It creates a non-connectable advertising set and
 * periodically updates the advertising data.
 *
 * @return 0 on success, non-zero on error
 */
int periodic_adv(void);

#endif /* PERIODIC_ADV_H */
```
