## CMakeLists.txt
```
# Copyright (c) Atmosic 2024-2026
#
# SPDX-License-Identifier: LicenseRef-Atmosic

cmake_minimum_required(VERSION 3.20.0)

find_package(Zephyr REQUIRED HINTS $ENV{ZEPHYR_BASE})
project(hci_vendor)

target_sources(app PRIVATE src/main.c)
```

## Kconfig
```
# Copyright (c) 2024-2026 Atmosic
#
# SPDX-License-Identifier: LicenseRef-Atmosic

source "Kconfig.zephyr"

config ATM_HCI_VENDOR
	bool "Atmosic HCI VENDOR module"
	default y

if ATM_HCI_VENDOR

module = ATM_HCI_VENDOR
module-str = atm_hci_vendor
source "subsys/logging/Kconfig.template.log_config"

endif # ATM_HCI_VENDOR
```

## sample.yaml
```
# Copyright (c) 2026 Atmosic
#
# SPDX-License-Identifier: LicenseRef-Atmosic

sample:
  description: Atmosic HCI vendor sample
  name: Atmosic HCI vendor sample
common:
  tags:
    - bluetooth
    - role_all
  harness: console
  harness_config:
    type: one_line
    regex:
      - "atm_hci_init done"
  # The commands enabled by default call into atm_vendor_drv entry points that
  # only the HALs declaring this feature implement.
  depends_on:
    - atm_vendor_drv
  sysbuild: true
  extra_configs:
    - CONFIG_BT_SETTINGS=y
tests:
  samples.bluetooth.hci_vendor.atm.pd50:
    tags:
      - openair_release
    extra_configs:
      - CONFIG_ATMWSTK_PD50=y
  samples.bluetooth.hci_vendor.atm: &base_config
    tags:
      - openair_release
    extra_args:
      - SB_CONFIG_DTS_EXTRA_SELECT_CPD200_HINT=y
  samples.bluetooth.hci_vendor.atm.rx_dc_cal:
    <<: *base_config
    extra_configs:
      - CONFIG_ATM_HCI_RESET_RX_DC_CAL=y
  samples.bluetooth.hci_vendor.atm.gcov:
    <<: *base_config
    tags:
      - gcov
    depends_on:
      - gcov_capable
    timeout: 180
    extra_configs:
      - CONFIG_UU_TEST_OPENAIR="atm_vendor.c;atm_hci_uart.c"
  samples.bluetooth.hci_vendor.atm.mcuboot:
    tags:
      - mcuboot
    extra_args:
      - SB_CONFIG_BOOTLOADER_MCUBOOT=y
      - SB_CONFIG_BOOT_SIGNATURE_TYPE_ECDSA_P256=y
      - SB_CONFIG_MCUBOOT_MODE_SWAP_USING_OFFSET=y
      - SB_CONFIG_DTS_EXTRA_SELECT_CPD200_HINT=y
  samples.bluetooth.hci_vendor.atm.mcuboot.pd50:
    tags:
      - mcuboot
    extra_args:
      - SB_CONFIG_BOOTLOADER_MCUBOOT=y
      - SB_CONFIG_BOOT_SIGNATURE_TYPE_ECDSA_P256=y
      - SB_CONFIG_MCUBOOT_MODE_SWAP_USING_OFFSET=y
      - SB_CONFIG_ATMWSTK_PD50=y
  samples.bluetooth.hci_vendor.atm.mcuboot.sec_debug:
    tags:
      - mcuboot
      - sec_debug
    # CONFIG_ATM_MCUBOOT_SECURE_DEBUG depends on the sec-debug node, which only
    # exists on SoCs that implement the secure debug registers.
    filter: dt_compat_enabled("atmosic,sec-debug")
    extra_args:
      - SB_CONFIG_BOOTLOADER_MCUBOOT=y
      - SB_CONFIG_BOOT_SIGNATURE_TYPE_ECDSA_P256=y
      - SB_CONFIG_MCUBOOT_MODE_SWAP_USING_OFFSET=y
      - SB_CONFIG_DTS_EXTRA_SELECT_CPD200_HINT=y
      - SB_ATM_DTS_EXTRA_CPPFLAGS='-DUSE_ATM_SECURE_DEBUG'
      - mcuboot_CONFIG_ATM_MCUBOOT_SECURE_DEBUG=y
      - mcuboot_CONFIG_ATM_MCUBOOT_UART_DEBUG_AUTH_TIMEOUT_MS=50000
  samples.bluetooth.hci_vendor.atm.mcuboot.sec_debug.pd50:
    tags:
      - mcuboot
      - sec_debug
    # CONFIG_ATM_MCUBOOT_SECURE_DEBUG depends on the sec-debug node, which only
    # exists on SoCs that implement the secure debug registers.
    filter: dt_compat_enabled("atmosic,sec-debug")
    extra_args:
      - SB_CONFIG_BOOTLOADER_MCUBOOT=y
      - SB_CONFIG_BOOT_SIGNATURE_TYPE_ECDSA_P256=y
      - SB_CONFIG_MCUBOOT_MODE_SWAP_USING_OFFSET=y
      - SB_CONFIG_ATMWSTK_PD50=y
      - SB_ATM_DTS_EXTRA_CPPFLAGS='-DUSE_ATM_SECURE_DEBUG'
      - mcuboot_CONFIG_ATM_MCUBOOT_SECURE_DEBUG=y
      - mcuboot_CONFIG_ATM_MCUBOOT_UART_DEBUG_AUTH_TIMEOUT_MS=50000
  # Legacy configurations for backward compatibility
  samples.bluetooth.hci_vendor.atm.mcuboot.legacy_scratch:
    tags:
      - mcuboot
      - legacy
    extra_args:
      - SB_CONFIG_BOOTLOADER_MCUBOOT=y
      - SB_CONFIG_BOOT_SIGNATURE_TYPE_ECDSA_P256=y
      - SB_CONFIG_MCUBOOT_MODE_SWAP_SCRATCH=y
      - SB_ATM_DTS_EXTRA_CPPFLAGS="-DATM_MCUBOOT_SWAP_WITH_OFFSET=0"
      - SB_CONFIG_DTS_EXTRA_SELECT_CPD200_HINT=y
  samples.bluetooth.hci_vendor.atm.system_level_test:
    tags:
      - bluetooth
      - psm
      - gpio
    harness: pytest
    timeout: 480
    harness_config:
      # Files run in listed order; the PSM file is last so test_psm_hibernate
      # (its final method) is the last test case called. With pytest_dut_scope
      # class each file's class gets a fresh flash + boot, so the terminal
      # hibernate case runs on its own cold boot.
      pytest_root:
        - "pytest/test_hci_vendor_gpio.py"
        - "pytest/test_hci_vendor_psm.py"
      pytest_dut_scope: class
      pytest_args:
        - "-v"
    extra_args:
      - SB_CONFIG_DTS_EXTRA_SELECT_CPD200_HINT=y
      - EXTRA_DTC_OVERLAY_FILE=system_level_test.overlay
      - OVERLAY_CONFIG=system_level_test.conf
```

## prj.conf
```kconfig
CONFIG_SERIAL=y
CONFIG_UART_INTERRUPT_DRIVEN=y
CONFIG_BT=y
CONFIG_LOG=y
CONFIG_LOG_BACKEND_SHOW_COLOR=n
CONFIG_LOG_MODE_IMMEDIATE=y
CONFIG_BT_HCI_RAW=y
CONFIG_BT_HCI_RAW_H4=y
CONFIG_BT_HCI_RAW_H4_ENABLE=y
CONFIG_BT_HCI_RAW_CMD_EXT=y

# For ATM vendor
CONFIG_BT_BUF_CMD_TX_SIZE=140
CONFIG_ATM_VENDOR=y
# Disable BLE driver sleep mode, so the radio won't power down and lose settings
# from tools.
CONFIG_ATM_BLE_DRIVER_SLEEP=n

# Increase UART PM RX thread stack size to prevent stack overflow
CONFIG_UART_ATM_PM_RX_THREAD_STACK_SIZE=2048
```

## system_level_test.conf
```kconfig
# Copyright (c) 2026 Atmosic
#
# SPDX-License-Identifier: LicenseRef-Atmosic

CONFIG_ATM_BLE_DRIVER_SLEEP=y
CONFIG_ATM_EUI_ALLOW_RANDOM=y
CONFIG_VND_PSM=y
CONFIG_VND_GPIO_TEST=y
```

## app.overlay
```dts
/* Copyright (c) 2025-2026 Atmosic
 *
 * SPDX-License-Identifier: LicenseRef-Atmosic
 */

&uart0 {
	current-speed = <2000000>;
	status = "okay";
	hw-flow-control;
};
```

## system_level_test.overlay
```dts
/* Copyright (c) 2026 Atmosic
 *
 * SPDX-License-Identifier: LicenseRef-Atmosic
 */

&cpu0 {
    cpu-power-states = <&idle &sleep &retain &hibernate &soc_off>;
};

&soc_off {
	status = "okay";
};

&uart0 {
	/delete-property/ rts-pin;
	/delete-property/ cts-pin;
	/delete-property/ hw-flow-control;
	current-speed = <2000000>;
	status = "okay";
};
```

## boards/ATMEVK-3405-WQK-5_ns.overlay
```dts
/*
 * Copyright (c) 2025 Atmosic
 *
 * SPDX-License-Identifier: Apache-2.0
 */

&uart0 {
	current-speed = <2000000>;
	status = "okay";
	hw-flow-control;
};
```

## boards/ATMEVK-3405-YBV-5_ns.overlay
```dts
/*
 * Copyright (c) 2024 Atmosic
 *
 * SPDX-License-Identifier: Apache-2.0
 */

&uart0 {
	current-speed = <2000000>;
	status = "okay";
	hw-flow-control;
};
```

## boards/ATMEVK-3430e-YQN-5_ns.overlay
```dts
/*
 * The confidential and proprietary information contained in this file may
 * only be used by a person authorised under and to the extent permitted
 * by a subsisting licensing agreement from Atmosic.
 *
 * Copyright (c) Atmosic 2024
 *
 * This entire notice must be reproduced on all copies of this file
 * and copies of this file may only be made by a person if such person is
 * permitted to do so under the terms of a subsisting license agreement
 * from Atmosic.
 */

&uart0 {
	current-speed = <2000000>;
	status = "okay";
	hw-flow-control;
};
```

## boards/ATMEVK-M2251-02.overlay
```dts
/*
 * Copyright (c) 2024 Atmosic
 *
 * SPDX-License-Identifier: Apache-2.0
 */

&uart0 {
	current-speed = <460800>;
	status = "okay";
	hw-flow-control;
};
```

## src/main.c
```c
/*
 * Copyright (c) 2025-2026 Atmosic
 *
 * SPDX-License-Identifier: LicenseRef-Atmosic
 */

/* main.c - Application main entry point */

#include <errno.h>
#include <stddef.h>
#include <stdio.h>
#include <string.h>
#include <zephyr/kernel.h>
#include <zephyr/logging/log.h>
#include "arch.h"
#include "atm_vendor.h"

#define LOG_HCI_VENDOR_MODULE_NAME hci_vendor
LOG_MODULE_REGISTER(LOG_HCI_VENDOR_MODULE_NAME, CONFIG_ATM_HCI_VENDOR_LOG_LEVEL);

void hci_vendor_init(void)
{
#ifdef CONFIG_RUNTIME_EN_HCI_VENDOR
    if (!atm_vendor_get_hci_vendor_en()) {
	atm_vendor_enter_hci_vendor_mode();
    }
#endif
    atm_vendor_init();
}

int main(void)
{
    hci_vendor_init();
    return 0;
}
```
