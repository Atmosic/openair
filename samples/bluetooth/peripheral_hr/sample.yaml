## samples/bluetooth/peripheral_hr/sample.yaml
```yaml
sample:
  name: Bluetooth Peripheral HR
common:
  tags:
    - bluetooth
    - role_peripheral
tests:
  samples.bluetooth.peripheral_hr.atm:
    tags:
      - openair_release
    sysbuild: true
    harness: console
    harness_config:
      type: one_line
      regex:
        - "Advertising successfully started"
```

## samples/bluetooth/peripheral_identity/sample.yaml
```yaml
sample:
  name: Bluetooth Peripheral Identity
common:
  tags:
    - bluetooth
    - role_peripheral
tests:
  samples.bluetooth.peripheral_identity.atm:
    sysbuild: true
    harness: console
    harness_config:
      type: one_line
      regex:
        - "Advertising successfully started"
```

## samples/bluetooth/scan_adv/sample.yaml
```yaml
sample:
  name: Bluetooth Scan & Advertise
  description: Demonstrates combined Bluetooth LE Broadcaster & Observer role functionality
common:
  sysbuild: true
  harness: console
  tags:
    - bluetooth
    - role_central
tests:
  samples.bluetooth.scan_adv.atm:
    tags:
      - openair_release
    harness_config:
      type: one_line
      regex:
        - "Starting Scanner/Advertiser Demo"
    extra_args:
      - SB_CONFIG_DTS_EXTRA_SELECT_CPD200_HINT=y
  samples.bluetooth.scan_adv.atm.dump_hci:
    harness_config:
      type: one_line
      regex:
        - "CMD COMPL:"
    extra_args:
      - SB_CONFIG_DTS_EXTRA_SELECT_CPD200_HINT=y
    extra_configs:
      - CONFIG_ATM_BLE_DUMP_HCI=y
      - CONFIG_LOG_BUFFER_SIZE=8192
```

## samples/nsc_hello_world/sample.yaml
```yaml
sample:
  description: Sample demonstrating adding NS-callable functions
  name: NSC hello world
common:
  tags:
    - introduction
    - requires_trustzone
  harness: console
  harness_config:
    type: one_line
    regex:
      - "Hello from Secure World"
  sysbuild: true
tests:
  sample.nsc_hello_world: {}
  samples.nsc_hello_world.atm:
    extra_args:
      - SB_CONFIG_SPE=y
      - spe_CONFIG_ATM_ENABLE_NSC_EXAMPLE=y
```

## samples/subsys/mgmt/mcumgr/smp_svr/sample.yaml
```yaml
common:
  tags:
    - atm_test_with_spe
  extra_args:
    - EXTRA_CONF_FILE="bt.conf;serial.conf;shell-mgmt.conf"
tests:
  samples.subsys.mgmt.mcumgr.smp_svr.atm.mcuboot:
    sysbuild: true
    harness: console
    harness_config:
      type: one_line
      regex:
        - smp_sample
    tags:
      - mcuboot
      - openair_release_mcuboot
    extra_args:
      - SB_CONFIG_BOOTLOADER_MCUBOOT=y
      - SB_CONFIG_BOOT_SIGNATURE_TYPE_ECDSA_P256=y
      - SB_CONFIG_MCUBOOT_MODE_SWAP_USING_OFFSET=y
  samples.subsys.mgmt.mcumgr.smp_svr.atm.mcuboot.legacy_scratch:
    sysbuild: true
    harness: console
    harness_config:
      type: one_line
      regex:
        - smp_sample
    tags:
      - mcuboot
      - legacy
    extra_args:
      - SB_CONFIG_BOOTLOADER_MCUBOOT=y
      - SB_CONFIG_BOOT_SIGNATURE_TYPE_ECDSA_P256=y
      - SB_CONFIG_MCUBOOT_MODE_SWAP_SCRATCH=y
      - SB_ATM_DTS_EXTRA_CPPFLAGS="-DATM_MCUBOOT_SWAP_WITH_OFFSET=0"
  samples.subsys.mgmt.mcumgr.smp_svr.atm.mcuboot.overwrite:
    sysbuild: true
    harness: console
    harness_config:
      type: one_line
      regex:
        - smp_sample
    tags:
      - mcuboot
    extra_args:
      - SB_CONFIG_BOOTLOADER_MCUBOOT=y
      - SB_CONFIG_BOOT_SIGNATURE_TYPE_ECDSA_P256=y
      - SB_CONFIG_MCUBOOT_MODE_OVERWRITE_ONLY=y
      - SB_ATM_DTS_EXTRA_CPPFLAGS="-DATM_MCUBOOT_SCRATCH_SIZE=0;-DATM_MCUBOOT_SWAP_WITH_OFFSET=0"
  samples.subsys.mgmt.mcumgr.smp_svr.atm.mcuboot.flash_xip:
    sysbuild: true
    harness: console
    harness_config:
      type: one_line
      regex:
        - smp_sample
    tags:
      - mcuboot
      - flash_xip
    depends_on:
      - flash
      - rram
      - xip
    extra_args:
      - SB_CONFIG_BOOTLOADER_MCUBOOT=y
      - SB_CONFIG_BOOT_SIGNATURE_TYPE_ECDSA_P256=y
      - SB_CONFIG_MCUBOOT_MODE_SWAP_USING_OFFSET=y
      - SB_ATM_DTS_EXTRA_CPPFLAGS="-DATM_APP_FLASH_XIP"
      - mcuboot_CONFIG_UPDATEABLE_IMAGE_NUMBER=2
    extra_configs:
      - CONFIG_MCUMGR_GRP_IMG_ALLOW_CONFIRM_NON_ACTIVE_IMAGE_ANY=y
  samples.subsys.mgmt.mcumgr.smp_svr.atm.mcuboot.flash_xip.legacy_scratch:
    sysbuild: true
    harness: console
    harness_config:
      type: one_line
      regex:
        - smp_sample
    tags:
      - mcuboot
      - flash_xip
      - legacy
    depends_on:
      - flash
      - rram
      - xip
    extra_args:
      - SB_CONFIG_BOOTLOADER_MCUBOOT=y
      - SB_CONFIG_BOOT_SIGNATURE_TYPE_ECDSA_P256=y
      - SB_CONFIG_MCUBOOT_MODE_SWAP_SCRATCH=y
      - SB_ATM_DTS_EXTRA_CPPFLAGS="-DATM_APP_FLASH_XIP;-DATM_MCUBOOT_SWAP_WITH_OFFSET=0"
      - mcuboot_CONFIG_UPDATEABLE_IMAGE_NUMBER=2
    extra_configs:
      - CONFIG_MCUMGR_GRP_IMG_ALLOW_CONFIRM_NON_ACTIVE_IMAGE_ANY=y
  samples.subsys.mgmt.mcumgr.smp_svr.atm.mcuboot.flash_xip.overwrite:
    sysbuild: true
    harness: console
    harness_config:
      type: one_line
      regex:
        - smp_sample
    tags:
      - mcuboot
      - flash_xip
      - overwrite
    depends_on:
      - flash
      - rram
      - xip
    extra_args:
      - SB_CONFIG_BOOTLOADER_MCUBOOT=y
      - SB_CONFIG_BOOT_SIGNATURE_TYPE_ECDSA_P256=y
      - SB_CONFIG_MCUBOOT_MODE_OVERWRITE_ONLY=y
      - SB_ATM_DTS_EXTRA_CPPFLAGS="-DATM_APP_FLASH_XIP;-DATM_MCUBOOT_SCRATCH_SIZE=0;-DATM_MCUBOOT_SWAP_WITH_OFFSET=0"
      - mcuboot_CONFIG_UPDATEABLE_IMAGE_NUMBER=2
      - mcuboot_CONFIG_MCUBOOT_VERIFY_IMG_ADDRESS=n
    extra_configs:
      - CONFIG_MCUMGR_GRP_IMG_ALLOW_CONFIRM_NON_ACTIVE_IMAGE_ANY=y
```

## samples/sysbuild/hello_world/sample.yaml
```yaml
sample:
  description: Sysbuild Hello World sample, the simplest Zephyr
    introduction
  name: Sysbuild
common:
  sysbuild: true
  harness: console
  harness_config:
    type: one_line
    regex:
      - "Atmosic Sysbuild Hello World"
  tags:
    - introduction
    - atm_test_with_spe
tests:
  samples.sysbuild.hello_world.atm:
    tags:
      - openair_release
  samples.sysbuild.hello_world.atm.mcuboot:
    tags:
      - mcuboot
      - openair_release_mcuboot
    extra_args:
      - SB_CONFIG_BOOTLOADER_MCUBOOT=y
      - SB_CONFIG_BOOT_SIGNATURE_TYPE_ECDSA_P256=y
      - SB_CONFIG_MCUBOOT_MODE_SWAP_USING_OFFSET=y
  samples.sysbuild.hello_world.atm.mcuboot.legacy_scratch:
    tags:
      - mcuboot
      - legacy
    extra_args:
      - SB_CONFIG_BOOTLOADER_MCUBOOT=y
      - SB_CONFIG_BOOT_SIGNATURE_TYPE_ECDSA_P256=y
      - SB_CONFIG_MCUBOOT_MODE_SWAP_SCRATCH=y
      - SB_ATM_DTS_EXTRA_CPPFLAGS="-DATM_MCUBOOT_SWAP_WITH_OFFSET=0"
  samples.sysbuild.hello_world.atm.mcuboot.overwrite:
    tags:
      - mcuboot
    extra_args:
      - SB_CONFIG_BOOTLOADER_MCUBOOT=y
      - SB_CONFIG_BOOT_SIGNATURE_TYPE_ECDSA_P256=y
      - SB_CONFIG_MCUBOOT_MODE_OVERWRITE_ONLY=y
  samples.sysbuild.hello_world.atm.spe.flash_xip:
    tags:
      - flash_xip
    depends_on:
      - flash
      - rram
      - xip
    extra_args:
      - SB_CONFIG_SPE=y
      - SB_ATM_DTS_EXTRA_CPPFLAGS="-DATM_APP_FLASH_XIP"
  samples.sysbuild.hello_world.atm.mcuboot.sec_debug:
    harness: pytest
    tags:
      - mcuboot
      - sec_debug
    extra_args:
      - SB_CONFIG_BOOTLOADER_MCUBOOT=y
      - SB_CONFIG_BOOT_SIGNATURE_TYPE_ECDSA_P256=y
      - SB_ATM_DTS_EXTRA_CPPFLAGS='-DUSE_ATM_SECURE_DEBUG'
      - mcuboot_CONFIG_ATM_MCUBOOT_SECURE_DEBUG=y
      - mcuboot_CONFIG_ATM_MCUBOOT_UART_DEBUG_AUTH_TIMEOUT_MS=50000
```

## soc/atmosic/ATM33/Kconfig.defconfig
```kconfig
# Copyright (c) 2021-2026 Atmosic
#
# SPDX-License-Identifier: LicenseRef-Atmosic

if SOC_SERIES_ATM33

# Get clock frequency from DTS sysclk node to support INIT_BP_FREQ for all domains
config SYS_CLOCK_HW_CYCLES_PER_SEC
	int
	default $(dt_nodelabel_int_prop,sysclk,clock-frequency)

config NUM_IRQS
	int
	default 128

config HW_STACK_PROTECTION
	default y

config CORTEX_M_NULL_POINTER_EXCEPTION_PAGE_SIZE
	hex "Size of paged unmapped to implement null pointer detection"
	default $(dt_nodelabel_reg_size_hex,rom_null_page)
	depends on $(dt_nodelabel_exists,rom_null_page)
	depends on NULL_POINTER_EXCEPTION_DETECTION_MPU

endif # SOC_SERIES_ATM33
```

## soc/atmosic/ATM5/Kconfig
```kconfig
# Copyright (c) 2024-2026 Atmosic
#
# SPDX-License-Identifier: LicenseRef-Atmosic

config SOC_SERIES_ATM5
	select ARM
	select CPU_CORTEX_M33
	select CPU_HAS_ARM_SAU
	select CPU_HAS_ARM_MPU
	select CPU_HAS_FPU
	select FPU
	select ARMV8_M_DSP
	select CPU_HAS_TEE
	select HAS_PM
	select HAS_POWEROFF if PM && $(dt_path_enabled,/power-states/soc_off)
	select SOC_ATM_SYSTICK_COUNTFLAG_WORKAROUND
	help
	  Enable support for ATM5 series
```

## soc/atmosic/ATM5/Kconfig.defconfig
```kconfig
# Copyright (c) 2024-2026 Atmosic
#
# SPDX-License-Identifier: LicenseRef-Atmosic

if SOC_SERIES_ATM5

config ATM_LL_HEAP_SIZE
	int "LL heap size"
	default 40388 if SOC_ATM5XXX_2 && ATMWSTK_PD50
	default 60388 if SOC_ATM5XXX_2 && ATMWSTK_CPD200
	default 80388 if SOC_ATM5XXX_2
	default 80572

config SYS_CLOCK_HW_CYCLES_PER_SEC
	int
	default 16000000 if $(dt_nodelabel_bool_prop,systick,external-clock-source)
	default 32000000

config NUM_IRQS
	int
	default 128

config HW_STACK_PROTECTION
	default y

config CORTEX_M_NULL_POINTER_EXCEPTION_PAGE_SIZE
	hex "Size of paged unmapped to implement null pointer detection"
	default $(dt_nodelabel_reg_size_hex,rom_null_page)
	depends on $(dt_nodelabel_exists,rom_null_page)
	depends on NULL_POINTER_EXCEPTION_DETECTION_MPU

config ATM_ANTENNA_RAM_ONLY_FOR_PM
	default y

config ATM_ENA_BLE_CS_MANDATORY_TIMING_ONLY
	default y

endif # SOC_SERIES_ATM5
```

## soc/atmosic/ATM5/Kconfig.soc
```kconfig
# Copyright (c) 2024-2026 Atmosic
#
# SPDX-License-Identifier: LicenseRef-Atmosic

config SOC_SERIES_ATM5
	bool
	select SOC_FAMILY_ATM

config SOC_SERIES
	default "ATM5" if SOC_SERIES_ATM5

config SOC_ATM5XXX_2
	bool
	select SOC_SERIES_ATM5

config SOC
	default "ATM5xxx-2" if SOC_ATM5XXX_2
```

## soc/atmosic/Kconfig
```kconfig
# Copyright (c) 2021-2026 Atmosic
#
# SPDX-License-Identifier: LicenseRef-Atmosic

if SOC_FAMILY_ATM

rsource "*/Kconfig"

config SOC_ATM_SYSTICK_COUNTFLAG_WORKAROUND
	bool
	help
	  Workaround for a SysTick COUNTFLAG race condition present on certain
	  Atmosic SoC series.  When the counter naturally reaches 0 at the
	  same moment software writes VAL=0, the hardware re-asserts COUNTFLAG
	  even though the counter was just reloaded, causing a spurious ~1 s
	  time jump in the tickless kernel.  Selected automatically by every
	  SoC series that carries the hardware defect; not user-configurable.

endif # SOC_FAMILY_ATM
```

## soc/atmosic/Kconfig.soc
```kconfig
# Copyright (c) 2021-2026 Atmosic
#
# SPDX-License-Identifier: LicenseRef-Atmosic

config SOC_FAMILY_ATM
	bool

config SOC_FAMILY
	default "atmosic" if SOC_FAMILY_ATM

rsource "*/Kconfig.soc"
```
