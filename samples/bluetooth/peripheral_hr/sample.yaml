## subsys/bluetooth/services/atm_bt_tput/Kconfig
```kconfig
# SPDX-License-Identifier: Apache-2.0
# Copyright (c) 2025-2026 Atmosic

config ATM_BT_TPUTP
	bool "Support for BLE throughput service"

config ATM_TPUT_TEST_DATA_LEN_PER_PACKET
	int "Data length per packet in ble throughput test"
	default 243

config ATM_TPUT_TEST_PACKET_COUNT
	int "Numer of packets in ble throughput test"
	default 1000

config ATM_TPUT_AUTO_TEST
	bool "Enable auto test for ble throughput test"
	default y if ZTEST
	help
	  Enable automatic test mode for BLE throughput testing.
	  Central device automatically sends end test command to peripheral
	  after completing the test, allowing both devices to coordinate
	  test completion without manual intervention.

if ATM_BT_TPUTP

module = ATM_BT_TPUTP
module-str = ATM_BT_TPUTP
source "subsys/logging/Kconfig.template.log_config"

endif # ATM_BT_TPUTP
```

## subsys/bluetooth/services/dult/Kconfig
```kconfig
# Copyright (c) 2025-2026 Atmosic
#
# SPDX-License-Identifier: Apache-2.0

menuconfig ATM_DULT
    bool "Detecting Unwanted Location Trackers (DULT)"
    depends on BT
    select APP_WORK_Q
    help
	"Detecting Unwanted Location Trackers (DULT) Service"
	See https://www.ietf.org/archive/id/draft-detecting-unwanted-location-trackers-01.html#name-applicability.

if ATM_DULT

config HEAP_MEM_POOL_ADD_SIZE_ATM_DULT
	int "Heap memory pool size for DULT service"
	default 256
	help
	  Additional heap memory pool size required by DULT Service.
	  Covers GATT response buffers and GATT-initiated sound indication
	  work items.  Motion detection (CONFIG_DULT_MOTION_DETECT) does not
	  add heap usage — its work items are statically allocated in BSS.

module = ATM_DULT
module-str = dult
source "${ZEPHYR_BASE}/subsys/logging/Kconfig.template.log_config"

config DULT_MANUFACTURER_NAME
    string "Manufacturer name"
    default "Atmosic Tech."
    help
	The name should match the value provided in the Google Nearby Console.

config DULT_MODEL_NAME
    string "Model name"
    default "Google Fast Pair"
    help
	The name should match the value provided in the Google Nearby Console.

config DULT_ACCESSORY_CATEGORY_TYPE
    int "The category value from DULT specification the accessory most closely resembles"
    range 1 167
    default 1 # NO_ACC_CAT_LOC_TRACKER
    help
	See https://www.ietf.org/archive/id/draft-detecting-unwanted-location-trackers-01.html#name-accessory-category-value for specific category value.

config DULT_FIRMWARE_VERSION_MAJOR
    int "DULT Firmware major version"
    default 1
    range 0 65535
    help
	Default is set to 1, because Major.Minor.Revision value of 0.0.0 is not
        supported by the Fast Pair Validator Android app.

config DULT_FIRMWARE_VERSION_MINOR
    int "DULT Firmware major version"
    default 0
    range 0 255

config DULT_FIRMWARE_VERSION_REVISION
    int "DULT Firmware revision version"
    default 0
    range 0 255

config DULT_PROTOCOL_IMPLEMENTATION_VERSION
    hex "DULT implementation version"
    default 0x00010000

config DULT_MOTION_DETECT
	bool "DULT motion detector UT support"
	help
	  Enable motion detector Unwanted Tracker (UT) behavior defined in
	  the DULT specification. Requires a motion detector (e.g. accelerometer)
	  capable of detecting an orientation change of +-10 degrees along any
	  two axes of the accessory.

config DULT_MOTION_DETECT_TRIGGER
	bool "Enable trigger-based motion detection for DULT UT"
	depends on DULT_MOTION_DETECT
	help
	  Enable interrupt-driven (trigger) motion event path for DULT UT.
	  When selected, the platform signals motion via dult_ut_motion_event()
	  on each hardware interrupt instead of using the polling loop.  Only the
	  polling infrastructure (poll handler and periodic poll work) is excluded
	  from the build; the 20s fast-phase backoff timer remains active in both
	  modes.

config DULT_MOTION_DETECT_SOUND_DURATION_MS
	int "DULT motion detect sound duration in milliseconds"
	default 500
	range 1 65535
	depends on DULT_MOTION_DETECT
	help
	  The duration of the sound played when motion is detected.

config DULT_ACCESSORY_CAPABILITIES
    hex "The capability value from DULT specification the accessory most closely resembles"
    default 0xB if DULT_MOTION_DETECT  # play sound + motion detector UT + BLE lookup
    default 0x9                        # play sound + BLE lookup (no motion detector)
    help
	See https://www.ietf.org/archive/id/draft-detecting-unwanted-location-trackers-01.html#name-accessory-category-value for specific category value.

config DULT_NETWORK_ID
    hex "DULT NETWORK ID"
    default 0x2 # google network id

config DULT_BATTERY_TYPE
    hex "DULT battery type"
    default 0x2 # Rechargeable battery
    help
	See https://www.ietf.org/archive/id/draft-detecting-unwanted-location-trackers-01.html#name-accessory-category-value for specific category value.

config DULT_NETWORK_VERSION_MAJOR
    int "DULT Network major version"
    default 1
    range 0 65535
    help
	Default is set to 1

config DULT_NETWORK_VERSION_MINOR
    int "DULT Network major version"
    default 0
    range 0 255

config DULT_NETWORK_VERSION_REVISION
    int "DULT Network revision version"
    default 0
    range 0 255

config DULT_ADV_SUPPORT
    bool "DULT advertising support"
    help
	Enable DULT advertising support.

config DULT_SEPARATION_DETECT
	bool "DULT owner-disconnection separation detection"
	default n
	help
	  Enable the legacy 30-minute owner-disconnection timer that changes the
	  DULT mode to separated. When disabled, applications such as FMDN can
	  control the separated mode state through their own protocol.

endif # ATM_DULT
```

## subsys/bluetooth/services/esls/Kconfig
```kconfig
# Copyright (c) 2024-2026 Atmosic
#
# SPDX-License-Identifier: LicenseRef-Atmosic

config BT_ESLS
	bool "Support for GATT Electronic Shelf Label Service"
	select BT_EAD
	select BT_EXT_ADV
	select BT_OBSERVER
	select BT_PER_ADV_SYNC
	select BT_PER_ADV_SYNC_RSP
	select BT_PER_ADV_SYNC_TRANSFER_RECEIVER
	select SMF
	select PSA_WANT_ALG_CCM
	select PSA_WANT_KEY_TYPE_AES

if BT_ESLS

config BT_ESLS_DISPLAY_NUM
	int "Number of Display"
	range 0 102
	default 1
	depends on DISPLAY

if BT_ESLS_DISPLAY_NUM > 0

config BT_ESLS_IMAGE_NUM
	int "Maximum Image Number"
	range 1 255
	default 1

config BT_ESLS_IMAGE_MAX_SIZE
	int "Maximum Image Size"
	range 1 20000
	default 8192

config ESLS_IMG_WQ_STACK_SIZE
	int "Thread Stack Size for Image"
	range 16 2048
	default 1024

config ESLS_IMG_WQ_PRIO
	int "ESL Image Workqueue priority"
	default 2

config BT_OTS
	default y

config BT_OTS_DIR_LIST_OBJ
	default y

config BT_OTS_OACP_WRITE_SUPPORT
	default y

config BT_OTS_OACP_CHECKSUM_SUPPORT
	default y

config BT_OTS_OACP_PATCH_SUPPORT
	default y

config BT_OTS_MAX_OBJ_CNT
	default 2

endif # BT_ESLS_DISPLAY_NUM

config BT_ESLS_SENSOR_NUM
	int "Number of Sensor"
	range 0 255
	default 1
	depends on SENSOR

config BT_ESLS_SYNCHRONIZED_TIMEOUT_SEC
	int "Timeout for No Valid Message in SYNCHRONIZED state to enter Unsynchronized State"
	range 1 3600
	default 3600

config BT_ESLS_UNSYNCHRONIZED_TIMEOUT_SEC
	int "Timeout for Unsynchronized state to enter Unassociate State"
	range 1 3600
	default 3600

config BT_ESLS_ADV_MANU_DATA_MAX
	int "Maximum manufacture data length in adv data"
	range 0 6
	default 0

config BT_ESLS_LED_NUM
	int "Maximum LED Number"
	range 0 255
	default 0
	depends on LED

if BT_ESLS_LED_NUM > 0

config ESLS_LED_WQ_STACK_SIZE
	int "Thread Stack Size for LED"
	range 16 2048
	default 1024

config ESLS_LED_WQ_PRIO
	int "ESL LED Workqueue priority"
	default 2

endif

config APP_WORK_Q
	default y

module = BT_ESLS
module-str = BT_ESLS
source "subsys/logging/Kconfig.template.log_config"

endif # BT_ESLS
```
