## subsys/bluetooth/services/gfp/fmdn/Kconfig
```kconfig
# Copyright (c) 2025-2026 Atmosic
#
# SPDX-License-Identifier: Apache-2.0

menuconfig ATM_FMDN
    bool "Find My Device Network extension of Google Fast Pair (FMDN)"
    depends on FAST_PAIR_FMDN
    help
        "Find My Device Network extension (FMDN)"

if ATM_FMDN

config HEAP_MEM_POOL_ADD_SIZE_ATM_FMDN
	int "Heap memory pool size for FMDN extension"
	default 128
	help
	  Additional heap memory pool size required by Find My Device Network extension.
	  This includes work items for provisioning, ring notifications, and CS settings.

choice FMDN_ECC_TYPE
    prompt "Elliptic Curve selection"
    default FMDN_ECC_SECP160R1
    help
	Select the encryption of Elliptic Curve to be used.

config FMDN_ECC_SECP160R1
    bool "FMDN with the SECP160R1 Elliptic Curve"
    depends on ATM_GFP_DIRECT_UECC_INTERFACE
    help
	Select the SECP160R1 Elliptic Curve for FMDN. This curve type is less
	secure than the SECP256R1 variant, but it can be used with Bluetooth
	Legacy Advertising because of its limited size (160 bits).

config FMDN_ECC_SECP256R1
    bool "FMDN with the SECP256R1 Elliptic Curve"
    help
	Select the SECP256R1 Elliptic Curve for FMDN. This curve type is more
	secure than the SECP160R1 variant but requires using Bluetooth Extended
	Advertising due to its extended size (256 bits).

endchoice

config FMDN_HASH_FLAGS
    bool "Advertising data with hash flags"
    default y

config FMDN_MAX_CONN
    int "FMDN maximum concurrent connected client"
    default 2

config FMDN_RING_COMPONENTS
    hex "Number of ringing-capable components"
    default 0x01
    range 0x00 0x03
    help
	Number of components capable of ringing, as reported to the Seeker
	in the Read Beacon Parameters response (FMDN spec byte 6):
	  0x00 - Not capable of ringing
	  0x01 - Single component (e.g. consumer tag or left earbud)
	  0x02 - Left and right earbuds can ring independently
	  0x03 - Left earbud, right earbud, and case can all ring independently

config FMDN_RING_VOL_SEL
    bool "Ringing volume selection available"
    default y
    depends on FMDN_RING_COMPONENTS != 0
    help
	When enabled, the Provider advertises ringing volume selection support
	and must accept and handle 3 volume levels (low, medium, high) as
	indicated in the Ring operation.
	When disabled, only the default volume level is used.

# Power-loss recovery advertising

config FMDN_CLOCK_SAVE_INTERVAL_SEC
    int "Periodic FMDN clock save interval (seconds)"
    default 86400
    help
	Periodic FMDN clock save interval (seconds)
	FMDN spec: at least once per day (86400s).

config FMDN_POWER_LOSS_RECOVERY_TIMEOUT_SEC
    int "Continuous advertising timeout (seconds)"
    default 300
    help
	Continuous advertising duration after power loss before switching to periodic mode.
	FMDN spec: 5 minutes.

config FMDN_POWER_LOSS_PERIODIC_INTERVAL_SEC
    int "Periodic cycle interval (seconds)"
    default 600
    help
	Gap between periodic advertising cycles (end of one to start of next).
	FMDN spec: at least every 10 minutes (max 600s gap).

config FMDN_POWER_LOSS_PERIODIC_DURATION_SEC
    int "Periodic cycle duration (seconds)"
    default 30
    help
	Duration of each periodic advertising cycle.
	FMDN spec: at least 30 seconds.

config FMDN_POWER_LOSS_PERIODIC_ADV_INTERVAL_MS
    int "Periodic BLE advertising interval (milliseconds)"
    default 1000
    help
	BLE advertising packet interval during periodic cycles.
	FMDN spec: 1 second.

config FMDN_PERSISTENT_CONNECTION
    bool "Enable Persistent Connection support"
    depends on FAST_PAIR_FMDN_V2
    default y
    select BT_USER_CONN_PARAM_REJECTED
    help
	Enable Persistent Connection feature for FHN v2.
	Persistent Connection allows longer connection intervals to save power,
	with acceptable latency for Find/Ring/Reverse Ringing operations.
	This feature is reported in the capabilities bitmap (bit 0).

config FMDN_PC_NEGO_RETRY_COUNT
    int "Connection parameter negotiation retry count"
    depends on FMDN_PERSISTENT_CONNECTION
    default 3
    range 0 10
    help
	Number of times to retry connection parameter negotiation after a
	mismatch or rejection before treating the negotiation as a final
	failure and disconnecting (for non-interactive persistent types).
	Set to 0 to disable retries.

config FMDN_PC_NEGO_RETRY_INTERVAL_MS
    int "Connection parameter negotiation retry interval (ms)"
    depends on FMDN_PERSISTENT_CONNECTION
    default 2000
    range 500 10000
    help
	Delay in milliseconds between negotiation retry attempts.

config FMDN_REVERSE_RINGING
    bool "Enable Reverse Ringing support"
    depends on FAST_PAIR_FMDN_V2
    default y
    help
	Enable Reverse Ringing feature for FHN v2.
	Reverse Ringing allows the Provider to ring the Seeker device.
	This feature is reported in the capabilities bitmap (bit 1).

config FMDN_REVERSE_RINGING_ADV_TIMEOUT_SEC
    int "Reverse Ringing Advertising timeout (seconds)"
    default 20
    range 15 20
    depends on FMDN_REVERSE_RINGING
    help
	Reverse Ringing Advertising timeout duration.
	FHN v2 spec: 15-20 seconds.

config FMDN_REVERSE_RINGING_RING_TIMEOUT_SEC
    int "Reverse Ringing persistent-path ring timeout (seconds)"
    default 300
    range 60 900
    depends on FMDN_REVERSE_RINGING
    help
	Guard timer started on the persistent-connection path after the
	Provider's START indication is acknowledged by the Seeker.
	If the Seeker does not send a stop WRITE within this period, the
	Provider resets the local ringing state.
	This value should match the phone-side ringing duration


config FMDN_V2_MINIMAL_LOGGING
    bool "Minimal logging for FHN v2 (production builds)"
    depends on FAST_PAIR_FMDN_V2
    default n
    help
      Reduce logging in FHN v2 modules to only errors and warnings.
      This saves 3-10KB of flash by removing informational and debug logs.

      When enabled:
      - LOG_ERR and LOG_WRN are kept (critical for debugging)
      - LOG_INF and LOG_DBG are compiled out at build time

      Recommended for production builds with flash constraints.

      Flash savings breakdown:
      - Reverse Ringing: ~1.5-4KB
      - Advertisement Ringing: ~0.9-2.5KB
      - Persistent Connection: ~1.0-2.8KB
      - Secure Beacon Actions: ~0.9-2.5KB
      Total: ~4-12KB flash savings

# FMDN Logging Level Configuration
# This controls the compile-time log level for all FMDN modules
config ATM_FMDN_LOG_LEVEL
    int
    default 2 if FMDN_V2_MINIMAL_LOGGING  # WRN level (errors + warnings only)
    default 3                              # INF level (default: errors + warnings + info)
    help
      Maximum compiled-in log level for FMDN modules.

      Levels:
      - 0: OFF (no logging)
      - 1: ERR (errors only)
      - 2: WRN (errors + warnings)
      - 3: INF (errors + warnings + info) [DEFAULT]
      - 4: DBG (all logs including debug)

      This value is used by LOG_MODULE_DECLARE(fmdn, CONFIG_ATM_FMDN_LOG_LEVEL)
      in all FMDN source files. Logs above this level are compiled out.

# Include precision finding (FHPF) configuration
rsource "Kconfig.fhpf"

endif #  ATM_FMDN
```

## subsys/bluetooth/services/gfp/fmdn/Kconfig.fhpf
```kconfig
# Copyright (c) 2025 Atmosic
#
# SPDX-License-Identifier: Apache-2.0

# FMDN Find Hub Precision Finding (FHPF) Configuration

config FMDN_PRECISION_FINDING
    bool "Enabling Find Hub Precision Finding (FHPF)"
    select RANGING_OOB_DE
    help
        Enabling Precision Finding feature using Google's Find My Device app.
        This enables ranging capabilities for precise device location.

if FMDN_PRECISION_FINDING

config FMDN_RANGING_OOB_DE_TYPE_UWB_EN
    bool "Enable Ranging OOB DE type UWB Support"
    help
        Enable Ultra-Wideband (UWB) ranging support for precision finding.
        UWB provides high-accuracy ranging capabilities for indoor positioning.

        Requires appropriate UWB hardware and driver support in the platform.

# Include UWB-specific configuration
rsource "Kconfig.fhpf_uwb"

config FMDN_RANGING_OOB_DE_TYPE_BLE_CS_EN
    bool "Enable Ranging OOB DE type BLE CS Support"
    depends on BT_CHANNEL_SOUNDING
    depends on BT_BONDABLE
    imply FMDN_CS_EXT_ADV_NO_2M
    help
        Enable Bluetooth Low Energy Channel Sounding (BLE CS) ranging support
        for precision finding. BLE CS provides ranging capabilities using
        Bluetooth 5.4+ Channel Sounding features.

        Requires CONFIG_BT_CHANNEL_SOUNDING=y to be enabled in the kernel configuration.
	Requires CONFIG_BT_BONDABLE=y to be enabled to require bonding connection.

if FMDN_RANGING_OOB_DE_TYPE_BLE_CS_EN

config FMDN_RANGING_CS_SECURITY_LEVEL
    int "Minimum security level required for CS ranging operations"
    range 1 4
    default 2
    help
        Minimum Bluetooth security level required for CS ranging operations:
        1 = No security (not recommended for ranging)
        2 = Unauthenticated pairing with encryption (default)
        3 = Authenticated pairing with encryption (MITM protection)
        4 = Authenticated LE Secure Connections pairing

config FMDN_RANGING_OOB_DE_TYPE_BLE_CS_CAP_FORCE_EN
    bool "Force reply BLE CS ranging capability"
    help
        Force the device to always reply with BLE CS ranging capability,
        even if the underlying CS support is not fully available or configured.

        This can be useful for testing or when CS capability detection is
        not working correctly, but should be used with caution in production.

        Note: This may cause compatibility issues if the actual CS hardware
        or driver support is missing.

config FMDN_CS_EXT_ADV_NO_2M
    bool "Force EXT_ADV secondary channel to 1M PHY for CS ranging"
    help
        When enabled, forces the FMDN Extended Advertising secondary
        channel to use 1M PHY instead of the default 2M PHY.

        The default 2M secondary channel (AUX_ADV_IND) competes with
        the ACL PHY update (1M->2M) initiated by the central after
        connection. If the PHY update cannot complete, the controller
        never manages the 2M transmit power (phyTxPower[2M] stays
        UNMANAGED), causing CS Procedure Enable to fail with HCI error
        0x20 (Unsupported LL Parameter Value).

        Disable this option only if the central independently ensures
        the 2M PHY is negotiated before initiating CS (for example, by
        explicitly requesting a PHY update to 2M prior to CS setup).

endif # FMDN_RANGING_OOB_DE_TYPE_BLE_CS_EN

config FMDN_OOB_MOTION_DETECT_TRIGGER
    bool "Enable trigger-based motion detection for FHPF"
	help
	  Enable the interrupt-driven (trigger) motion event path for FHPF.

	  When selected, the platform signals motion immediately on each hardware
	  interrupt (typically via dult_ut_motion_event() or atm_gfp_dult_motion_event())
	  instead of using a periodic polling loop.

	  Enabling this excludes the polling infrastructure (the poll handler and
	  periodic poll work) to optimize system responsiveness and reduce idle
	  power consumption.


endif # FMDN_PRECISION_FINDING
```

## subsys/fs/nvs/Kconfig
```kconfig
# Copyright (c) 2025-2026 Atmosic
#
# SPDX-License-Identifier: Apache-2.0

config NVS_INIT_BAD_MEMORY_REGION
	default y
	help
	  Enable automatic initialization of a NVS on a memory region that does
	  not contain a valid NVS. A region containing an invalid NVS can be
	  caused by corruption or by providing a non-empty region. This option
	  ensures a new NVS can be created.
	  In some cases, the RRAM default value is not empty (0xFF) but 0x55 or
	  0xAA, which requires this option to be enabled to properly initialize
	  the NVS region.
```

## subsys/mcumgr_dfu/Kconfig
```kconfig
# Copyright (c) 2025 Atmosic
#
# SPDX-License-Identifier: Apache-2.0

menuconfig ATM_MCUMGR
	bool "Atmosic MCUmgr support"
	depends on BOOTLOADER_MCUBOOT
	select BASE64
	select NET_BUF
	select ZCBOR
	select MCUMGR
	select STREAM_FLASH
	select IMG_MANAGER
	select FLASH
	select MCUMGR_GRP_IMG
	select MCUMGR_GRP_OS
	help
	  Enable MCUmgr with image and OS management command groups.
	  This option also selects all required dependencies.
```
