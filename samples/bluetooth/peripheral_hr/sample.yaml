## subsys/bluetooth/services/gfp/Kconfig
```kconfig
# Copyright (c) 2025-2026 Atmosic
#
# SPDX-License-Identifier: Apache-2.0

rsource "fmdn/Kconfig"
rsource "dis/Kconfig"

menuconfig ATM_GFPS
    bool "Google Fast Pair Service (GFPS)"
    depends on BT
    select ATM_GFP_CRYPTO
    select APP_WORK_Q
    select BT_PRIVACY
    select BT_RPA_TIMEOUT_DYNAMIC
    select BT_SMP
    select BASE64
    help
	"Google Fast Pair Service (GFPS)"

if ATM_GFPS

config HEAP_MEM_POOL_ADD_SIZE_ATM_GFP
	int "Heap memory pool size for Google Fast Pair service"
	default 256
	help
	  Additional heap memory pool size required by Google Fast Pair Service.
	  This includes work items for key-based pairing crypto operations.

rsource "Kconfig.logging"

config FAST_PAIR_MAX_ACCOUNT_KEY_COUNT
    int "account key number support"
    default 64 if FAST_PAIR_FMDN_V2
    default 5
    help
      Maximum number of account keys that can be stored and used for
      Fast Pair authentication. This affects the account key filter
      buffer size in advertising data.

      FHN v2 requires minimum 64 keys to support concurrent bonded devices.
      Legacy Fast Pair uses 5 keys by default.

config FAST_PAIR_ACCOUNT_KEY_FILTER_MAX_LEN
    int "Maximum account key filter buffer size in bytes"
    default 80 if FAST_PAIR_MAX_ACCOUNT_KEY_COUNT >= 64
    default 39 if FAST_PAIR_MAX_ACCOUNT_KEY_COUNT <= 30
    default 33 if FAST_PAIR_MAX_ACCOUNT_KEY_COUNT <= 25
    default 27 if FAST_PAIR_MAX_ACCOUNT_KEY_COUNT <= 20
    range 4 255
    help
      Maximum size of the account key filter buffer in advertising data.
      This must be large enough to hold the Bloom filter for all configured
      account keys. The required size is approximately: 1.2 * key_count + 3.

      For FHN v2 with 64 keys: ~80 bytes recommended.
      For legacy Fast Pair with 5-30 keys: 27-39 bytes.

      Note: Extended advertising may be required for larger filter sizes
      to fit within BLE advertising payload constraints.

config FAST_PAIR_MODEL_ID
    hex "Google Fast Pair Model ID"
    default 0x1A7331 if SOC_SERIES_ATM33
    default 0x8FE397 if SOC_SERIES_ATM34

config FAST_PAIR_AS_KEY
    string "Google Fast Pair Anti-Spoofing key"
    default "wLhpDl6Z4da3v/s1/AA32ZUtvMUkgtmPTCy5weMIDrs=" if SOC_SERIES_ATM33
    default "3H/wrAa6A5Bn2IvSq0E6RrNMucXdhEtI/Vv4sKiHtoI=" if SOC_SERIES_ATM34

config FAST_PAIR_AS_KEY_TAG
    hex "Google Fast Pair Anti-Spoofing key tag in secure journal"
    default 0xdf
    help
	Secure journal tag for Google Fast Pair Anti-Spoofing key.
	The secure journal key must be exactly 32 bytes of binary data.
	This allows production devices to use provisioned keys while maintaining development
	fallback support.

config FAST_PAIR_MODEL_ID_TAG
    hex "Google Fast Pair Model ID tag in secure journal"
    default 0xde
    help
	Secure journal tag for Google Fast Pair Model ID.
	The secure journal Model ID must be exactly 3 bytes of binary data.
	This allows production devices to use provisioned Model IDs while maintaining development
	fallback support.

config FAST_PAIR_USER_PAIR_BT_ADDR
    bool "Enable user to specify Google Fast Pair Static Random BT Address"
    depends on !FAST_PAIR_USE_BT_ID_DEFAULT
    help
      Enable custom Bluetooth device address for testing or development purposes.
      Otherwise, the device's EUI-48 MAC address will be used.

      Note: This option is not compatible with FAST_PAIR_USE_BT_ID_DEFAULT.
      When using BT_ID_DEFAULT, the address is managed by the Bluetooth stack
      and cannot be customized through this configuration.

config FAST_PAIR_PAIR_BT_ADDR
    string "Google Fast Pair Static Random BT Address, must in mac address format"
    depends on FAST_PAIR_USER_PAIR_BT_ADDR
    default "E5:C4:11:11:11:11"

config FAST_PAIR_STORAGE_DEBUG_EN
    bool "enable storage debug"
    default n

config FAST_PAIR_TX_PWR_CALIBRATION_1M
    int "TX power calibration at 1 meter when CONFIG_MAX_TX_PWR = 0 dBm"
    default -58
    range -100 20
    help
      Measured RSSI at 1 meter when CONFIG_MAX_TX_PWR = 0 dBm.
      Used for Fast Pair Advertising (encoded as RSSI@1m + 41).

      Note:
      - The default value is a reference measured on the Atmosic EVK.
      - Since antenna gain and signal attenuation vary significantly by
        PCB layout and mechanical enclosure, customers MUST perform
        actual measurements on their final product.
      - Formula: TX_PWR_0M = (Measured RSSI at 1m) + 41 dBm.

      Adjustment of this value is required to ensure compliance with
      Google Fast Pair specifications.


config FAST_PAIR_TX_PWR_CALIBRATION_0M
    int "TX power calibration at 0 meter when CONFIG_MAX_TX_PWR = 0 dBm"
    default -38
    range -100 20
    help
      Measured RSSI at 0 meter (contact distance) when CONFIG_MAX_TX_PWR = 0 dBm.
      Used for FMDN Read Beacon Parameters.

      Google recommends using actual measured values (not estimates) for
      optimal proximity pairing accuracy.

      Note:
      - The default value is a reference measured on the Atmosic EVK.
      - Since antenna gain and signal attenuation vary significantly by
        PCB layout and mechanical enclosure, customers MUST perform
        actual measurements on their final product.

      Adjustment of this value is required to ensure compliance with
      Google Fast Pair specifications.


config FAST_PAIR_FMDN
    bool "Find My Device Network extension for Fast Pair"
    default y
    select ATM_FMDN
    select ATM_GFP_DIS
    help
	Enable Find My Device Network (FMDN) extension for Fast Pair.

config FAST_PAIR_FMDN_V2
    bool "Enable FHN v2 (Find Hub Network v2) features"
    depends on FAST_PAIR_FMDN
    select BT_KEYS_OVERWRITE_OLDEST
    select BT_KEYS_SAVE_AGING_COUNTER_ON_PAIRING
    select BT_SMP_APP_PAIRING_ACCEPT
    help
	Enable Find Hub Network v2 (FHN v2) features including:
	- Secure Beacon Actions GATT characteristic (UUID FE2C1240-8366-4814-8EB0-01DE32100BEA)
	- Persistent Connection support for power efficiency
	- Reverse Ringing capability
	- FIFO eviction for account key storage
	- Support for up to 64 concurrent bonded devices

	Automatically enables:
	- BT_KEYS_OVERWRITE_OLDEST: FIFO eviction for bonding keys
	- BT_KEYS_SAVE_AGING_COUNTER_ON_PAIRING: Persist aging counter on each pairing
	- BT_SMP_APP_PAIRING_ACCEPT: Application-level pairing acceptance control

config FAST_PAIR_ACCOUNT_KEY_FIFO_EVICTION
    bool "Enable FIFO eviction for account key storage"
    depends on FAST_PAIR_FMDN_V2
    default y
    help
	Enable FIFO (First-In-First-Out) eviction policy for account key storage.
	When storage is full, the oldest key (by timestamp) is automatically evicted
	to make room for new keys. This is required for FHN v2 to support up to 64
	concurrent bonded devices.

# Override BT_MAX_PAIRED default when FHN v2 is enabled
# This ensures 64 bonded devices are supported for FHN v2
# Using configdefault to safely override the default without weakening dependencies
configdefault BT_MAX_PAIRED
    default 64 if FAST_PAIR_FMDN_V2

config FAST_PAIR_FMDN_DULT
    bool "Enable Detecting Unwanted Location Trackers (DULT) support in FMDN"
    default y
    select ATM_DULT
    help
	See https://www.ietf.org/archive/id/draft-detecting-unwanted-location-trackers-01.html#name-applicability.

config FP_FMDN_PROVISION_EN_FP_ADV
    bool "Enable remaining Fast Pair advertisement after provisioned"
    default n

config FAST_PAIR_FMDN_MERGED_ADV
    bool "Merge Fast Pair and FMDN provisioned advertising"
    depends on FAST_PAIR_FMDN && BT_EXT_ADV
    select FP_FMDN_PROVISION_EN_FP_ADV
    help
      Use a single extended advertising set for provisioned Fast Pair and
      Find My Device Network advertising.

config FP_FMDN_VALIDATOR_TEST
    bool "Enable optimize for EDDYSTONE test cases of Google Fast Pair Validator App"
    default n
    select FP_FMDN_PROVISION_EN_FP_ADV

config FP_BT_ID_NUM
    int "FP BT ID number"
    default 3 if FAST_PAIR_FMDN_DULT && !FAST_PAIR_FMDN_USE_BT_ID_OF_FAST_PAIR
    default 2 if (FAST_PAIR_FMDN_DULT && DULT_ADV_SUPPORT) && FAST_PAIR_FMDN_USE_BT_ID_OF_FAST_PAIR
    default 1

config FAST_PAIR_RECREATE_ADV_ON_MODE_SWITCH
    bool "Recreate advertising when mode switch"
    help
      Automatically recreate Fast Pair advertising when the device mode changes.
      This ensures advertising parameters are updated correctly for each mode.

      When enabled:
      - Advertising is recreated on mode transitions (pairing, paired, provisioned)
      - Ensures correct advertising intervals and parameters for each mode
      - Required when using BT_ID_DEFAULT

      When disabled:
      - Manual advertising control is required
      - May be used for custom advertising management

config FAST_PAIR_USE_BT_ID_DEFAULT
    bool "Use BT_ID_DEFAULT for Fast Pair"
    select FAST_PAIR_RECREATE_ADV_ON_MODE_SWITCH
    help
      Use BT_ID_DEFAULT (ID 0) for Fast Pair advertising instead of creating new BT IDs.

      When enabled:
      - Uses BT_ID_DEFAULT for Fast Pair advertising
      - Supports both public and random static addresses
      - Requires CONFIG_BT_HCI_SET_PUBLIC_ADDR=y for public addresses
      - Recommended when using public addresses

      When disabled:
      - Creates dedicated BT IDs starting from next available ID
      - Only supports static random addresses
      - Traditional Fast Pair implementation
      - Seeker auto-disconnects after account key or provisioned

config FAST_PAIR_FMDN_USE_BT_ID_OF_FAST_PAIR
    bool "Use the same BT_ID of Fast Pair for FMND"
    depends on FAST_PAIR_FMDN
    default y
    help
      Use same BT_ID of Fast Pair for FMDN.

config FP_MAX_CONNECTIONS
    int "Maximum Fast Pair connections"
    default 2
    help
      Maximum concurrent connections for Fast Pair.

if FP_FMDN_VALIDATOR_TEST

config FP_FMDN_VALIDATOR_TEST_ADV_INT
    int "Optimize FMDN advertisement interval in ms for EDDYSTONE test"
    default 250

endif

endif # ATM_GFPS
```

## subsys/bluetooth/services/gfp/dis/Kconfig
```kconfig
# Copyright (c) 2025 Atmosic
#
# SPDX-License-Identifier: Apache-2.0

menuconfig ATM_GFP_DIS
    bool "Device Information Service (DIS) of Google Fast Pair"
    depends on BT && !BT_DIS

    help
	Device Information Service (DIS) of Google Fast Pair
	To prevent tracking access to the Firmware Revision characteristic should be restricted.
	Seeker only allow to read after provisioned. If an attempt is made to read the firmware
	revision, and the Provider isn't bonded nor an authenticated operation was successfully
	completed over that same connection, the Provider should return an unauthenticated error.


if ATM_GFP_DIS

module = ATM_GFP_DIS
module-str = gfp_dis
source "${ZEPHYR_BASE}/subsys/logging/Kconfig.template.log_config"

config GFP_DIS_FW_VERSION_STR_MAX
    int "Maximum firmware version string length"
    default 100
    range 2 512
    help
	Maximum length of the firmware version string buffer in the Device Information
	Service (DIS). The Google Fast Pair specification does not explicitly limit the
	firmware version string length or mandate a specific format, so this is a
	configurable implementation parameter.

	The buffer must be large enough to accommodate:
	- The firmware version string itself (application-defined format)
	- A null terminator (1 byte)

	Minimum: 2 bytes (allows single character + null terminator)
	Default: 100 bytes (provides reasonable headroom for various version formats)
	Maximum: 512 bytes (practical limit for embedded devices)

	If gfp_dis_init() receives a string longer than this value minus 1 (for null
	terminator), it will reject the string with -ENAMETOOLONG error.

endif # ATM_GFP_DIS
```
