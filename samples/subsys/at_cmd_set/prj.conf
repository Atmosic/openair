## CMakeLists.txt
```
# Copyright (c) 2026 Atmosic
#
# SPDX-License-Identifier: LicenseRef-Atmosic

cmake_minimum_required(VERSION 3.20.0)
find_package(Zephyr REQUIRED HINTS $ENV{ZEPHYR_BASE})
project(at_cmd)

target_sources(app PRIVATE
    src/main.c
)
```

## Kconfig
```
# Copyright (c) 2026 Atmosic
#
# SPDX-License-Identifier: LicenseRef-Atmosic

mainmenu "AT command set sample"

config AT_CMD_SET_SAMPLE_APP_VERSION
	string "Application version printed in boot banner"
	default "1.0.0"
	help
	  Embedded in the boot banner so the pytest DFU harness can tell
	  v1 and v2 builds apart after an MCUboot swap.

source "Kconfig.zephyr"
```

## sample.yaml
```
# Copyright (c) 2026 Atmosic
#
# SPDX-License-Identifier: LicenseRef-Atmosic

sample:
  description: AT Command sample
  name: AT Command
  # Pytest Options:
  #   --cmd-timeout <seconds>   : Timeout for AT command responses (default: 5.0)
  #   --at-cmd-serial <port>    : Serial port for AT commands (uart0), e.g., COM4
  #   --at-cmd-baud <rate>      : Baud rate for AT command port (default: 115200)
  #   -T, --adv-timeout <seconds>: Timeout in seconds to wait while advertising before disabling (default: 60)
  #   --dev-b-serial <port>      : Serial port for device B (central) in two-device tests, e.g., COM6
  #   --dev-b-baud <rate>        : Baud rate for device B serial port (default: 115200)
  #   --funcpin-out-pin <pin>   : gpio0 pin for SYSFUNCPIN output tests (default: 10)
  #   --funcpin-in-pin <pin>    : gpio0 pin for SYSFUNCPIN input tests  (default:  9)
  #
  # Hardware Configuration:
  #   - uart0: AT command input/output (configured in app.overlay)
  #   - uart1: Console/debug output (board default)
  #
  # Single-port mode (same port for console and AT commands):
  #   twister ... --device-serial COM3
  #
  # Two-port mode (separate ports for console and AT commands):
  #   twister ... --device-serial COM3 --pytest-args="--at-cmd-serial=COM4"
  #
  # Two-device mode (devA=dut peripheral, devB=central via --dev-b-serial):
  #   twister ... --device-serial COM3 --pytest-args="--at-cmd-serial=COM4 --dev-b-serial=COM6"
common:
  sysbuild: true
tests:
  samples.subsys.at_cmd_set.atm:
    harness: console
    harness_config:
      type: one_line
      regex:
        - "Ready for AT commands"
    tags:
      - openair_release
  samples.subsys.at_cmd_set.atm.mcuboot:
    harness: console
    harness_config:
      type: one_line
      regex:
        - "Ready for AT commands"
    tags:
      - mcuboot
    extra_args:
      - SB_CONFIG_BOOTLOADER_MCUBOOT=y
      - SB_CONFIG_BOOT_SIGNATURE_TYPE_ECDSA_P256=y
      - SB_CONFIG_MCUBOOT_MODE_SWAP_SCRATCH=y
      - SB_ATM_DTS_EXTRA_CPPFLAGS="-DATM_MCUBOOT_SWAP_WITH_OFFSET=0"
  samples.subsys.at_cmd_set.atm.pytest:
    harness: pytest
    timeout: 300
    harness_config:
      pytest_root: ["pytest"]
      pytest_dut_scope: class
      pytest_args:
        - "-m"
        - "basic"
        - "-v"
        # For two-port mode, add: --at-cmd-serial=<port>
    extra_configs:
      - CONFIG_ATM_AT_CMDTEST=y
  samples.subsys.at_cmd_set.atm.pytest.adv:
    harness: pytest
    timeout: 300
    harness_config:
      pytest_root: ["pytest"]
      pytest_dut_scope: class
      pytest_args:
        - "-m"
        - "adv"
        - "-v"
        - "-T"
        - "5"
    tags:
      - openair_release
  samples.subsys.at_cmd_set.atm.pytest.system:
    harness: pytest
    timeout: 300
    harness_config:
      pytest_root: ["pytest"]
      pytest_dut_scope: session
      pytest_args:
        - "-m"
        - "system"
        - "-v"
    extra_configs:
      - CONFIG_AT_CMD_SYSFUNCPIN=y
      - CONFIG_AT_CMD_SYSPM=y
      - CONFIG_AT_CMD_SYSUARTBR=y
      - CONFIG_AT_CMD_SYSUARTFC=y
      - CONFIG_AT_CMD_SYSUARTRAW=y
  samples.subsys.at_cmd_set.atm.pytest.scan_conn:
    harness: pytest
    timeout: 300
    extra_args:
      - SB_CONFIG_DTS_EXTRA_SELECT_CPD200_HINT=y
    extra_configs:
      - CONFIG_AT_CMD_CENTRAL=y
    harness_config:
      pytest_root: ["pytest"]
      pytest_dut_scope: session
      pytest_args:
        - "-m"
        - "scan_conn"
        - "-v"
  samples.subsys.at_cmd_set.atm.pytest.gatt:
    harness: pytest
    timeout: 600
    harness_config:
      pytest_root: ["pytest"]
      pytest_dut_scope: session
      pytest_args:
        - "-m"
        - "gatt"
        - "-v"
  samples.subsys.at_cmd_set.atm.pytest.gatt_dyn:
    harness: pytest
    timeout: 600
    harness_config:
      pytest_root: ["pytest"]
      pytest_dut_scope: session
      pytest_args:
        - "-m"
        - "gatt_dyn"
        - "-v"
  samples.subsys.at_cmd_set.atm.pytest.gatt_client:
    harness: pytest
    timeout: 300
    extra_args:
      - SB_CONFIG_DTS_EXTRA_SELECT_CPD200_HINT=y
    extra_configs:
      - CONFIG_AT_CMD_CENTRAL=y
    harness_config:
      pytest_root: ["pytest"]
      pytest_dut_scope: class
      pytest_args:
        - "-m"
        - "gatt_client"
        - "-v"
  samples.subsys.at_cmd_set.atm.two_dev.central:
    tags:
      - two_dev
    harness: pytest
    timeout: 300
    extra_args:
      - SB_CONFIG_DTS_EXTRA_SELECT_CPD200_HINT=y
    extra_configs:
      - CONFIG_AT_CMD_PERIPHERAL=n
      - CONFIG_AT_CMD_CENTRAL=y
      - CONFIG_VND_API_SET_CON_TX_POWER=y
      - CONFIG_BT_EXT_ADV=y
      - CONFIG_BT_L2CAP_TX_MTU=247
      - CONFIG_BT_BUF_ACL_RX_SIZE=251
    harness_config:
      pytest_root: ["pytest"]
      pytest_dut_scope: session
      pytest_args:
        - "-m"
        - "two_dev"
        - "-v"
        # Two-device mode requires --dev-b-serial=<port> in --pytest-args:
        #   west twister ... --pytest-args="--at-cmd-serial=COM4 --dev-b-serial=COM6"
  samples.subsys.at_cmd_set.atm.two_dev.gatt:
    tags:
      - two_dev
    harness: pytest
    timeout: 900
    extra_args:
      - SB_CONFIG_DTS_EXTRA_SELECT_CPD200_HINT=y
    extra_configs:
      - CONFIG_AT_CMD_PERIPHERAL=n
      - CONFIG_AT_CMD_CENTRAL=y
      - CONFIG_BT_EXT_ADV=y
      - CONFIG_BT_L2CAP_TX_MTU=247
      - CONFIG_BT_BUF_ACL_RX_SIZE=251
    harness_config:
      pytest_root: ["pytest"]
      pytest_dut_scope: session
      pytest_args:
        - "-m"
        - "gatt_two_dev"
        - "-v"
        # Two-device mode requires --dev-b-serial=<port> in --pytest-args:
        #   west twister ... --pytest-args="--at-cmd-serial=<port> --dev-b-serial=<port>"
  samples.subsys.at_cmd_set.atm.mcuboot.pytest.sysdfu.single_image:
    harness: pytest
    tags:
      - dfu
      - mcuboot
    timeout: 600
    depends_on:
      - flash
      - rram
    extra_args:
      - SB_CONFIG_BOOTLOADER_MCUBOOT=y
      - SB_CONFIG_BOOT_SIGNATURE_TYPE_ECDSA_P256=y
      - SB_CONFIG_MCUBOOT_MODE_SWAP_SCRATCH=y
      - SB_CONFIG_DTS_EXTRA_SELECT_CPD200_HINT=y
      - SB_ATM_DTS_EXTRA_CPPFLAGS="-DATM_MCUBOOT_SWAP_WITH_OFFSET=0"
    extra_configs:
      - CONFIG_AT_CMD_SYSDFU=y
      - CONFIG_AT_CMD_SYSMKBANKGOOD=y
      - CONFIG_ATM_VENDOR_DFU=y
      - CONFIG_STREAM_FLASH=y
      - CONFIG_BOOTLOADER_MCUBOOT=y
      - CONFIG_MCUBOOT_IMG_MANAGER=y
      - CONFIG_IMG_MANAGER=y
      - CONFIG_CRC=y
      - CONFIG_UART_INTERRUPT_DRIVEN=y
      - CONFIG_SERIAL=y
      - CONFIG_REBOOT=y
    harness_config:
      pytest_root: ["pytest/test_at_cmd_dfu_swap.py"]
      pytest_args:
        - "-v"
        - "--dfu-mode=single"
  samples.subsys.at_cmd_set.atm.mcuboot.flash_xip.pytest.sysdfu.dual_image:
    harness: pytest
    tags:
      - dfu
      - mcuboot
      - flash_xip
    timeout: 600
    depends_on:
      - flash
      - rram
      - xip
    extra_args:
      - SB_CONFIG_BOOTLOADER_MCUBOOT=y
      - SB_CONFIG_BOOT_SIGNATURE_TYPE_ECDSA_P256=y
      - SB_CONFIG_MCUBOOT_MODE_SWAP_USING_OFFSET=y
      - SB_CONFIG_DTS_EXTRA_SELECT_CPD200_HINT=y
      - SB_ATM_DTS_EXTRA_CPPFLAGS="-DATM_APP_FLASH_XIP;-DATM_STORAGE_SIZE=0x1000;-DATM_MCUBOOT_SCRATCH_SIZE=0"
      - mcuboot_CONFIG_UPDATEABLE_IMAGE_NUMBER=2
    extra_configs:
      - CONFIG_AT_CMD_SYSDFU=y
      - CONFIG_AT_CMD_SYSMKBANKGOOD=y
      - CONFIG_ATM_VENDOR_DFU=y
      - CONFIG_STREAM_FLASH=y
      - CONFIG_BOOTLOADER_MCUBOOT=y
      - CONFIG_MCUBOOT_IMG_MANAGER=y
      - CONFIG_IMG_MANAGER=y
      - CONFIG_CRC=y
      - CONFIG_UART_INTERRUPT_DRIVEN=y
      - CONFIG_SERIAL=y
      - CONFIG_REBOOT=y
    harness_config:
      pytest_root: ["pytest/test_at_cmd_dfu_swap.py"]
      pytest_args:
        - "-v"
        - "--dfu-mode=dual"
  samples.subsys.at_cmd_set.atm.two_dev.smp:
    tags:
      - two_dev
    harness: pytest
    timeout: 300
    extra_args:
      - SB_CONFIG_DTS_EXTRA_SELECT_CPD200_HINT=y
    extra_configs:
      - CONFIG_AT_CMD_PERIPHERAL=n
      - CONFIG_AT_CMD_CENTRAL=y
      - CONFIG_BT_EXT_ADV=y
      - CONFIG_BT_L2CAP_TX_MTU=247
      - CONFIG_BT_BUF_ACL_RX_SIZE=251
      - CONFIG_BT_SMP_SC_PAIR_ONLY=n
      - CONFIG_BT_SMP_ALLOW_UNAUTH_OVERWRITE=y
    harness_config:
      pytest_root: ["pytest"]
      pytest_dut_scope: session
      pytest_args:
        - "-m"
        - "two_dev_smp"
        - "-v"
        # At runtime, Twister must pass:
        #   --pytest-args="--at-cmd-serial=<UART0_A>"
        #   --pytest-args="--dev-b-serial=<UART0_B>"
  samples.subsys.at_cmd_set.atm.two_dev.central.sensor_beacon:
    tags:
      - two_dev
      - sensor_beacon
    harness: pytest
    timeout: 600
    extra_args:
      - SB_CONFIG_DTS_EXTRA_SELECT_CPD200_HINT=y
    extra_configs:
      - CONFIG_AT_CMD_PERIPHERAL=n
      - CONFIG_AT_CMD_CENTRAL=y
      - CONFIG_BT_EXT_ADV=y
      - CONFIG_BT_L2CAP_TX_MTU=247
      - CONFIG_BT_BUF_ACL_RX_SIZE=251
    harness_config:
      pytest_root: ["pytest"]
      pytest_dut_scope: session
      pytest_args:
        - "-m"
        - "sensor_beacon"
        - "-v"
        # DevB must be pre-flashed with applications/sensor_beacon.
        # At runtime pass:
        #   --pytest-args="--at-cmd-serial=<UART0_A> --dev-b-serial=<UART0_B>"
```

## prj.conf
```kconfig
# Copyright (c) 2026 Atmosic
#
# SPDX-License-Identifier: LicenseRef-Atmosic

CONFIG_LOG=y
CONFIG_LOG_MODE_IMMEDIATE=y
CONFIG_ASSERT=y

# Bluetooth configuration
CONFIG_BT=y
CONFIG_BT_ID_MAX=2
CONFIG_BT_SETTINGS=y

# Settings backend
CONFIG_FLASH=y
CONFIG_FLASH_PAGE_LAYOUT=y
CONFIG_FLASH_MAP=y
CONFIG_NVS=y
CONFIG_SETTINGS=y
CONFIG_SETTINGS_NVS=y

# Shell configuration (optional, for AT command interface)
CONFIG_SHELL=n

# AT Command library
CONFIG_ATM_AT_CMD=y

# Atmosic AT Command Set
CONFIG_AT_CMD_SET=y

# Increase system work queue stack size.
CONFIG_SYSTEM_WORKQUEUE_STACK_SIZE=2048
CONFIG_AT_CMD_PERIPHERAL=y
```

## app.overlay
```dts
/*
 * Copyright (c) 2026 Atmosic
 *
 * SPDX-License-Identifier: LicenseRef-Atmosic
 */

/* UART0 for AT command input/output */
&uart0 {
	current-speed = <115200>;
	status = "okay";
};
```

## src/main.c
```c
/*
 * Copyright (c) 2026 Atmosic
 *
 * SPDX-License-Identifier: LicenseRef-Atmosic
 */

#include <zephyr/kernel.h>
#include <zephyr/device.h>
#include <zephyr/bluetooth/bluetooth.h>
#include <zephyr/settings/settings.h>

#include "at_cmd_set.h"

/*
 * Main function
 */
int main(void)
{
	int err;

	printk("\nBLE AT Command Sample\n");
	printk("AT_CMD_SET APP_VER=" CONFIG_AT_CMD_SET_SAMPLE_APP_VERSION "\n");

	/* Initialize Bluetooth */
	err = bt_enable(NULL);
	if (err) {
		printk("ERROR: Bluetooth init failed (err %d)\n", err);
		return err;
	}

	/* Load settings to restore persistent BT identities */
	settings_load();
	printk("Bluetooth initialized\n");

	/* Initialize AT command system with UART transport */
	err = at_cmd_set_uart_ch_init(DEVICE_DT_GET(DT_NODELABEL(uart0)));
	if (err) {
		printk("ERROR: AT command UART init failed (err %d)\n", err);
		return err;
	}

	printk("Ready for AT commands (use AT+LISTCMDS? to list commands)\n");

	/* Main loop - everything is handled by callbacks */
	while (1) {
		k_sleep(K_FOREVER);
	}

	return 0;
}
```
