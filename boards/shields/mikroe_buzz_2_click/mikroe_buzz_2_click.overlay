/*
 * Copyright (c) 2025-2026 Atmosic
 *
 * SPDX-License-Identifier: LicenseRef-Atmosic
 */

/ {
	buzzer: buzzer {
		compatible = "atmosic,atm3x-pwm-buzzer";
		pwms = <&mikrobus_pwm 6 PWM_USEC(1000) PWM_POLARITY_NORMAL>;
		min-frequency = <123>;
		max-frequency = <10000>;
	};
};

&mikrobus_pwm {
	pin = <22>;
	status = "okay";
};
