## boards/shields/mikroe_pir_click/Kconfig.shield
```kconfig
# Copyright (c) 2025-2026 Atmosic
# SPDX-License-Identifier: LicenseRef-Atmosic

config SHIELD_MIKROE_PIR_CLICK
	def_bool $(shields_list_contains,mikroe_pir_click)
```

## boards/shields/pervasive_epaper/dts/bindings/display/pervasive,common.yaml
```yaml
# Copyright (c) 2024 Atmosic
# SPDX-License-Identifier: Apache-2.0

description: Pervasive EPD display controller

include: [spi-device.yaml, display-controller.yaml]

properties:
  spi-read-max-freq:
    type: int
    description: Maximal read frequency.

     The maximal spi clock used in read operation. If not defined, use
     spi-max-frequency instead.

child-binding:
  properties:
    reset-gpios:
      type: phandle-array
      required: true
      description: RESET pin.

        The RESET pin of Pervasive display is active low.
        If connected directly the MCU pin should be configured
        as active low.

    dc-gpios:
      type: phandle-array
      required: true
      description: DC pin.

        The DC pin of Pervasive display is active low (transmission
        command byte).
        If connected directly the MCU pin should be configured
        as active low.

    busy-gpios:
      type: phandle-array
      required: true
      description: BUSY pin.

        The BUSY pin of Pervasive display is active high.
        If connected directly the MCU pin should be configured
        as active high.

    pc-gpios:
      type: phandle-array
      description: Power control pin.

        The power control pin is active high. It is connected directly to the
        MCU pin to control the power switch of the Pervasive device.
        If not defined, no power switch is present.
```

## boards/shields/pervasive_epaper/dts/bindings/display/pervasive,e2266cs0c2.yaml
```yaml
# Copyright (c) 2024 Atmosic
# SPDX-License-Identifier: Apache-2.0

description: Pervasive 2.66 152x296 EPD display controller

compatible: "pervasive,e2266cs0c2"

include: pervasive,common.yaml
```

## boards/shields/pervasive_epaper/dts/bindings/display/pervasive,e2266qs0f1.yaml
```yaml
# Copyright (c) 2024 Atmosic
# SPDX-License-Identifier: Apache-2.0

description: Pervasive 2.66 152x296 EPD display controller

compatible: "pervasive,e2266qs0f1"

include: pervasive,common.yaml
```

## boards/shields/pervasive_epaper/dts/bindings/display/pervasive,e2741js0b2.yaml
```yaml
# Copyright (c) 2024 Atmosic
# SPDX-License-Identifier: Apache-2.0

description: Pervasive 7.41 480x800 EPD display controller

compatible: "pervasive,e2741js0b2"

include: pervasive,common.yaml
```

## drivers/Kconfig
```kconfig
# Copyright (c) 2024-2026 Atmosic
# SPDX-License-Identifier: LicenseRef-Atmosic

menu "OpenAir device drivers"

rsource "*/Kconfig"

endmenu
```

## drivers/adc/Kconfig
```kconfig
# Copyright (c) 2025-2026 Atmosic
# SPDX-License-Identifier: LicenseRef-Atmosic

if ADC

rsource "Kconfig.atmx3"
rsource "Kconfig.atm34"

endif # ADC
```

## drivers/adc/Kconfig.atm34
```kconfig
# ADC configuration options

# Copyright (c) 2023-2026 Atmosic
# SPDX-License-Identifier: LicenseRef-Atmosic

config ADC_ATM34
	bool "Atmosic ATM34 ADC driver"
	default y
	depends on DT_HAS_ATMOSIC_ATM34_ADC_ENABLED
	help
	  This option enables the ADC driver for ATM34
	  family of processors.
	  Support 16-bit resolution.
	  Support 11 channels: ch1~ch11.

if ADC_ATM34

config CBPRINTF_FP_SUPPORT
	default y
	bool "Enable floating point support"

config ADC_ASYNC
	default y
	bool "Enable asynchronous mode"

config ADC_CAL_REFRESH_INTERVAL
	int "Refresh interval (in ms) for gain extensions"
	default 5000
	help
	    Schedules calibration measurements to update the offset_comp* registers

config ATM_ADC_TEST_API
	bool "Enable ADC test API (TEST ONLY)"
	help
	    Exposes atm_adc_test_raw_samples() which reads raw GADC samples
	    from a single channel via direct register access, for hardware
	    bring-up and validation. Bypasses the Zephyr ADC subsystem and
	    calibration; not for production use.

config ATM_ADC_CAL_RELOAD
	bool
	default y
	help
	    The driver exposes atm_adc_reload_cal() to re-read the GADC
	    calibration tag after the active secure journal changes.

config ATM_ADC_CAL_TEST_HOOKS
	bool "Enable GADC calibration reload test hooks (TEST ONLY)"
	depends on ATM_ADC_CAL_RELOAD && ATM_ADC_TEST_API
	default y if ZTEST
	help
	    Exposes atm_adc_test_invalidate_cal() and
	    atm_adc_test_set_cal_missing() so tests can verify that
	    atm_adc_reload_cal() re-reads the secure journal. Not for
	    production use.

endif
```

## drivers/adc/Kconfig.atmx3
```kconfig
# ADC configuration options

# Copyright (c) 2021-2026 Atmosic
# SPDX-License-Identifier: LicenseRef-Atmosic

config ADC_ATMx3
	bool "Atmosic ATMx3 ADC driver"
	default y
	depends on DT_HAS_ATMOSIC_ATMX3_ADC_ENABLED
	help
	  This option enables the ADC driver for ATMx3
	  family of processors.
	  Support 11-bit resolution.
	  Support 11 channels: ch1~ch11.

if ADC_ATMx3

config CBPRINTF_FP_SUPPORT
	default y
	bool "Enable floating point support"

config ADC_ASYNC
	default y
	bool "Enable asynchronous mode"

config ATM_ADC_CAPTURE
	bool "Enable GADC continuous-mode capture API"
	help
	    Exposes atm_adc_capture_start()/read()/stop(), which run the GADC
	    free-running in continuous mode so raw samples can be drained at
	    the converter rate instead of one conversion at a time. No
	    calibration or unit conversion is applied to the samples.

	    Unrelated to ADC_STREAM: samples are drained by polling, not
	    through RTIO.

config ATM_ADC_TEST_API
	bool "Enable ADC test API (TEST ONLY)"
	select ATM_ADC_CAPTURE
	help
	    Exposes atm_adc_test_raw_samples() which reads raw GADC samples
	    from a single channel via direct register access, for hardware
	    bring-up and validation. Bypasses the Zephyr ADC subsystem and
	    calibration; not for production use.

endif
```

## drivers/atm_antenna/Kconfig
```kconfig
# Copyright (c) 2025-2026 Atmosic
#
# SPDX-License-Identifier: LicenseRef-Atmosic

config ATM_ANTENNA_SWITCH
	bool "Atmosic antenna driver"
	default y if !MCUBOOT
	depends on DT_HAS_ATMOSIC_ANTENNA_ENABLED
	depends on GPIO

if ATM_ANTENNA_SWITCH

module = ATM_ANTENNA_SWITCH
module-str = Atmosic antenna switch
source "subsys/logging/Kconfig.template.log_config"

config ATM_ANTENNA_RAM_ONLY_FOR_PM
	bool "Configure driver to only access RAM during power management"

endif # ATM_ANTENNA_SWITCH
```

## drivers/atm_buzzer/Kconfig
```kconfig
# Copyright (c) 2025-2026 Atmosic
#
# SPDX-License-Identifier: LicenseRef-Atmosic
config ATM_BUZZER
	bool "ATM buzzer"
	select PWM

if ATM_BUZZER

module = ATM_BUZZER
module-str = atm_buzzer
source "subsys/logging/Kconfig.template.log_config"

config ATM_BUZZER_TIMEOUT
	bool "Enable buzzer timeout"
	default n
	help
	  Enable buzzer timeout feature. If enabled, the buzzer will stop after a specified duration.

endif # ATM_BUZZER
```

## drivers/audio/Kconfig
```kconfig
# Copyright (c) 2026 Atmosic
#
# SPDX-License-Identifier: LicenseRef-Atmosic

if AUDIO

if AUDIO_CODEC
rsource "Kconfig.sma1303"
endif # AUDIO_CODEC

if AUDIO_DMIC

config DMIC_ATM
	bool "Atmosic PDM/DMIC driver"
	depends on DT_HAS_ATMOSIC_ATM_PDM_ENABLED
	select PINCTRL
	help
	  Enable the Atmosic PDM microphone driver.
	  Supports 8 kHz and 16 kHz mono PCM output with 16-bit, 20-bit, or 24-bit
	  sample width.

if DMIC_ATM

config ATM_DMIC_RX_QUEUE_SIZE
	int "RX message queue depth (number of blocks)"
	default 4
	help
	  Number of ping-pong audio blocks that can be buffered before
	  dmic_read() must drain them.  Each block is one ping-pong buffer
	  (PP_BUFFER_WORDS hardware words). Increase this value if the application
	  cannot call dmic_read() frequently enough.

config ATM_DMIC_HPF_ORDER_SEL
	int "PDM high-pass filter order select"
	default 2
	range 0 3
	help
	  IIR high-pass filter order, which attenuates residual DC content
	  in the decimated PCM signal: 0=1st order, 1=2nd order, 2=3rd
	  order, 3=4th order. See the HPF_ORD field in
	  at_apb_pdm_regs_core_macro.h.

config ATM_DMIC_HPF_BW_SEL
	int "PDM high-pass filter bandwidth select"
	default 0
	range 0 7
	help
	  IIR high-pass filter bandwidth code (0-7). The actual cutoff
	  frequency this selects (10 Hz - 6240 Hz) depends on
	  CONFIG_ATM_DMIC_HPF_ORDER_SEL - see the HPF_BW field's per-order
	  code-to-Hz table in at_apb_pdm_regs_core_macro.h.

	  The default (order=3rd, bw=0) selects a 51 Hz cutoff.

config ATM_DMIC_GAIN_DB
	int "PDM digital gain (milli-dB, -30000 to 30000)"
	default -2000
	range -30000 30000
	help
	  Digital gain in milli-dB (e.g. -2000 = -2.0 dB). The default is
	  -2000 (-2.0 dB), compensating the +2.0 dB PDM decimation filter offset.
	  Must be in 0.5 dB steps (multiples of 500 mB).

config ATM_DMIC_MIC_POWERUP_DELAY_MS
	int "PDM microphone power-up delay (milliseconds)"
	default 50
	range 0 1000
	help
	  Delay after enabling the external PDM microphone power GPIO and before
	  starting the PDM clock. The SPK0641HT4H-1 specifies up to 50 ms for
	  power-up. Set to 0 when the microphone is powered continuously.

config ATM_DMIC_CAPTURE_ON_RISING
	bool "Sample PDM DATA on rising edge of PDM CLK"
	help
	  When disabled (default), the PDM data is sampled on the falling
	  edge of PDM CLK (i.e. the microphone transitions data on the
	  rising edge). Enable this if the microphone outputs data on the
	  falling edge (sampled on rising edge). Refer to the microphone
	  datasheet's CLK/DATA timing diagram.

endif # DMIC_ATM

endif # AUDIO_DMIC

endif # AUDIO
```

## drivers/bluetooth/Kconfig
```kconfig
# Copyright (c) 2025-2026 Atmosic
# SPDX-License-Identifier: LicenseRef-Atmosic

if BT_DRIVERS
if BT_HCI

rsource "hci/Kconfig"

endif
endif # BT_DRIVERS
```

## drivers/bluetooth/hci/Kconfig
```kconfig
# Copyright (c) 2025-2026 Atmosic
# SPDX-License-Identifier: LicenseRef-Atmosic

config BT_ATMOSIC_HCI
	bool "Atmosic HCI Interface"
	default y
	depends on DT_HAS_ATMOSIC_ATM_HCI_ENABLED
	help
	  Atmosic HCI interface to the local link layer (LL). The driver
	  is provided by the Atmosic HAL.
```

## drivers/display/gme/Kconfig
```kconfig
# Copyright (c) 2026 Atmosic
#
# SPDX-License-Identifier: LicenseRef-Atmosic

config GME_OLED
	bool "GME12864 family OLED driver"
	default y
	depends on DT_HAS_ATMOSIC_GME_OLED_ENABLED
	select I2C
	help
	  Driver for GME12864 family monochrome OLED modules on I2C, including the bare
	  COG variants whose controller cannot take long or back-to-back transfers. See
	  the atmosic,gme-oled binding.

if GME_OLED

module = GME_OLED
module-str = gme_oled
source "subsys/logging/Kconfig.template.log_config"

endif # GME_OLED
```

## drivers/display/pervasive/Kconfig.pervasive
```kconfig
# Copyright (c) 2024 Atmosic
#
# SPDX-License-Identifier: Apache-2.0

config PERVASIVE
	bool "PERVASIVE compatible display controller driver"
	default y
	depends on \
		DT_HAS_PERVASIVE_E2266CS0C2_ENABLED || \
		DT_HAS_PERVASIVE_E2266QS0F1_ENABLED || \
		DT_HAS_PERVASIVE_E2741JS0B2_ENABLED
	select SPI
	help
	  Enable driver for PERVASIVE compatible controller.

config PERVASIVE_SW_FB
	bool "Software frame buffer"
	depends on \
		DT_HAS_PERVASIVE_E2266CS0C2_ENABLED || \
		DT_HAS_PERVASIVE_E2266QS0F1_ENABLED
	help
	  Enable software-based frame buffer
```

## drivers/entropy/Kconfig
```kconfig
# Copyright (c) 2025-2026 Atmosic
# SPDX-License-Identifier: LicenseRef-Atmosic

if ENTROPY_GENERATOR

rsource "Kconfig.atm"

endif
```

## drivers/flash/Kconfig
```kconfig
# Copyright (c) 2025-2026 Atmosic
# SPDX-License-Identifier: LicenseRef-Atmosic

if FLASH

rsource "Kconfig.atm"

endif # FLASH
```

## drivers/gpio/Kconfig
```kconfig
# Copyright (c) 2025-2026 Atmosic
# SPDX-License-Identifier: LicenseRef-Atmosic

if GPIO

rsource "Kconfig.atm"
rsource "Kconfig.kts162x"

endif # GPIO
```

## drivers/gpio/Kconfig.atm
```kconfig
# Atmosic GPIO driver configuration
#
# Copyright (c) 2025-2026 Atmosic
#
# SPDX-License-Identifier: LicenseRef-Atmosic
#

config GPIO_ATM
	bool "Atmosic GPIO driver with automatic pinmux"
	default y
	depends on DT_HAS_ATMOSIC_ATM_GPIO_ENABLED
	help
	  Enable the Atmosic GPIO driver which extends the ARM CMSDK AHB
	  GPIO driver with automatic pin multiplexing configuration.

	  This driver automatically calls PIN_SELECT() to configure pins
	  as GPIO when gpio_pin_configure() is called, eliminating the
	  need for manual pinmux setup in application code.

	  This is particularly useful for pins like P0 and P1 which
	  default to SWD function and need to be explicitly muxed to
	  GPIO before use.

	  Note: This driver reuses functions from the ARM CMSDK AHB GPIO
	  driver (gpio_cmsdk_ahb.c) which is compiled as part of this driver.

if GPIO_ATM

config GPIO_ATM_ALLOW_DISCONNECT
	bool "Allow GPIO_DISCONNECTED to clear pull-up/pull-down and input enable"
	help
	  The ARM CMSDK AHB GPIO driver (gpio_cmsdk_ahb.c), which this driver
	  reuses, normally rejects gpio_pin_configure() calls with
	  -ENOTSUP when neither GPIO_INPUT nor GPIO_OUTPUT is set (i.e.
	  GPIO_DISCONNECTED). This means callers relying on
	  GPIO_DISCONNECTED to tear down a pin's input enable and
	  pull-up/pull-down configuration silently fail, leaving those
	  registers latched.

	  Enable this option to allow GPIO_DISCONNECTED requests to fall
	  through and actually clear the outenable/inenable/pullup_enable/
	  pulldown_enable registers for the pin, instead of returning
	  -ENOTSUP.

	  Default is 'n' to preserve existing behavior; enable explicitly
	  in applications that depend on GPIO_DISCONNECTED clearing pin
	  state.

config GPIO_ATM_RESET_GPIOS_ON_WARM_RESET
	bool "Reset GPIO state on warm reset"
	default y if MCUBOOT
	default y if !BOOTLOADER_MCUBOOT && (ATM_NO_TZ || TRUSTED_EXECUTION_NONSECURE)
	select ATM_RESET
	help
	  This option resets GPIO pin states during either due to warm
	  reset or watchdog reset

endif # GPIO_ATM
```

## drivers/hwinfo/Kconfig
```kconfig
# Copyright (c) 2025-2026 Atmosic
# SPDX-License-Identifier: LicenseRef-Atmosic

if HWINFO

config HWINFO_ATM
	bool "Atmosic device ID"
	default y
	select ATM_RESET
	help
	  Enable Atmosic hwinfo driver
	  get_device_id and get_device_eui64 require CONFIG_ATM_EUI

endif
```

## drivers/i2c/Kconfig
```kconfig
# Copyright (c) 2025-2026 Atmosic
# SPDX-License-Identifier: LicenseRef-Atmosic

if I2C

rsource "Kconfig.atm"

endif # I2C
```

## drivers/i2c/Kconfig.atm
```kconfig
# ATM I2C configuration options

# Copyright (c) 2021-2026 Atmosic
# SPDX-License-Identifier: LicenseRef-Atmosic

menuconfig I2C_ATM
	bool "Atmosic I2C driver"
	default y
	depends on DT_HAS_ATMOSIC_ATM_I2C_ENABLED
	select PINCTRL
	help
	  Enables the ATM I2C driver

if I2C_ATM

config I2C_ATM_TIMEOUT
	int "Timeout in microseconds for a transaction to complete"
	default 100000

endif # I2C_ATM
```

## drivers/i2s/Kconfig
```kconfig
# Copyright (c) 2025-2026 Atmosic
# SPDX-License-Identifier: LicenseRef-Atmosic

if I2S

rsource "Kconfig.*"

endif # I2S
```
