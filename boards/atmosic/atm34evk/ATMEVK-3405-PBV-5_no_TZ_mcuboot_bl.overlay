/*
 * Copyright (c) 2025 Atmosic
 *
 * SPDX-License-Identifier: Apache-2.0
 */

/ {
        chosen {
                zephyr,code-partition = &boot_partition;
        };
};

#ifdef USE_ATM_SECURE_DEBUG
&uart0 {
       status = "okay";
};
#endif
