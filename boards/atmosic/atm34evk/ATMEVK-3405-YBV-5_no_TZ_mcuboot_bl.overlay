/*
 * Copyright (c) 2025 Atmosic
 *
 * SPDX-License-Identifier: Apache-2.0
 */

#include <arm/atmosic/ATM34xx_mcuboot_partitions.dtsi>

#ifdef USE_ATM_SECURE_DEBUG
&uart0 {
       status = "okay";
};
#endif
