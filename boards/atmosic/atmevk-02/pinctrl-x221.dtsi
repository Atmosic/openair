/*
 * For ATMx221 and boards
 *
 * Copyright (c) 2024-2025 Atmosic
 *
 * SPDX-License-Identifier: Apache-2.0
 */

#include <atmx2_pinmux.h>

&pinctrl {
	i2c1_sda_default: i2c1_sda_default {
		pinmux = <13 P13_I2C1_SDA>;
	};

	i2c1_scl_default: i2c1_scl_default {
		pinmux = <12 P12_I2C1_SCL>;
	};
};

