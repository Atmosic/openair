## sysbuild/atm_arch/Kconfig
```kconfig
# Copyright (c) 2025-2026 Atmosic
#
# SPDX-License-Identifier: LicenseRef-Atmosic


config ATM_ARCH
	bool "ATM ARCH generated automatically with sysbuild"

if ATM_ARCH

config ATM_ARCH_ERASE_ALL
	bool "Add erase whole flash and rram command to atm isp file"

config ATM_ARCH_ERASE_FLASH_ALL
	bool "Add erase whole flash command to atm isp file"

config ATM_ARCH_ERASE_RRAM_ALL
	bool "Add erase whole rram command to atm isp file"

config ATM_ARCH_ERASE_STORAGE
	default y if !ATM_ARCH_ERASE_ALL
	bool "Add erase factory and settings storage command to atm isp file"

endif # ATM_ARCH
```

## sysbuild/module/Kconfig
```kconfig
# Copyright (c) 2026 Atmosic
#
# SPDX-License-Identifier: LicenseRef-Atmosic

config ATM_MPC_NULL_POINTER_DETECTION
	bool "Use MPC for NULL pointer detection in no-TZ mode"
	default y
	depends on !SPE
	help
	  Use TrustZone MPC instead of MPU for NULL pointer detection.
	  This frees up MPU regions for other uses like userspace.

	  When enabled via sysbuild, this option will:
	  - Pass ATM_MPC_NULL_POINTER_DETECTION DTS flag to disable
	    the rom_null_page node
	  - Set CONFIG_NULL_POINTER_EXCEPTION_DETECTION_MPC

	  This option is enabled by default in no-TZ (no SPE) configurations.
```

## sysbuild/spe/Kconfig
```kconfig
# Copyright (c) 2024-2026 Atmosic
#
# SPDX-License-Identifier: LicenseRef-Atmosic

config SPE
	bool "SPE"
	help
	  Include Atmosic spe to use
```

## tests/bluetooth/shell/sample.yaml
```yaml
# Copyright (c) 2026 Atmosic
#
# SPDX-License-Identifier: LicenseRef-Atmosic

sample:
  name: Bluetooth shell
  description: Bluetooth shell
common:
  sysbuild: true
  harness: shell
  harness_config:
    shell_commands:
      - command: "bt"
        expected: bt - Bluetooth shell commands
  tags:
    - bluetooth
tests:
  tests.bluetooth.shell.atm:
    extra_args:
      - SB_CONFIG_DTS_EXTRA_SELECT_CPD200_HINT=y
  tests.bluetooth.shell.atm.cs:
    tags:
      - channel_sounding
    extra_args:
      - EXTRA_CONF_FILE=${CMAKE_CURRENT_SOURCE_DIR}/basic_cs.conf
      - SB_CONFIG_DTS_EXTRA_SELECT_CPD200_HINT=y
    extra_configs:
      - CONFIG_ATM_CS=y
```

## tests/boot/test_mcuboot/sample.yaml
```yaml
# Copyright (c) 2026 Atmosic
#
# SPDX-License-Identifier: LicenseRef-Atmosic

sample:
  name: MCUboot Test Application
common:
  sysbuild: true
  tags:
    - mcuboot
    - flash
  harness: console
  harness_config:
    type: multi_line
    regex:
      - "I: Starting bootloader"
      - "Launching primary slot application on (.*)"
      - "Secondary application ready for swap, rebooting"
      - "I: Starting swap using (.*)|I: Image 0 upgrade secondary slot -> primary slot"
      - "Swapped application booted on (.*)"
tests:
  tests.boot.test_mcuboot.atm.mcuboot:
    extra_args:
      - SB_CONFIG_BOOTLOADER_MCUBOOT=y
      - SB_CONFIG_BOOT_SIGNATURE_TYPE_ECDSA_P256=y
      - SB_CONFIG_MCUBOOT_MODE_SWAP_USING_OFFSET=y
      - mcuboot_CONFIG_ATM_MCUBOOT_BENCHMARK=y
  tests.boot.test_mcuboot.atm.mcuboot.legacy_scratch:
    tags:
      - legacy
    extra_args:
      - SB_CONFIG_BOOTLOADER_MCUBOOT=y
      - SB_CONFIG_BOOT_SIGNATURE_TYPE_ECDSA_P256=y
      - SB_CONFIG_MCUBOOT_MODE_SWAP_SCRATCH=y
      - SB_ATM_DTS_EXTRA_CPPFLAGS="-DATM_MCUBOOT_SWAP_WITH_OFFSET=0"
      - mcuboot_CONFIG_ATM_MCUBOOT_BENCHMARK=y
  tests.boot.test_mcuboot.atm.mcuboot.overwrite:
    extra_args:
      - SB_CONFIG_BOOTLOADER_MCUBOOT=y
      - SB_CONFIG_BOOT_SIGNATURE_TYPE_ECDSA_P256=y
      - SB_CONFIG_MCUBOOT_MODE_OVERWRITE_ONLY=y
      - SB_ATM_DTS_EXTRA_CPPFLAGS="-DATM_MCUBOOT_SWAP_WITH_OFFSET=0"
      - mcuboot_CONFIG_ATM_MCUBOOT_BENCHMARK=y
```

## tests/boot/test_mcuboot_multikey/sample.yaml
```yaml
# Copyright (c) 2026 Atmosic
#
# SPDX-License-Identifier: LicenseRef-Atmosic

sample:
  name: MCUboot Multiple Key Test Application
common:
  sysbuild: true
  tags:
    - mcuboot
    - flash
    - multikey
  harness: console
  harness_config:
    type: multi_line
    regex:
      - "I: Starting bootloader"
      - "Launching primary slot application on (.*)"
      - "Secondary application ready for swap, rebooting"
      - "I: Starting swap using (.*)|I: Image 0 upgrade secondary slot -> primary slot"
      - "Swapped application booted on (.*)"
tests:
  tests.boot.test_mcuboot_multikey.atm.mcuboot:
    extra_args:
      - SB_CONFIG_BOOTLOADER_MCUBOOT=y
      - SB_CONFIG_BOOT_SIGNATURE_TYPE_ECDSA_P256=y
      - SB_CONFIG_MCUBOOT_MODE_SWAP_USING_OFFSET=y
      - mcuboot_EXTRA_KCONFIG_OPTIONS="CONFIG_BOOT_MULTIPLE_SIGNATURE_KEYS=y;CONFIG_BOOT_SIGNATURE_KEY_FILE=\"\${${CMAKE_CURRENT_SOURCE_DIR}}/test-key-1.pem\";CONFIG_BOOT_SIGNATURE_KEY_FILE_2=\"\${${CMAKE_CURRENT_SOURCE_DIR}}/test-key-2.pem\""
```

## tests/crypto/mbedtls/testcase.yaml
```yaml
# Copyright (c) 2026 Atmosic
#
# SPDX-License-Identifier: LicenseRef-Atmosic

common:
  min_flash: 65
  min_ram: 36
  tags:
    - crypto
    - mbedtls
    - userspace
  timeout: 400
tests:
  tests.crypto.mbedtls.atm:
    sysbuild: true
    extra_configs:
      - CONFIG_TEST_USERSPACE=y
```

## tests/drivers/adc/adc_api/Kconfig
```kconfig
# Copyright (c) 2026 Atmosic
# SPDX-License-Identifier: LicenseRef-Atmosic

config TEST_ATM_ADC_API
	bool
	default y if ADC_ATM34 || ADC_ATMx3 || ADC_ATMx2
	select ATM_ADC_TEST_API
	help
	    Includes test_atm_adc_api.c for testing

config TEST_RAW_SAMPLE_BIT_MASK
	hex "Bit mask applied to each raw GADC sample before bit assembly"
	default 0x4 if ADC_ATMx2
	default 0x2
	depends on TEST_ATM_ADC_API
	help
	    Selects which bit(s) of each raw 16-bit GADC sample are extracted
	    during the assembly loop.

config TEST_CAPTURE_RATE_MAX_HZ
	int "Fastest capture rate the GADC can be programmed to"
	default 111111 if ADC_ATMx3 || ADC_ATMx2
	default 500000
	depends on TEST_ATM_ADC_API
	help
	    ATM34 decimates by OSR alone (8MHz / 16). ATMx3 and ATMx2 fold the
	    decimation into hardware averaging, so a conversion costs two
	    datapath cycles on top of the averaged samples (2MHz / 18).

config TEST_CAPTURE_RATE_MIN_HZ
	int "Slowest capture rate the GADC can be programmed to"
	default 972 if ADC_ATMx3
	default 1734 if ADC_ATMx2
	default 7812
	depends on TEST_ATM_ADC_API
	help
	    Must be exactly achievable: the rate selector never rounds up, so a
	    request below the floor is rejected rather than clamped.

config TEST_CAPTURE_BURST_RATE_HZ
	int "Capture rate the polled drain is asked to sustain"
	default 50000 if ADC_ATMx3 || ADC_ATMx2
	default 125000
	depends on TEST_ATM_ADC_API
	help
	    Below the rate selector's ceiling on purpose: the burst test asks
	    whether the polled drain keeps up, not whether the converter can be
	    programmed faster than it can be read.

config ADC_32_BITS_DATA
	default y

source "$(ZEPHYR_BASE)/tests/drivers/adc/adc_api/Kconfig"
```

## tests/drivers/adc/adc_api/testcase.yaml
```yaml
# Copyright (c) 2026 Atmosic
#
# SPDX-License-Identifier: LicenseRef-Atmosic

common:
  tags:
    - adc
    - drivers
    - userspace
tests:
  tests.drivers.adc.adc_api.atm:
    sysbuild: true
```

## tests/drivers/adc/warm_reset/testcase.yaml
```yaml
common:
  tags:
    - adc
    - drivers
  sysbuild: true
  expect_reboot: true

tests:
  tests.drivers.adc.warm_reset.atm: {}
```

## tests/drivers/at_tz_mpc/testcase.yaml
```yaml
# SPDX-License-Identifier: LicenseRef-Atmosic
# Copyright (c) 2026 Atmosic

common:
  sysbuild: true
  tags:
    - drivers
    - at_tz_mpc

tests:
  tests.drivers.at_tz_mpc.atm.gcov:
    tags:
      - gcov
    depends_on:
      - gcov_capable
    timeout: 180
    extra_configs:
      - CONFIG_UU_TEST_OPENAIR="at_tz_mpc.c"
```

## tests/drivers/atm_spe_sec_fault_storage/testcase.yaml
```yaml
# Copyright (c) 2026 Atmosic
#
# SPDX-License-Identifier: LicenseRef-Atmosic

common:
  tags:
    - drivers
    - fault_storage
    - requires_trustzone
  sysbuild: true
  timeout: 30

tests:
  tests.drivers.atm_spe_sec_fault_storage.atm:
    harness: console
    harness_config:
      type: multi_line
      regex:
        - "=== SPE SECURE FAULT DETECTED ==="
        - "SPE SECURE FAULT"
        - "Fault Reason: [0-9]+"
      ordered: true
    extra_args:
      - SB_CONFIG_SPE=y
      - SB_ATM_DTS_EXTRA_CPPFLAGS="-DATM_SEC_FAULT_STORAGE"
    extra_configs:
      - CONFIG_LOG_MODE_IMMEDIATE=y
      - CONFIG_ATM_SPE_FAULT_STORAGE=y
  tests.drivers.atm_spe_sec_fault_storage.atm.mcuboot:
    tags:
      - mcuboot
    harness: console
    harness_config:
      type: multi_line
      regex:
        - "=== SPE SECURE FAULT DETECTED ==="
        - "SPE SECURE FAULT"
        - "Fault Reason: [0-9]+"
      ordered: true
    extra_args:
      - SB_CONFIG_SPE=y
      - SB_ATM_DTS_EXTRA_CPPFLAGS="-DATM_SEC_FAULT_STORAGE;-DATM_MCUBOOT_SWAP_WITH_OFFSET=0"
      - SB_CONFIG_BOOTLOADER_MCUBOOT=y
      - SB_CONFIG_BOOT_SIGNATURE_TYPE_ECDSA_P256=y
      - SB_CONFIG_MCUBOOT_MODE_SWAP_SCRATCH=y
    extra_configs:
      - CONFIG_LOG_MODE_IMMEDIATE=y
      - CONFIG_ATM_SPE_FAULT_STORAGE=y
  tests.drivers.atm_spe_sec_fault_storage.atm.mcuboot.flash_xip:
    tags:
      - mcuboot
      - flash_xip
    depends_on:
      - flash
      - rram
      - xip
    harness: console
    harness_config:
      type: multi_line
      regex:
        - "=== SPE SECURE FAULT DETECTED ==="
        - "SPE SECURE FAULT"
        - "Fault Reason: [0-9]+"
      ordered: true
    extra_args:
      - SB_CONFIG_SPE=y
      - SB_ATM_DTS_EXTRA_CPPFLAGS="-DATM_APP_FLASH_XIP;-DATM_SEC_FAULT_STORAGE;-DATM_MCUBOOT_SCRATCH_SIZE=0"
      - mcuboot_CONFIG_UPDATEABLE_IMAGE_NUMBER=2
      - SB_CONFIG_BOOTLOADER_MCUBOOT=y
      - SB_CONFIG_BOOT_SIGNATURE_TYPE_ECDSA_P256=y
      - SB_CONFIG_MCUBOOT_MODE_SWAP_USING_OFFSET=y
    extra_configs:
      - CONFIG_LOG_MODE_IMMEDIATE=y
      - CONFIG_ATM_SPE_FAULT_STORAGE=y
  tests.drivers.atm_spe_sec_fault_storage.atm.log_panic:
    harness: console
    harness_config:
      type: one_line
      regex:
        - "TEST LOG PANIC SAVE COMPLETE"
    extra_args:
      - SB_CONFIG_SPE=y
      - SB_ATM_DTS_EXTRA_CPPFLAGS="-DATM_SEC_FAULT_STORAGE"
    extra_configs:
      - CONFIG_LOG=y
      - CONFIG_TEST_LOGGING_DEFAULTS=n
      - CONFIG_TEST_LOG_PANIC=y
      - CONFIG_ATM_SPE_FAULT_STORAGE=y
  tests.drivers.atm_spe_sec_fault_storage.atm.mcuboot.log_panic:
    tags:
      - mcuboot
    harness: console
    harness_config:
      type: one_line
      regex:
        - "TEST LOG PANIC SAVE COMPLETE"
    extra_args:
      - SB_CONFIG_SPE=y
      - SB_ATM_DTS_EXTRA_CPPFLAGS="-DATM_SEC_FAULT_STORAGE;-DATM_MCUBOOT_SWAP_WITH_OFFSET=0"
      - SB_CONFIG_BOOTLOADER_MCUBOOT=y
      - SB_CONFIG_BOOT_SIGNATURE_TYPE_ECDSA_P256=y
      - SB_CONFIG_MCUBOOT_MODE_SWAP_SCRATCH=y
    extra_configs:
      - CONFIG_LOG=y
      - CONFIG_TEST_LOGGING_DEFAULTS=n
      - CONFIG_TEST_LOG_PANIC=y
      - CONFIG_ATM_SPE_FAULT_STORAGE=y
```

## tests/drivers/batt_model/batt_model_dry/testcase.yaml
```yaml
# Copyright (c) 2026 Atmosic
#
# SPDX-License-Identifier: LicenseRef-Atmosic

tests:
  tests.drivers.batt_model.batt_model_dry.atm:
    sysbuild: true
```

## tests/drivers/batt_model/testcase.yaml
```yaml
# Copyright (c) 2026 Atmosic
#
# SPDX-License-Identifier: LicenseRef-Atmosic

common:
  sysbuild: true
  harness: ztest
  tags:
    - drivers
    - batt_model

tests:
  tests.drivers.batt_model.atm.coin.gcov: &batt_model_gcov_base
    tags:
      - gcov
    depends_on:
      - gcov_capable
    timeout: 180
    extra_configs:
      - CONFIG_BATT_MODEL_COIN=y
      - CONFIG_UU_TEST_OPENAIR="batt_model_coin.c"
  tests.drivers.batt_model.atm.dry.gcov:
    <<: *batt_model_gcov_base
    extra_configs:
      - CONFIG_BATT_MODEL_DRY=y
      - CONFIG_UU_TEST_OPENAIR="batt_model_dry.c"
  tests.drivers.batt_model.atm.hsc_liion.gcov:
    <<: *batt_model_gcov_base
    depends_on:
      - gcov_capable
      - energy_harvesting
    extra_configs:
      - CONFIG_BATT_MODEL_HSC_LIION=y
      - CONFIG_UU_TEST_OPENAIR="batt_model_hsc_liion.c"
```

## tests/drivers/buzzer/testcase.yaml
```yaml
# SPDX-License-Identifier: LicenseRef-Atmosic
# Copyright (c) 2026 Atmosic

common:
  sysbuild: true
  tags:
    - drivers
    - pwm
    - buzzer
    - atm_buzzer
  # app.overlay wires the atmosic,atm3x-pwm-buzzer node to pwm3, which only the
  # ATM3x PWM block routes.
  depends_on:
    - atm3x_pwm

tests:
  tests.drivers.buzzer.atm: &base_config {}

  tests.drivers.buzzer.atm.gcov:
    <<: *base_config
    tags:
      - gcov
    depends_on:
      - gcov_capable
    timeout: 180
    extra_configs:
      - CONFIG_UU_TEST_OPENAIR="atm_buzzer.c"
```

## tests/drivers/ccbm/testcase.yaml
```yaml
# SPDX-License-Identifier: LicenseRef-Atmosic
# Copyright (c) 2026 Atmosic
common:
  sysbuild: true
  harness: ztest
  tags:
    - drivers
    - ccbm
    - battery
  depends_on:
    - ccbm
tests:
  tests.drivers.ccbm.atm: {}
```

## tests/drivers/entropy/warm_reset/testcase.yaml
```yaml
common:
  tags:
    - entropy
    - drivers
  depends_on:
    - entropy
  sysbuild: true
  expect_reboot: true

tests:
  tests.drivers.entropy.warm_reset.atm: {}
```

## tests/drivers/flash/common/testcase.yaml
```yaml
# Copyright (c) 2026 Atmosic
#
# SPDX-License-Identifier: LicenseRef-Atmosic

common:
  tags:
    - drivers
    - flash
    - atm_test_with_spe
  sysbuild: true
tests:
  tests.drivers.flash.common.atm: {}
  tests.drivers.flash.common.atm.mcuboot:
    tags:
      - mcuboot
    extra_args:
      - SB_CONFIG_BOOTLOADER_MCUBOOT=y
      - SB_CONFIG_BOOT_SIGNATURE_TYPE_ECDSA_P256=y
      - SB_CONFIG_MCUBOOT_MODE_SWAP_SCRATCH=y
      - SB_ATM_DTS_EXTRA_CPPFLAGS="-DATM_MCUBOOT_SWAP_WITH_OFFSET=0"
  tests.drivers.flash.common.atm.ruid:
    extra_args:
      - SB_ATM_DTS_EXTRA_CPPFLAGS="-DTEST_STORAGE_IN_FLASH;-DCONFIG_FLASH_ATM_RUID=y"
  tests.drivers.flash.common.atm.ruid.spe.flash_xip:
    tags:
      - flash_xip
    extra_args:
      - SB_CONFIG_SPE=y
      - SB_ATM_DTS_EXTRA_CPPFLAGS="-DATM_APP_FLASH_XIP;-DTEST_STORAGE_IN_FLASH;-DCONFIG_FLASH_ATM_RUID=y"
  tests.drivers.flash.common.atm.ruid.mcuboot.flash_xip:
    tags:
      - flash_xip
    extra_args:
      - SB_CONFIG_BOOTLOADER_MCUBOOT=y
      - SB_CONFIG_BOOT_SIGNATURE_TYPE_ECDSA_P256=y
      - SB_CONFIG_MCUBOOT_MODE_SWAP_SCRATCH=y
      - SB_ATM_DTS_EXTRA_CPPFLAGS="-DATM_APP_FLASH_XIP;-DCONFIG_FLASH_ATM_RUID=y;-DATM_MCUBOOT_SWAP_WITH_OFFSET=0"
      - mcuboot_CONFIG_UPDATEABLE_IMAGE_NUMBER=2
  tests.drivers.flash.common.atm.wo_ext_flash:
    tags:
      - wo_ext_flash
    extra_args:
      - SB_ATM_DTS_EXTRA_CPPFLAGS="-DFLASH_SIZE=0;-DATM_ALLOW_FLASH_DISABLE"
```

## tests/drivers/gpio/gpio_api_1pin/testcase.yaml
```yaml
# Copyright (c) 2026 Atmosic
#
# SPDX-License-Identifier: LicenseRef-Atmosic

tests:
  tests.drivers.gpio.gpio_api_1pin.atm:
    sysbuild: true
```

## tests/drivers/i2c/warm_reset/testcase.yaml
```yaml
common:
  tags:
    - i2c
    - drivers
  depends_on:
    - i2c
  sysbuild: true
  expect_reboot: true

tests:
  tests.drivers.i2c.warm_reset.atm: {}
```

## tests/drivers/pwm/pwm_api/testcase.yaml
```yaml
# Copyright (c) 2026 Atmosic
#
# SPDX-License-Identifier: LicenseRef-Atmosic

tests:
  tests.drivers.pwm.pwm_api.atm:
    sysbuild: true
    extra_configs:
      - CONFIG_DEFAULT_PWM_PORT=3
```
