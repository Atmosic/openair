## subsys/audio/stream/Kconfig
```kconfig
# Copyright (c) 2025 Atmosic
#
# SPDX-License-Identifier: Apache-2.0

menuconfig AUDIO_STREAM
    bool "Audio stream subsystem (I2S + codec abstraction)"
    depends on I2S
    help
      Enable the audio stream subsystem, providing playback/capture APIs
      on top of I2S and audio codec drivers.

if AUDIO_STREAM

config AUDIO_STREAM_ATM_API
	bool "Use ATM proprietary APIs for I2S transfer"
	select ATM_FIFO_TX_ISR
	default y

config AUDIO_DEFAULT_VOLUME
	int "Default volume"
	default 64
	  help
	    Set the default volume for the audio stream.
endif
```

## subsys/bluetooth/services/Kconfig
```kconfig
# Copyright (c) 2025 Atmosic
#
# SPDX-License-Identifier: Apache-2.0

menu "GATT Services"
	depends on BT_CONN

rsource "*/Kconfig"

endmenu
```

## subsys/bluetooth/services/gfp/Kconfig.logging
```kconfig
# Copyright (c) 2025 Atmosic
#
# SPDX-License-Identifier: Apache-2.0

module = ATM_GFPS
module-str = gfps
source "${ZEPHYR_BASE}/subsys/logging/Kconfig.template.log_config"

module = ATM_FP
module-str = fp
parent-module = ATM_GFPS
source "subsys/logging/Kconfig.template.log_config_inherit"

if ATM_FMDN

module = ATM_FMDN
module-str = fmdn
parent-module = ATM_GFPS
source "subsys/logging/Kconfig.template.log_config_inherit"

endif # ATM_FMDN
```

## subsys/bluetooth/services/gfp/fmdn/Kconfig.fhpf_uwb
```kconfig
# Copyright (c) 2025 Atmosic
#
# SPDX-License-Identifier: Apache-2.0

# FMDN Find Hub Precision Finding (FHPF) UWB Configuration
# See: https://developers.google.com/nearby/fast-pair/specifications/extensions/precisionfinding

if FMDN_RANGING_OOB_DE_TYPE_UWB_EN

config FMDN_RANGING_UWB_CHANNEL_MASK
	hex "UWB Supported Channel Mask"
	default 0x220
	help
	  Bitmask of supported UWB channels.
	  Spec: Channel 9 must be supported.
	  Default: 0x220 (channels 5 and 9)

config FMDN_RANGING_UWB_PREAMBLE_MASK
	hex "UWB Supported Preamble Index Mask"
	default 0xFE800000
	help
	  Bitmask of supported UWB preamble indices (1 to 32).
	  Default: 0xFE800000

config FMDN_RANGING_UWB_CONFIG_ID_MASK
	hex "UWB Supported Config IDs Mask"
	default 0x40
	help
	  Bitmask of supported UWB configuration IDs.
	  Spec: Config ID 6 is mandatory, Config ID 3 is optional.
	  Default: 0x40 (Config ID 6)

config FMDN_RANGING_UWB_MIN_RANGING_INT
	hex "UWB Minimum Ranging Interval"
	default 0xF0
	help
	  Minimum supported ranging interval in milliseconds.
	  Spec: 96ms preferred, 240ms minimum.
	  Default: 0xF0 (240 ms)

config FMDN_RANGING_UWB_MIN_SLOT_DUR
	hex "UWB Minimum Slot Duration"
	default 0x02
	help
	  Minimum supported slot duration in milliseconds.
	  Spec: 1ms recommended, 2ms also supported.
	  Default: 0x02

config FMDN_RANGING_UWB_DEVICE_ROLE
	hex "UWB Device Role Bitmap"
	default 0x01
	help
	  Device role bitmap for UWB ranging.
	  Spec: Responder device must indicate UWB initiator role.
	  Default: 0x01 (Initiator/Reflector)

endif # FMDN_RANGING_OOB_DE_TYPE_UWB_EN
```

## subsys/bluetooth/services/ras/Kconfig
```kconfig
# Copyright (c) 2025 Atmosic
#
# SPDX-License-Identifier: Apache-2.0

config BT_RAS
	bool "Support for GATT Ranging Service"
	select BT_CHANNEL_SOUNDING
	select APP_WORK_Q

if BT_RAS

config RAS_MAX_ANTENNA_PATH_NUM
	int "Maximum Antenna Path Number"
	range 1 4
	default 4

config RAS_REAL_TIME_RD
	bool "Support for Real-time Ranging Data"
	default y

config RAS_SECURE_LVL
	int "Connection Secure level for Ranging Profile"
	range 2 4
	default 2
	help
	    Connection Secure, BT_SECURITY_L2 ~ BT_SECURITY_L4

config RAS_RD_BUFFER_NUM
	int "The amount of Buffer for RAS Raging Data"
	range 1 2
	default 1

config RAS_SECURE_FORCE_DISCONN
	bool "Force disconnect if secure level change too low"

config RAS_ACTIVE_SECURE_CHANGE
	bool "Server would send secure request as connected"

module = BT_RAS
module-str = BT_RAS
source "subsys/logging/Kconfig.template.log_config"

endif # BT_RAS

config BT_RAS_CLIENT
	bool "Support for GATT Ranging Service Client"
	select BT_GATT_CLIENT
	select BT_CHANNEL_SOUNDING

if BT_RAS_CLIENT

config RAS_CLIENT_MAX_ANTENNA_PATH_NUM
	int "Maximum Antenna Path Number"
	range 1 4
	default 4

config RAS_CLIENT_RECEIVE_RANGING_DATA_TIMEOUT_SEC
	int "Timeout for No Ranging Data Received"
	range 0 5
	default 5

config RAS_CLIENT_REAL_TIME_RD
	bool "Support Real-time Ranging Data Mode"
	default y

module = BT_RAS_CLIENT
module-str = BT_RAS_CLIENT
source "subsys/logging/Kconfig.template.log_config"

endif # BT_RAS_CLIENT

if BT_RAS || BT_RAS_CLIENT
config BT_BUF_ACL_TX_SIZE
	range 251 $(UINT16_MAX)
	default 502

config BT_BUF_ACL_RX_SIZE
	range 251 $(UINT16_MAX)
	default 502

config BT_L2CAP_TX_MTU
	range 247 2000
	default 498
endif # BT_RAS || BT_RAS_CLIENT
```

## subsys/fs/Kconfig
```kconfig
# Copyright (c) 2025 Atmosic
#
# SPDX-License-Identifier: Apache-2.0

rsource "*/Kconfig"
```

## subsys/settings/Kconfig
```kconfig
# Copyright (c) 2024-2025 Atmosic
#
# SPDX-License-Identifier: Apache-2.0

config ATM_SETTINGS
	bool "Proprietary settings subsystem library"
	select FLASH
	select FLASH_MAP
	select NVS
	select SETTINGS
	select ATM_NV_MEM_FLASH_PROT if DT_HAS_ATMOSIC_SEC_NV_MEM_FLASH_PROT_ENABLED

if ATM_SETTINGS

config ATM_SETTINGS_INIT_PRIORITY
	int "ATM_SETTINGS initialization priority"
	default 45

module = ATM_SETTINGS
module-str = atm_settings
source "subsys/logging/Kconfig.template.log_config"

endif # ATM_SETTINGS
```

## subsys/version/Kconfig
```kconfig
# Copyright (c) 2025 Atmosic
#
# SPDX-License-Identifier: Apache-2.0

config ATM_VERSION
	bool "Print Atmosic SDK Version"
	default y

config ATMWSTK_VERSION
    string "Atmosic BLE stack version"
    default "PD50" if ATMWSTK_PD50
    default "FULL" if ATMWSTK_FULL
    default "CPD200" if ATMWSTK_CPD200
    default "NO_BLE"
```

## sysbuild/atmwstk/Kconfig
```kconfig
# Copyright (c) 2025 Atmosic
#
# SPDX-License-Identifier: Apache-2.0

choice ATM_WIRELESS_STACK_CHOICE
	prompt "BLE link layer wireless stack flavor of sysbuild"
	optional

config ATMWSTK_PD50
	bool "PD50 link controller"

config ATMWSTK_FULL
	bool "Full link controller"

config ATMWSTK_CPD200
	bool "CPD200 link controller"

endchoice

config DTS_EXTRA_SELECT_CPD200_HINT
	bool "In sysbuild, select CPD200 fixed image for platforms that need it"
```

## tests/atm/fast_code/testcase.yaml
```yaml
sample:
  description: Test for placing application code in fast_code section using simple linker snippet
  name: ATM Fast Code Test
common:
  sysbuild: true
  harness: ztest
  tags:
    - fast_code
tests:
  tests.atm.fast_code.atm.spe.flash_xip:
    tags:
      - no_mcuboot
    extra_args:
      - SB_CONFIG_SPE=y
      - SB_ATM_DTS_EXTRA_CPPFLAGS="-DATM_APP_FLASH_XIP"
  tests.atm.fast_code.atm.mcuboot.flash_xip:
    extra_args:
      - SB_CONFIG_BOOTLOADER_MCUBOOT=y
      - SB_CONFIG_BOOT_SIGNATURE_TYPE_ECDSA_P256=y
      - SB_CONFIG_MCUBOOT_MODE_SWAP_SCRATCH=y
      - SB_ATM_DTS_EXTRA_CPPFLAGS="-DATM_APP_FLASH_XIP"
```

## tests/drivers/flash/atm_abnormal/testcase.yaml
```yaml
common:
  tags:
    - drivers
    - flash
  sysbuild: true
  expect_reboot: true

tests:
  tests.drivers.flash.atm_abnormal.atm.before_erase:
    extra_configs:
      - CONFIG_FLASH_ATM_ABNORMAL_TEST_BEFORE_ERASE=y

  tests.drivers.flash.atm_abnormal.atm.during_erase:
    extra_configs:
      - CONFIG_FLASH_ATM_ABNORMAL_TEST_DURING_ERASE=y
```

## tests/drivers/gpio/gpio_basic_api/testcase.yaml
```yaml
tests:
  tests.drivers.gpio.gpio_basic_api.atm:
    sysbuild: true
    harness: console
    harness_config:
      type: one_line
      regex:
        - Running TESTSUITE after_flash_gpio_config_trigger
    tags:
      - no_mcuboot
```

## tools/Kconfig
```kconfig
# Copyright (c) 2024 Atmosic
#
# SPDX-License-Identifier: Apache-2.0

config GEN_PARTITION_INFO
	bool "Generate partition info"
	default y

config GEN_PARTITION_INFO_SCRIPT
	string "Generate partition info script path"
	default "${ZEPHYR_OPENAIR_MODULE_DIR}/tools/scripts/gen_atm_partition_info.py"

config GEN_TAG_DATA_BIN_FILE_SCRIPT
	string "Generate tag data bin file script path"
	default "${ZEPHYR_OPENAIR_MODULE_DIR}/tools/scripts/gen_tag_data_bin_file.py"
```

## tools/scripts/sysbuild/samples/bluetooth/beacon/sample.yaml
```yaml
tests:
  samples.bluetooth.beacon.atm:
    sysbuild: true
    harness: console
    harness_config:
      type: one_line
      regex:
        - "Beacon started"
    tags: bluetooth atm33 atm34
    extra_args:
      - spe_EXTRA_CONF_FILE=${BOARD_DIR}/sysbuild/spe.conf
      - EXTRA_CONF_FILE=${BOARD_DIR}/sysbuild/app.conf
      - SB_CONFIG_SPE=y
  samples.bluetooth.beacon.atm.mcuboot:
    sysbuild: true
    harness: console
    harness_config:
      type: one_line
      regex:
        - "Beacon started"
    tags: bluetooth atm33 atm34
    extra_args:
      - mcuboot_DTC_OVERLAY_FILE="${BOARD_DIR}/${BOARD}_mcuboot_bl.overlay"
      - mcuboot_EXTRA_CONF_FILE=${BOARD_DIR}/sysbuild/mcuboot.conf
      - spe_EXTRA_CONF_FILE=${BOARD_DIR}/sysbuild/spe_mcuboot.conf
      - EXTRA_CONF_FILE=${BOARD_DIR}/sysbuild/app_mcuboot.conf
      - SB_CONFIG_SPE=y
      - SB_CONFIG_BOOTLOADER_MCUBOOT=y
      - SB_CONFIG_BOOT_SIGNATURE_TYPE_ECDSA_P256=y
      - SB_CONFIG_MCUBOOT_MODE_SWAP_SCRATCH=y
  samples.bluetooth.beacon.atm.mcuboot.atmwstk.pd50ll:
    sysbuild: true
    harness: console
    harness_config:
      type: one_line
      regex:
        - "Beacon started"
    tags: bluetooth atm33
    extra_args:
      - mcuboot_DTC_OVERLAY_FILE="${BOARD_DIR}/${BOARD}_mcuboot_bl.overlay"
      - mcuboot_EXTRA_CONF_FILE=${BOARD_DIR}/sysbuild/mcuboot.conf
      - mcuboot_DTS_EXTRA_CPPFLAGS="-DATMWSTK=PD50LL"
      - spe_EXTRA_CONF_FILE=${BOARD_DIR}/sysbuild/spe_mcuboot.conf
      - spe_DTS_EXTRA_CPPFLAGS="-DATMWSTK=PD50LL"
      - EXTRA_CONF_FILE=${BOARD_DIR}/sysbuild/app_mcuboot.conf
      - DTS_EXTRA_CPPFLAGS="-DATMWSTK=PD50LL"
      - SB_CONFIG_SPE=y
      - SB_CONFIG_BOOTLOADER_MCUBOOT=y
      - SB_CONFIG_BOOT_SIGNATURE_TYPE_ECDSA_P256=y
      - SB_CONFIG_MCUBOOT_MODE_SWAP_SCRATCH=y
    extra_configs:
      - CONFIG_ATMWSTK="PD50LL"
      - CONFIG_USE_ATMWSTK=y
      - CONFIG_ATM_SOC_ALLOW="ATM33"
  samples.bluetooth.beacon.atm.mcuboot.atmwstklib.pd50:
    sysbuild: true
    harness: console
    harness_config:
      type: one_line
      regex:
        - "Beacon started"
    tags: bluetooth atm33 atm34
    extra_args:
      - mcuboot_DTC_OVERLAY_FILE="${BOARD_DIR}/${BOARD}_mcuboot_bl.overlay"
      - mcuboot_EXTRA_CONF_FILE=${BOARD_DIR}/sysbuild/mcuboot.conf
      - spe_EXTRA_CONF_FILE=${BOARD_DIR}/sysbuild/spe_mcuboot.conf
      - EXTRA_CONF_FILE=${BOARD_DIR}/sysbuild/app_mcuboot.conf
      - SB_CONFIG_SPE=y
      - SB_CONFIG_BOOTLOADER_MCUBOOT=y
      - SB_CONFIG_BOOT_SIGNATURE_TYPE_ECDSA_P256=y
      - SB_CONFIG_MCUBOOT_MODE_SWAP_SCRATCH=y
    extra_configs:
      - CONFIG_ATMWSTKLIB="PD50"
```

## tools/scripts/sysbuild/samples/bluetooth/extended_adv/advertiser/sample.yaml
```yaml
tests:
  samples.bluetooth.extended_adv.advertiser.atm:
    sysbuild: true
    harness: console
    harness_config:
      type: one_line
      regex:
        - Starting Extended Advertising Demo
    tags: bluetooth atm33 atm34
    extra_args:
      - spe_EXTRA_CONF_FILE=${BOARD_DIR}/sysbuild/spe.conf
      - EXTRA_CONF_FILE=${BOARD_DIR}/sysbuild/app.conf
      - SB_CONFIG_SPE=y
    extra_configs:
      - CONFIG_ATMWSTKLIB=""
      - CONFIG_USE_ATMWSTK=y
```

## tools/scripts/sysbuild/samples/bluetooth/observer/sample.yaml
```yaml
tests:
  samples.bluetooth.observer.atm:
    sysbuild: true
    harness: console
    harness_config:
      type: one_line
      regex:
        - Starting Observer Demo
    tags: bluetooth atm33 atm34
    extra_args:
      - spe_DTS_EXTRA_CPPFLAGS=";"
      - spe_EXTRA_CONF_FILE=${BOARD_DIR}/sysbuild/spe.conf
      - DTS_EXTRA_CPPFLAGS=";"
      - EXTRA_CONF_FILE=${BOARD_DIR}/sysbuild/app.conf
      - SB_CONFIG_SPE=y
      - SB_CONFIG_COMPILER_WARNINGS_AS_ERRORS=n
    extra_configs:
      - CONFIG_ATMWSTKLIB=""
      - CONFIG_USE_ATMWSTK=y
      - CONFIG_COMPILER_WARNINGS_AS_ERRORS=n
```

## tools/scripts/sysbuild/samples/bluetooth/periodic_adv_rsp/sample.yaml
```yaml
tests:
  samples.bluetooth.periodic_adv_rsp.atm:
    sysbuild: true
    harness: console
    harness_config:
      type: one_line
      regex:
        - Starting Periodic Advertising Demo
    tags: bluetooth atm33 atm34
    extra_args:
      - spe_EXTRA_CONF_FILE=${BOARD_DIR}/sysbuild/spe.conf
      - EXTRA_CONF_FILE=${BOARD_DIR}/sysbuild/app.conf
      - SB_CONFIG_SPE=y
      - SB_CONFIG_COMPILER_WARNINGS_AS_ERRORS=n
    extra_configs:
      - CONFIG_ATMWSTKLIB=""
      - CONFIG_USE_ATMWSTK=y
      - CONFIG_COMPILER_WARNINGS_AS_ERRORS=n
```

## tools/scripts/sysbuild/samples/bluetooth/peripheral/sample.yaml
```yaml
tests:
  samples.bluetooth.peripheral.atm:
    sysbuild: true
    harness: console
    harness_config:
      type: one_line
      regex:
        - "Indicate VND attr"
    tags: bluetooth atm33 atm34
    extra_args:
      - spe_EXTRA_CONF_FILE=${BOARD_DIR}/sysbuild/spe.conf
      - EXTRA_CONF_FILE=${BOARD_DIR}/sysbuild/app.conf
      - SB_CONFIG_SPE=y
  samples.bluetooth.peripheral.atm.mcuboot:
    sysbuild: true
    harness: console
    harness_config:
      type: one_line
      regex:
        - "Indicate VND attr"
    tags: bluetooth atm33 atm34
    extra_args:
      - mcuboot_DTC_OVERLAY_FILE="${BOARD_DIR}/${BOARD}_mcuboot_bl.overlay"
      - mcuboot_EXTRA_CONF_FILE=${BOARD_DIR}/sysbuild/mcuboot.conf
      - mcuboot_DTS_EXTRA_CPPFLAGS="-DDFU_IN_FLASH"
      - spe_EXTRA_CONF_FILE=${BOARD_DIR}/sysbuild/spe_mcuboot.conf
      - spe_DTS_EXTRA_CPPFLAGS="-DDFU_IN_FLASH"
      - EXTRA_CONF_FILE=${BOARD_DIR}/sysbuild/app_mcuboot.conf
      - DTS_EXTRA_CPPFLAGS="-DDFU_IN_FLASH"
      - SB_CONFIG_SPE=y
      - SB_CONFIG_BOOTLOADER_MCUBOOT=y
      - SB_CONFIG_BOOT_SIGNATURE_TYPE_ECDSA_P256=y
      - SB_CONFIG_MCUBOOT_MODE_SWAP_SCRATCH=y
  samples.bluetooth.peripheral.atm.mcuboot.atmwstk.pd50ll:
    sysbuild: true
    harness: console
    harness_config:
      type: one_line
      regex:
        - "Indicate VND attr"
    tags: introduction atm33
    extra_args:
      - mcuboot_DTC_OVERLAY_FILE="${BOARD_DIR}/${BOARD}_mcuboot_bl.overlay"
      - mcuboot_EXTRA_CONF_FILE=${BOARD_DIR}/sysbuild/mcuboot.conf
      - mcuboot_DTS_EXTRA_CPPFLAGS="-DATMWSTK=PD50LL;-DDFU_IN_FLASH"
      - spe_EXTRA_CONF_FILE=${BOARD_DIR}/sysbuild/spe_mcuboot.conf
      - spe_DTS_EXTRA_CPPFLAGS="-DATMWSTK=PD50LL;-DDFU_IN_FLASH"
      - EXTRA_CONF_FILE=${BOARD_DIR}/sysbuild/app_mcuboot.conf
      - DTS_EXTRA_CPPFLAGS="-DATMWSTK=PD50LL;-DDFU_IN_FLASH"
      - SB_CONFIG_SPE=y
      - SB_CONFIG_BOOTLOADER_MCUBOOT=y
      - SB_CONFIG_BOOT_SIGNATURE_TYPE_ECDSA_P256=y
      - SB_CONFIG_MCUBOOT_MODE_SWAP_SCRATCH=y
    extra_configs:
      - CONFIG_ATMWSTK="PD50LL"
      - CONFIG_USE_ATMWSTK=y
      - CONFIG_ATM_SOC_ALLOW="ATM33"
  samples.bluetooth.peripheral.atm.mcuboot.atmwstklib.pd50:
    sysbuild: true
    harness: console
    harness_config:
      type: one_line
      regex:
        - "Indicate VND attr"
    tags: bluetooth atm33 atm34
    extra_args:
      - mcuboot_DTC_OVERLAY_FILE="${BOARD_DIR}/${BOARD}_mcuboot_bl.overlay"
      - mcuboot_EXTRA_CONF_FILE=${BOARD_DIR}/sysbuild/mcuboot.conf
      - mcuboot_DTS_EXTRA_CPPFLAGS="-DDFU_IN_FLASH"
      - spe_EXTRA_CONF_FILE=${BOARD_DIR}/sysbuild/spe_mcuboot.conf
      - spe_DTS_EXTRA_CPPFLAGS="-DDFU_IN_FLASH"
      - EXTRA_CONF_FILE=${BOARD_DIR}/sysbuild/app_mcuboot.conf
      - DTS_EXTRA_CPPFLAGS="-DDFU_IN_FLASH"
      - SB_CONFIG_SPE=y
      - SB_CONFIG_BOOTLOADER_MCUBOOT=y
      - SB_CONFIG_BOOT_SIGNATURE_TYPE_ECDSA_P256=y
      - SB_CONFIG_MCUBOOT_MODE_SWAP_SCRATCH=y
    extra_configs:
      - CONFIG_ATMWSTKLIB="PD50"
```
