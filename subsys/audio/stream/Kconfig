## tools/scripts/sysbuild/samples/hello_world/sample.yaml
```yaml
tests:
  samples.hello_world.atm:
    sysbuild: true
    tags: introduction atm33 atm34
    extra_args:
      - spe_EXTRA_CONF_FILE=${BOARD_DIR}/sysbuild/spe.conf
      - EXTRA_CONF_FILE=${BOARD_DIR}/sysbuild/app.conf
      - SB_CONFIG_SPE=y
  samples.hello_world.atm.mcuboot:
    sysbuild: true
    tags: introduction atm33 atm34
    extra_args:
      - mcuboot_DTC_OVERLAY_FILE="${BOARD_DIR}/${BOARD}_mcuboot_bl.overlay"
      - mcuboot_EXTRA_CONF_FILE=${BOARD_DIR}/sysbuild/mcuboot.conf
      - spe_EXTRA_CONF_FILE=${BOARD_DIR}/sysbuild/spe_mcuboot.conf
      - EXTRA_CONF_FILE=${BOARD_DIR}/sysbuild/app_mcuboot.conf
      - SB_CONFIG_SPE=y
      - SB_CONFIG_BOOTLOADER_MCUBOOT=y
      - SB_CONFIG_BOOT_SIGNATURE_TYPE_ECDSA_P256=y
      - SB_CONFIG_MCUBOOT_MODE_SWAP_SCRATCH=y
  samples.hello_world.atm.mcuboot.atmx2:
    sysbuild: true
    tags: introduction atmx2
    extra_args:
      - mcuboot_EXTRA_CONF_FILE=${BOARD_DIR}/sysbuild/mcuboot.conf
      - EXTRA_CONF_FILE=${BOARD_DIR}/sysbuild/app_mcuboot.conf
      - SB_CONFIG_BOOTLOADER_MCUBOOT=y
      - SB_CONFIG_BOOT_SIGNATURE_TYPE_ECDSA_P256=y
      - SB_CONFIG_MCUBOOT_MODE_SWAP_SCRATCH=y
```
