## dts/bindings/atmosic,atm34-adc.yaml
```yaml
# Copyright (c) 2023-2026 Atmosic
# SPDX-License-Identifier: LicenseRef-Atmosic

description: Atmosic ADC for ATM34

compatible: "atmosic,atm34-adc"

include: atmosic,adc-controller.yaml

properties:
    interrupts:
      required: true

    clock-freq:
      type: int
      description: |
        ADC clock frequency selector;
      enum:
        - 0 # 8 MHz
        - 1 # 4 MHz (default)
        - 2 # 2 MHz
        - 3 # 1 MHz

    sample-avg:
      type: int
      description: |
        ADC samples (0 <= X <= 7) to be averaged. Default 5;

    osr-select:
      type: int
      description: |
        ADC OSR selector;
      enum:
        - 0 # 128 (default)
        - 1 # 64

child-binding:
  properties:
    sample-avg:
      type: int
      description: |
        Per-channel sample averaging exponent (0 <= N <= 7).
        Hardware averages 2^N samples per output. 0 = no averaging (1 sample).
```

## dts/bindings/atmosic,atm34-ieee802154.yaml
```yaml
# Copyright (c) Atmosic 2024-2026
# SPDX-License-Identifier: LicenseRef-Atmosic

description: Atmosic ATM34 IEEE 802.15.4 node

compatible: "atmosic,atm34-ieee802154"

include: base.yaml
```

## dts/bindings/atmosic,atmx3-adc.yaml
```yaml
# Copyright (c) 2021-2026 Atmosic
# SPDX-License-Identifier: LicenseRef-Atmosic

description: Atmosic ADC for ATMx3

compatible: "atmosic,atmx3-adc"

include: atmosic,adc-controller.yaml

properties:
    interrupts:
      required: true
```

## dts/bindings/atmosic,atmx3-pmu.yaml
```yaml
# Copyright (c) 2024-2026 Atmosic
# SPDX-License-Identifier: LicenseRef-Atmosic

description: Atmosic PMU

compatible: "atmosic,atmx3-pmu"

include: base.yaml

properties:
  reg:
    required: true

  interrupts:
    required: true
    description: |
      PMU interrupt (PMU_IRQn) for brownout, PMU watchdog warning, and energy monitoring events.
      The PMU driver provides a central handler that dispatches to appropriate sub-handlers based
      on compile-time configuration (CONFIG_ATM_BROWNOUT, CONFIG_WDT_ATMOSIC_PMU_ENABLE).

  batt-type:
    type: int
    enum:
      - 0 # Li-ion
      - 1 # Rechargeable
      - 2 # No battery
      - 3 # Non-rechargeable
    required: false
    description: |
      The battery type is specified through OTP and defaults to non-rechargeable. This
      property can override that default based on the board design.

      If ``batt-type = <0>`` (Li-ion) is used, first power the board using a power
      source that is not lithium-ion, then load a program with ``batt-type`` set
      to ``<0>``. This enables the lithium-ion power circuit. The non-lithium-ion
      power source can then be disconnected, the lithium-ion battery can be
      connected, and operation can proceed normally.

  batt-level:
    type: int
    enum:
      - 0 # <= 1.8 V
      - 1 # > 1.8 V
    required: false
    description: |
      The battery level is specified through OTP and defaults to ``> 1.8 V``.
      This property can override that default.

  vddio-type:
    type: int
    enum:
      - 0 # Internal
      - 1 # External
    required: false
    description: |
      The VDDIO type defaults to Internal and can be overridden through the ``vddio-type``
      property based on the board design.

      The external VDDIO type is determined by the source on the board, which
      is commonly assumed to be ``VBAT``. Therefore, it is supported only for
      ``batt-level = <1>`` (``> 1.8 V``).

  vstore-max:
    type: int
    required: false
    description: |
      The VSTORE maximum is specified through OTP and can be overridden through the
      ``vstore-max`` property.

      Supported values for ``vstore-max``:

      * 1500 mV to 3000 mV in 50 mV steps
      * 3100 mV
      * 3300 mV (default)

  vddpa-src:
    type: int
    enum:
      - 0 # VDDIOP
      - 1 # VDDPAP / VSTORE
      - 2 # None
    required: false
    description: |
      Supply source for VDDPA.

  nonrf-harv:
    type: boolean
    required: false
    description: |
      Enables photovoltaic (PV) harvesting. Can be specified with ``rf-harv`` to enable
      combined harvesting.

  vharv-range:
    type: int
    enum:
      - 0 # 0.4 V - 0.45 V
      - 1 # 0.45 V - 0.5 V
      - 2 # 0.525 V - 0.6 V
      - 3 # 0.6 V - 0.7 V
      - 4 # 0.675 V - 0.8 V
      - 5 # 0.75 V - 0.9 V
      - 6 # 0.825 V - 1.0 V
      - 7 # 0.9 V - 1.1 V
      - 8 # 0.975 V - 1.2 V
      - 9 # 1.05 V - 1.3 V
      - 10 # 1.175 V - 1.45 V
      - 11 # 1.3 V - 1.6 V
      - 12 # 1.5 V - 1.8 V
      - 13 # 1.7 V - 2.0 V
      - 14 # 1.95 V - 2.25 V
      - 15 # 2.2 V - 2.5 V
    required: false
    description: |
      The harvesting range must be specified when using PV harvesting and needs to
      match the PV cell operating region.

  boost-from-vharv-inductor:
    type: boolean
    required: false
    description: |
      This option is only available with ``batt-type = <0>`` (Li-ion), PV
      harvesting enabled, and a valid ``vharv-range`` setting.

      Refer to the application notes for the applicable scenarios, hardware connections,
      and performance.

      Based on the selected PV cell characteristics, choose the lower or upper
      level of ``vharv-range`` by enabling one of these properties:

      * ``vharv-ll``
      * ``vharv-ul``

  vharv-ll:
    type: boolean
    required: false
    description: |
      Select the lower level of the configured ``vharv-range``.

  vharv-ul:
    type: boolean
    required: false
    description: |
      Select the upper level of the configured ``vharv-range``.

  dig-test-out-pin:
    type: int
    required: false
    description: |
      Digital test output pin. Set when using inductive boost.

  boost-io-pin:
    type: int
    required: false
    description: |
      Boost I/O pin. Set when using two-diode boost.

  boost-from-vharv-two-diode:
    type: boolean
    required: false
    description: |
      This option is only available with ``batt-type = <0>`` (Li-ion), PV
      harvesting enabled, and a valid ``vharv-range`` setting.

      Refer to the application notes for the applicable scenarios, hardware connections,
      and performance.

  boost-from-vstore-two-diode:
    type: boolean
    required: false
    description: |
      This option is only available with ``batt-type = <0>`` (Li-ion), PV
      harvesting enabled, and a valid ``vharv-range`` setting.

      Refer to the application notes for the applicable scenarios, hardware connections,
      and performance.

  rf-harv:
    type: boolean
    required: false
    description: |
      Enables RF harvesting. Can be specified with ``nonrf-harv`` to enable
      combined harvesting.

  harv-meter:
    type: boolean
    required: false
    description: |
      Supported only when MPPT is disabled. The application must call the
      ``pmu_set_harv_meter()`` API to start or stop the meter.

      Instantaneous power computation depends on the configured
      ``vharv-range`` and the inductor used.

  inductor-nhenry:
    type: int
    required: false
    description: |
      Inductor value, in nH, used in the board design for the harvesting meter.

  soc-off-lpcomp-wakeup-pin:
    type: int
    description: |
      LP comparator input pin number for SoC-off wakeup.

      Valid values are platform-specific:

      * ATM33xx / ATM34xx: ``3`` or ``4``

      When this property is defined, ``soc-off-lpcomp-ref-level`` must also be defined.

  soc-off-lpcomp-ref-level:
    type: int
    description: |
      LP comparator reference voltage level (``1`` to ``15``).

      The system wakes when the input voltage crosses this threshold.

      This property is required when ``soc-off-lpcomp-wakeup-pin`` is defined.

  xtal-32k-cap-in:
    type: int
    description: |
      32 kHz crystal load value on ``XTALI_32K``. The value is calculated using calibration
      tools.

  xtal-32k-cap-out:
    type: int
    description: |
      32 kHz crystal load value on ``XTALO_32K``. The value is calculated using calibration
      tools.

  hsc-mode:
    type: boolean
    required: false
    description: |
      Indicates whether the design uses a Hybrid Super Cap.

      This is valid only for ``batt-type = <0>`` (Li-ion).
```
