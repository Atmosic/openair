## drivers/ieee802154/Kconfig
```kconfig
# Copyright (c) 2025-2026 Atmosic
# SPDX-License-Identifier: LicenseRef-Atmosic

if IEEE802154

rsource "Kconfig.atm"

endif # IEEE802154
```

## drivers/input/Kconfig
```kconfig
# Copyright (c) 2025-2026 Atmosic
# SPDX-License-Identifier: LicenseRef-Atmosic

if INPUT

rsource "Kconfig.atm"

endif # INPUT
```

## drivers/ir/Kconfig
```kconfig
# Copyright (c) 2026 Atmosic
#
# SPDX-License-Identifier: LicenseRef-Atmosic

config IR_NEC
	bool "Atmosic NEC IR blaster"
	select PWM
	select PWM_ATM_FIFO
	depends on DT_HAS_ATMOSIC_IR_NEC_ENABLED
	help
	  Enable NEC protocol IR transmitter using ATM PWM FIFO DMA.

if IR_NEC

config IR_NEC_DUTY_CYCLE
	int "NEC IR carrier duty cycle (%)"
	default 25
	range 1 99
	help
	  Duty cycle percentage for the 38 kHz IR carrier. The NEC standard
	  specifies 25%.

module = IR_NEC
module-str = ir_nec
source "subsys/logging/Kconfig.template.log_config"

endif # IR_NEC
```

## drivers/pinctrl/Kconfig
```kconfig
# Copyright (c) 2025-2026 Atmosic
# SPDX-License-Identifier: LicenseRef-Atmosic

if PINCTRL

rsource "Kconfig.atm"

endif # PINCTRL
```

## drivers/pinctrl/Kconfig.atm
```kconfig
# Copyright (c) 2024-2026 Atmosic
#
# SPDX-License-Identifier: LicenseRef-Atmosic

config PINCTRL_ATMOSIC_ATM
	bool "Atmosic Pin controller driver"
	default y
	depends on DT_HAS_ATMOSIC_ATM33_PINCTRL_ENABLED || \
	           DT_HAS_ATMOSIC_ATM34_PINCTRL_ENABLED
	help
	  Enable pin control driver for Atmosic MCU's

config ATM_PINCTRL_CLEAR_PUPD_OVRD_ON_GPIO
	bool "Clear WRPR PUPD_OVRD when switching pin to GPIO mode"
	depends on PINCTRL_ATMOSIC_ATM
	help
	  When enabled, clears the WRPR PUPD_OVRD override for a pin before
	  applying GPIO controller pull settings. WRPR overrides take priority
	  over GPIO controller pull registers, so GPIO-level bias-pull-up/down
	  would be ineffective without clearing it first. A write mask guards
	  the call so PIN_PULL_CLR is only invoked on pins that actually
	  support the PUPD_OVRD register bit.
```

## drivers/pwm/Kconfig
```kconfig
# Copyright (c) 2025-2026 Atmosic
# SPDX-License-Identifier: LicenseRef-Atmosic

if PWM

rsource "Kconfig.atm"

endif # PWM
```

## drivers/retained_mem/Kconfig.atm
```kconfig
# Copyright (c) 2025 Atmosic Technologies
# SPDX-License-Identifier: Apache-2.0

config RETAINED_MEM_ATM_HIB
	bool "Atmosic hibernation retained memory driver"
	default y
	depends on DT_HAS_ATMOSIC_RETAINED_HIB_ENABLED
	depends on !ATM_SHUB_ENABLED
	select RETAINED_MEM_BACKEND_SHUB if SOC_SERIES_ATM33 || SOC_SERIES_ATM34 || SOC_SERIES_ATMX2
	select RETAINED_MEM_BACKEND_EXPANSION if !SOC_SERIES_ATM33 && !SOC_SERIES_ATM34 && !SOC_SERIES_ATMX2
	help
	  Enable driver for Atmosic hibernation retained memory support.
	  This driver uses PSEQ (Power Sequencer) persistent registers and
	  optionally SHUB (Sensor Hub) registers (if available) to provide
	  retained memory functionality across hibernation and low power modes.

	  The driver automatically determines storage capacity based on SOC variant
	  and available hardware:

	  ATM33/ATM34 platforms (with SHUB hardware):
	  - With PERSISTENT6: 222 bytes (~178 SHUB + 24 PSEQ)
	  - With PERSISTENT5: 218 bytes (~178 SHUB + 20 PSEQ)
	  - Base configuration: 198 bytes (~178 SHUB + 20 PSEQ)

	  ATM33/ATM34 platforms (without SHUB hardware):
	  - With PERSISTENT6: 24 bytes (6 registers * 4 bytes)
	  - With PERSISTENT5: 20 bytes (5 registers * 4 bytes)

	  Platforms with persistent expansion (no SHUB):
	  - Uses persistent expansion mechanism: 64 - 256 bytes
	  - Different architecture with byte-addressable storage

	  Note: This driver cannot be used when SHUB is enabled for sensor
	  functionality as it conflicts with the register usage.

if RETAINED_MEM_ATM_HIB

config RETAINED_MEM_ATM_FIXED_OFFSET_0
	bool "Fix the offset used for save/restore"
	help
	  Enable this option for an optimized save and restore operation with the
	  starting offset assumed to be fixed to 0.  Enable this only if the
	  application manages all retained operations and does not coordinate use
	  with other software.  The application must only save and restore starting
	  at offset 0 up to the maximum capacity of the storage backend. This feature
	  is EXPERIMENTAL.

config RETAINED_MEM_BACKEND_SHUB
	bool
	help
	  Internal option to select SHUB-based retained memory backend.
	  This backend uses SHUB hardware combined with PSEQ PERSISTENT
	  registers for storage. Used on ATM33/ATM34 platforms.

config RETAINED_MEM_BACKEND_EXPANSION
	bool
	help
	  Internal option to select persistent expansion-based retained
	  memory backend. This backend uses the PSEQ persistent expansion
	  mechanism for byte-addressable storage. Used on platforms without
	  SHUB hardware.

endif

config ATM_SHUB_ENABLED
	bool "Atmosic Sensor Hub (SHUB) functionality enabled"
	help
	  This option indicates that the Atmosic Sensor Hub (SHUB) hardware
	  is being used for sensor functionality. When enabled, it prevents
	  the retained memory driver from using SHUB registers, as they
	  conflict with sensor operations.

	  Enable this option if:
	  - Using SHUB for sensor data collection
	  - Running sensor hub firmware
	  - Using any sensor drivers that require SHUB hardware

	  When this option is enabled, the retained memory driver will be
	  automatically disabled to prevent register conflicts.
```

## drivers/sensor/Kconfig
```kconfig
# Copyright (c) 2024-2026 Atmosic
# SPDX-License-Identifier: LicenseRef-Atmosic

if SENSOR

rsource "mcp3221/Kconfig"

endif # SENSOR
```

## drivers/serial/Kconfig
```kconfig
# Copyright (c) 2025-2026 Atmosic
# SPDX-License-Identifier: LicenseRef-Atmosic

if SERIAL

rsource "Kconfig.atm"

endif # SERIAL
```

## drivers/spi/Kconfig
```kconfig
# Copyright (c) 2025-2026 Atmosic
# SPDX-License-Identifier: LicenseRef-Atmosic

if SPI

rsource "Kconfig.atm"

endif # SPI
```

## drivers/timer/Kconfig
```kconfig
# Copyright (c) 2026 Atmosic Technologies, Inc.
# SPDX-License-Identifier: LicenseRef-Atmosic

if SYS_CLOCK_EXISTS

rsource "Kconfig.cmsdk_timer"

endif # SYS_CLOCK_EXISTS
```

## drivers/timer/Kconfig.cmsdk_timer
```kconfig
# Copyright (c) 2026 Atmosic Technologies, Inc.
# SPDX-License-Identifier: Apache-2.0

config CMSDK_TIMER
	bool "ARM CMSDK Timer (System Clock)"
	default y
	depends on DT_HAS_ARM_CMSDK_SYSTIMER_ENABLED
	select TICKLESS_CAPABLE
	select SYSTEM_TIMER_HAS_DISABLE_SUPPORT
	help
	  This module implements a kernel device driver for the ARM CMSDK
	  Timer and provides the standard "system clock driver" interfaces.

	  The CMSDK Timer is a 32-bit down-counting timer found in ARM
	  Corstone and similar SoC designs.

config CMSDK_TIMER_64BIT_CYCLE_COUNTER
	bool "Use 64-bit cycle counter"
	depends on CMSDK_TIMER
	default y if (SYS_CLOCK_HW_CYCLES_PER_SEC > 60000000)
	select TIMER_HAS_64BIT_CYCLE_COUNTER
	help
	  Use a 64-bit cycle counter internally to avoid overflow issues
	  with long-running systems.
```

## drivers/watchdog/Kconfig.atmosic
```kconfig
# Copyright (c) 2025 Atmosic
# SPDX-License-Identifier: Apache-2.0

if WATCHDOG

config WDT_ATM_UNIFIED
	bool "ATM Unified Watchdog Wrapper"
	depends on WDOG_CMSDK_APB || WDOG_ATMOSIC_CMSDK
	select ATM_PMU
	default y
	depends on DT_HAS_ATMOSIC_UNIFIED_WATCHDOG_ENABLED
	help
	  Unified watchdog driver that wraps the upstream ARM CMSDK APB
	  watchdog driver and adds ATM PMU watchdog management.

	  This driver presents a single watchdog interface to applications
	  while internally managing both ARM and PMU watchdogs. The ARM
	  watchdog operations are delegated to the upstream Zephyr driver,
	  ensuring automatic upstream bug fixes and enhancements.

	  The PMU watchdog provides additional protection during power state
	  transitions (retention, hibernation, SOC_OFF) and operates
	  independently of the ARM watchdog.

endif

config ATM_PMU_WDT_ENABLE
	bool "Enable PMU Watchdog"
	default y
	help
	  Enable ATM PMU watchdog alongside ARM watchdog. When enabled,
	  both watchdogs are configured with the same timeout and fed
	  simultaneously through the unified API.

	  The PMU watchdog provides additional protection during power state
	  transitions and can operate independently of the ARM watchdog.

	  In active state, both watchdogs are fed together. In low power
	  states (retention, hibernation, SOC_OFF), the PMU watchdog uses
	  warning timers to wake the device and maintain operation.

if ATM_PMU_WDT_ENABLE

config ATM_WDT_PMU_WARN_OFFSET_SEC
	int "PMU watchdog warning timer offset (seconds) [ATM34xx only]"
	default 1
	range -3600 3600
	help
	  Time offset applied to the PMU watchdog warning timer relative to the
	  maximum sleep duration (CONFIG_PM_MAX_SLEEP_DURATION_SEC) for all low-power
	  states (retention, hibernation, and SOC-off).

	  The PMU warning timer is set to: max_duration + offset

	  A POSITIVE value (default: 1 second) provides a safety margin - the PMU
	  watchdog warning interrupt will fire AFTER the maximum duration if the
	  system fails to wake up normally. This acts as a backup mechanism to
	  recover from failed wakeups.

	  A NEGATIVE value causes the PMU watchdog warning interrupt to fire BEFORE
	  the maximum duration is reached. This is useful for testing PMU watchdog
	  warning interrupt handling but should not be used in production.

	  A value of 0 means the PMU watchdog warning timer will be set to exactly
	  match the maximum sleep duration and should not be used in production.

	  This option applies to ATM34xx only.

	  Default: 1 second (positive safety margin)
	  Range: -3600 to 3600 seconds (-1 hour to +1 hour)

endif # ATM_PMU_WDT_ENABLE

if WDT_ATM_UNIFIED

config ATM_WDT_UNIFIED_INIT_PRIORITY
	int "ATM Unified Watchdog initialization priority"
	default 8
	range 6 9
	help
	  Initialization priority for the ATM unified watchdog driver at PRE_KERNEL_2.
	  Must be > 5 (after hw_cfg) and < 10 (before pmu) for proper PMU register
	  access and to clear pending interrupts before PMU operations.

config ATM_WDT_UNIFIED_LOG_LEVEL
	int "ATM Unified Watchdog Log Level"
	depends on LOG
	default 3
	range 0 4
	help
	  Sets log level for the ATM unified watchdog wrapper.
	  Levels are:
	  0 = OFF
	  1 = ERROR
	  2 = WARNING
	  3 = INFO
	  4 = DEBUG

endif # WDT_ATM_UNIFIED
```

## dts/bindings/atmosic,adc-controller.yaml
```yaml
# Copyright (c) 2017, NXP
# Copyright (c) 2026 Atmosic
# SPDX-License-Identifier: LicenseRef-Atmosic

# Common fields for ADC controllers

include: adc-controller.yaml

properties:
    resolution:
      type: int
      required: true

    ch-cell:
      type: int
      required: false

    ch-store:
      type: int
      required: false

    ch-core:
      type: int
      required: false

    ch-temp:
      type: int
      required: false

    ch-p1diff:
      type: int
      required: false

    ch-p0diff:
      type: int
      required: false

    ch-p1single0:
      type: int
      required: false

    ch-p1single1:
      type: int
      required: false

    ch-p0single0:
      type: int
      required: false

    ch-p0single1:
      type: int
      required: false

    ch-batt:
      type: int
      required: false

    ch-p2single:
      type: int
      required: false

    ch-p3single:
      type: int
      required: false

    ch-p4single:
      type: int
      required: false

    temp-output-scale:
      type: int
      description: |
        Temperature channel output denominator. The ADC driver returns
        temperature as an integer where 1 LSB = 1/temp-output-scale degC.
        100 = centi-degC (0.01 degC/LSB).
        256 = S8.8 fixed-point (1/256 degC/LSB).
        Defaults to 100 (centi-degC) when not specified.
      enum:
        - 100
        - 256
      default: 100

io-channel-cells:
    - input
```

## dts/bindings/atmosic,atlc-tcm.yaml
```yaml
# Copyright (c) 2026 Atmosic
# SPDX-License-Identifier: LicenseRef-Atmosic

description: |
  Atmosic ATLC TCM

  The ATLC TCM provides dedicated memory regions for radio operations including
  BLE and IEEE 802.15.4. It contains separate sections for TX/RX FIFOs and
  data buffers that are directly accessed by the radio hardware.

compatible: "atmosic,atlc-tcm"

include: base.yaml

child-binding:
  description: TCM memory region.
```

## dts/bindings/atmosic,atm-pdm.yaml
```yaml
# Copyright (c) 2026 Atmosic
#
# SPDX-License-Identifier: LicenseRef-Atmosic

description: |
  Atmosic ATM PDM controller (DMIC)

  Pins are configured through the pinctrl driver. The pinctrl-0 state must list
  the PDM clock group first (index 0) and the PDM data group second (index 1),
  e.g.:

    &pinctrl {
        pdm0_clk_default: pdm0_clk_default {
            pinmux = <16 PINMUX_PDM0_CLK>;
        };
        pdm0_data_default: pdm0_data_default {
            pinmux = <13 PINMUX_PDM0_IN>;
        };
    };

    &pdm0 {
        status = "okay";
        pinctrl-0 = <&pdm0_clk_default &pdm0_data_default>;
        pinctrl-names = "default";
    };

compatible: "atmosic,atm-pdm"

include: [base.yaml, pinctrl-device.yaml]

properties:
  reg:
    required: true
    description: |
      Two reg tuples:
        [0] PDM APB register block base address and size
        [1] PDM ping-pong buffer base address and size

  interrupts:
    required: true

  clocks:
    required: true
    description: Audio reference clock used by the PDM digital processor.

  clock-frequency:
    type: int
    default: 1000000
    description: |
      PDM bit clock frequency in Hz driven to the microphone (500000-4000000).
      The hardware divider is: pdm_clk_sel = round(aud_clk / clock-frequency) - 1
      where aud_clk comes from the clocks phandle (e.g. 16 MHz for clk_16M).
      Valid divider range is sel=3..31, giving 500 kHz to 4 MHz.

  pinctrl-0:
    required: true

  pinctrl-names:
    required: true

  mic-bias-gpios:
    type: phandle-array
    description: |
      Optional GPIO that controls the MIC_BIAS power supply for the external
      PDM microphone. The driver sets this GPIO high on START and low on STOP.
      If not specified, the microphone is assumed to be always powered.
```

## dts/bindings/atmosic,atm-pwm-buzzer.yaml
```yaml
# Copyright (c) 2025-2026 Atmosic
# SPDX-License-Identifier: LicenseRef-Atmosic

description: PWM-driven buzzer.

compatible: "atmosic,atm3x-pwm-buzzer"

include: base.yaml

properties:
  pwms:
    required: true
    type: phandle-array
    description: PWM specifier driving the buzzer.

  min-frequency:
    required: true
    type: int
    description: Minimum frequency supported by this buzzer (Hz).

  max-frequency:
    required: true
    type: int
    description: Maximum frequency supported by this buzzer (Hz).
```

## dts/bindings/atmosic,atm-spi.yaml
```yaml
description: Atmosic SPI

compatible: "atmosic,atm-spi"

include: [spi-controller.yaml, pinctrl-device.yaml]

properties:
    reg:
      required: true

    interrupts:
      required: false

    instance:
      type: int
      required: true
      description: SPI instance

    dummy_cycles:
      type: int
      required: false
      default: 0
      description: Number of extra shift cycles to help with the turn-around

    pinctrl-0:
      required: true

    pinctrl-names:
      required: true
```

## dts/bindings/atmosic,atm-trng.yaml
```yaml
# Copyright (c) 2023-2026 Atmosic
# SPDX-License-Identifier: LicenseRef-Atmosic

description: Atmosic TRNG

compatible: "atmosic,atm-trng"

include: base.yaml

properties:
  reg:
    required: true

  interrupts:
    required: true
```
