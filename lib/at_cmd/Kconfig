## lib/at_cmd/Kconfig
```kconfig
# Copyright (c) 2024-2026 Atmosic
#
# SPDX-License-Identifier: LicenseRef-Atmosic

config ATM_AT_CMD
	bool "Atmosic AT command core and parser library"

if ATM_AT_CMD

config AT_CMD_PREFIX
	string "AT command prefix"
	default "AT+"
	help
	  The prefix string matched byte-by-byte (case-insensitive) to identify
	  the start of an AT command. Change this only if your protocol uses a
	  different command prefix (e.g. "AT#"). Used by all transports (UART,
	  GATT).

config ATM_AT_CMD_UART_TRANSPORT
	bool "AT command UART transport"
	default y
	help
	  Enable the UART transport layer for AT commands. This provides a generic
	  UART driver interface for AT command transport.

if ATM_AT_CMD_UART_TRANSPORT

config AT_CMD_UART_RX_BUF_SIZE
	int "UART RX buffer size"
	default 2048
	range 256 4096
	help
	  Size of the receive buffer used by the UART transport to accumulate
	  incoming AT command bytes. Must be large enough to hold the longest
	  expected command including the header prefix, command name, '=', and
	  all parameters.

endif # ATM_AT_CMD_UART_TRANSPORT

config AT_CMD_XFER_MAX_NUM
	int "Maximum number of AT command transport channels"
	default 3
	range 1 5
	help
	  Maximum number of simultaneous AT command transport channels (e.g.
	  UART, GATT, custom).  Each channel occupies a small static slot
	  (xfer + resp function pointers).  Increase this when multiple
	  transports or test suites allocate channels concurrently.

config AT_CMD_RESP_LEN
	int "AT command response buffer size"
	default 256
	help
	  Maximum size of the underlying AT command response buffer. This defines
	  the maximum length of any fully formatted AT command response string
	  (including prefix, postfix, and all parameters).

config AT_CMD_RSP_FMT_MAX_LEN
	int "AT command response format string maximum length"
	default 64
	help
	  Maximum length of an AT command response format string (e.g., "B,A(0~32)").
	  This is used internally by the AT command parser when processing responses.

module = AT_CMD
module-str = at_cmd
source "subsys/logging/Kconfig.template.log_config"

endif # ATM_AT_CMD
```

## lib/at_cmd_set/Kconfig
```kconfig
# Copyright (c) 2024-2026 Atmosic
#
# SPDX-License-Identifier: Apache-2.0

config ATM_AT_CMD_SET
	bool "Atmosic AT command set library (ADVDATA, ADVINT, NAME, SYSRESET, UNLOCK)"
	depends on ATM_AT_CMD
	help
	  Enable the AT command set library which provides the following commands:
	  - ADVDATA: Set advertising data
	  - ADVINT: Set advertising interval
	  - NAME: Set device name
	  - SYSRESET: System reset
	  - UNLOCK: Unlock device for configuration

# Logging configuration for AT command set library
module = ATM_AT_CMD_SET
module-str = atm_at_cmd_set
source "subsys/logging/Kconfig.template.log_config"
```

## lib/atm_asm/Kconfig
```kconfig
# Copyright (c) 2024-2026 Atmosic
#
# SPDX-License-Identifier: LicenseRef-Atmosic

config ATM_ASM
	bool "BLE state machine library"
	default n
config ATM_ASM_MAX_ENTRY
	int "State Machine Max Entries."
	default 1
```

## lib/atm_bthci_utils/Kconfig
```kconfig
# Copyright (c) 2025-2026 Atmosic
#
# SPDX-License-Identifier: LicenseRef-Atmosic

config ATM_BTHCI_UTILS
	bool "Enable BT HCI utilities"

config ATM_BTHCI_UTILS_DUMP_PKTS
	bool "Enable decoding and output of HCI traffic to the console"
```

## lib/atm_debug_auth/Kconfig
```kconfig
# Copyright (c) 2024-2026 Atmosic
#
# SPDX-License-Identifier: LicenseRef-Atmosic

config ATM_SEC_DEBUG_AUTH
	bool "Atmosic Secure Debug Authentication"
	depends on (TRUSTED_EXECUTION_SECURE && MCUBOOT) || ZTEST

if ATM_SEC_DEBUG_AUTH

config ATM_SEC_DEBUG_AUTH_STATIC_CHALLENGE
	bool "Use a static (ROM/Secure Journal derived) debug auth challenge"
	default y

config ATM_SEC_DEBUG_AUTH_SIGNATURE_KEY_FILE
        string "Secure Boot key file"
        default "root-debug-ec-p256.pem"

endif # ATM_SEC_DEBUG_AUTH
```

## lib/atm_fmna/Kconfig
```kconfig
# Copyright (c) 2025-2026 Atmosic
#
# SPDX-License-Identifier: Apache-2.0

config ATM_FMNA
	bool "Atmosic Apple FindMy Network service"

config HEAP_MEM_POOL_ADD_SIZE_ATM_FMNA
	int "Heap memory pool size for FMNA service"
	default 2048
	depends on ATM_FMNA
	help
	  Additional heap memory pool size required by Apple FindMy Network service.
	  This includes scheduler work items, GATT indications, and UARP buffers.

config ATM_FMNA_LIB
	bool "Atmosic FMNA static library"
	default y if ATM_FMNA
	depends on ATM_FMNA
	select APP_WORK_Q
	select ATM_UECC
	select ATM_UECC_VLI_API
	select ATM_UECC_SUPPORT_POINT_ADD
	select ATM_UECC_SUPPORTS_SECP224R1
	select ATM_UECC_SUPPORTS_SECP256R1
	select ENTROPY_ATM_TRNG
	select ENTROPY_GENERATOR
	select MBEDTLS
	select MBEDTLS_PSA_CRYPTO_C
	select PSA_WANT_KEY_TYPE_AES
	select PSA_WANT_ALG_GCM
	select PSA_WANT_ALG_SHA_256
	select PSA_WANT_ALG_HMAC
	select PSA_WANT_KEY_TYPE_HMAC

config ATM_FMNA_LIB_DEBUG
	bool "Atmosic FMNA static library enable debug log"
	default y if ATM_FMNA_LIB
	depends on ATM_FMNA_LIB

config USE_UARP
	bool "OTA with Apple UARP"
	select STREAM_FLASH
	select IMG_MANAGER
	select ATM_VENDOR_DFU
	depends on BOOTLOADER_MCUBOOT
	help
	  Enable Apple UARP-based OTA. Routes all incoming firmware bytes
	  through the shared atm_vendor_dfu helper, which transparently
	  handles single-image and dual-image (ATMX-tagged) MCUboot layouts.
```

## lib/atm_hci_uart/Kconfig
```kconfig
# Copyright (c) 2024-2026 Atmosic
#
# SPDX-License-Identifier: LicenseRef-Atmosic

config ATM_HCI_UART
	bool "Atmosic HCI UART module"
	default y if ATM_VENDOR

if ATM_HCI_UART

module = ATM_HCI_UART
module-str = atm_hci_uart
source "subsys/logging/Kconfig.template.log_config"

config ATM_VENDOR_TX_STACK_SIZE
	int "ATM hci uart tx thread stack size"
	default 2048 if COVERAGE
	default 1792

config ATM_VENDOR_RX_STACK_SIZE
	int "ATM hci uart rx thread stack size"
	default 2048 if COVERAGE
	default 1792

choice
	prompt "Atmosic HCI UART DEVICE"
	default ATM_HCI_UART0_DEVICE

config ATM_HCI_UART0_DEVICE
	bool "Use uart0 as HCI uart"

config ATM_HCI_UART1_DEVICE
	bool "Use uart1 as HCI uart"

endchoice

config ATM_HCI_RESET_RX_DC_CAL
	bool "Trigger RX DC offset calibration on HCI reset complete"
	depends on ATM_ATLC
	select ATM_RADIO_HAL_MGR
	select ATM_RADIO_CAL_DEMAND
	select VND_BYPASS_RX_DC_CAL
	help
	  When enabled, a one-shot RX DC offset calibration is triggered when an
	  HCI_reset command complete event is detected. A vendor command
	  (OCF=0x15, OGF=0xF8) is provided to bypass this behaviour.

endif # ATM_HCI_UART
```

## lib/atm_mcuboot_ext/Kconfig
```kconfig
# Copyright (c) 2024-2026 Atmosic
#
# SPDX-License-Identifier: LicenseRef-Atmosic

config ATM_MCUBOOT_EXT
	bool "Atmosic MCUboot extensions"
	depends on MCUBOOT || ZTEST

if ATM_MCUBOOT_EXT

config ATM_MCUBOOT_EXT_LOCK_PRIMARY_SLOT
	bool "Lock the primary slot"
	select ATM_NV_MEM_FLASH_PROT if DT_HAS_ATMOSIC_SEC_NV_MEM_FLASH_PROT_ENABLED
	select ATM_NV_MEM_RRAM_PROT if DT_HAS_ATMOSIC_SEC_NV_MEM_RRAM_PROT_ENABLED
	select ATM_RRAM_ROM_PROT if !DT_HAS_ATMOSIC_SEC_NV_MEM_FLASH_PROT_ENABLED && !DT_HAS_ATMOSIC_SEC_NV_MEM_RRAM_PROT_ENABLED

config ATM_MCUBOOT_EXT_SKIP_PRIMARY_VALIDATE_HIBER
	bool "Skip primary slot validation on resume from hibernate"

config ATM_MCUBOOT_UART_DEBUG_AUTH
	bool "Enable Secure UART debug authentication"

config ATM_MCUBOOT_UART_DEBUG_AUTH_TIMEOUT_MS
        int "Debug Auth serial wait duration"
        depends on ATM_MCUBOOT_UART_DEBUG_AUTH
        default 500

endif
```

## lib/atm_shell/Kconfig
```kconfig
# Copyright (c) 2025-2026 Atmosic
#
# SPDX-License-Identifier: LicenseRef-Atmosic

menu "Atmosic Shell"

config ATM_SHELL
	bool "Enable Atmosic shell commands"
	select CRC
	select FLASH
	select SHELL
	help
	  Enable Atmosic shell commands.
endmenu
```

## lib/atm_stf/Kconfig
```kconfig
# Copyright (c) 2026 Atmosic
#
# SPDX-License-Identifier: Apache-2.0

config ATM_STF
	bool "Atmosic Samsung SmartThings Find (STF) TagSDK integration"
	select ATM_VENDOR_DFU
	help
	  Enable Samsung SmartThings Find TagSDK integration.
	  This provides the Atmosic wrapper for the Samsung TagSDK.
	  Note: Requires MBEDTLS configuration in application conf file.

	  Routes the TagSDK firmware-update transport through the shared
	  atm_vendor_dfu helper, which transparently handles single-image
	  and dual-image (ATMX-tagged) MCUboot layouts.

if ATM_STF

config HEAP_MEM_POOL_ADD_SIZE_ATM_STF
	int "Heap memory pool size for STF TagSDK"
	default 7168
	help
	  Additional heap memory pool size required by Samsung SmartThings Find TagSDK.
	  This includes security contexts, crypto buffers, BLE events, and control service data.

config ATM_STF_MULTI_MODE
	bool "Multi-Mode Samsung SmartThings support"
	help
	  Enable multi-mode support for Samsung SmartThings Find,
	  allowing coexistence with other tracking networks like FMNA and GFP.

endif # ATM_STF
```

## lib/atm_utils_slist/Kconfig
```kconfig
# Copyright (c) 2024-2026 Atmosic
#
# SPDX-License-Identifier: LicenseRef-Atmosic

config ATM_UTILS_SLIST
	bool "Atmosic lib singly linked list module"
```

## lib/atm_vendor_dfu/Kconfig
```kconfig
# Copyright (c) 2026 Atmosic
#
# SPDX-License-Identifier: Apache-2.0

config ATM_VENDOR_DFU
	bool "Atmosic vendor-protocol DFU helper"
	depends on FLASH
	depends on FLASH_MAP
	help
	  Shared DFU helper consumed by vendor OTA protocols (Samsung TagSDK,
	  Apple FMNA UARP, ...) so each vendor port can call a single uniform
	  API without having to know the local MCUboot / partition layout.

	  Behaviour is selected at compile time from devicetree:

	    * If both slot1_partition and slot3_partition exist, the helper
	      runs in dual-image mode: a 32-byte "ATMX" header at the start
	      of the stream selects the per-image sizes, Image 0 is routed
	      to slot1_partition and Image 1 to slot3_partition. The combined
	      binary is produced offline by scripts/pack_combined_image.py.

	    * If only slot1_partition exists, the helper runs in single-image
	      mode: incoming bytes are streamed directly into slot1_partition
	      with no header parsing.

	    * If slot1_partition is missing, every API call returns -ENOTSUP
	      with a warning so vendor protocols built without MCUboot still
	      link and run cleanly.

	  When CONFIG_MCUBOOT_BOOTLOADER_MODE_SWAP_USING_OFFSET is enabled,
	  the helper shifts each slot write by the first sector size so
	  MCUboot can accept the secondary-slot images. Upgrade requests are
	  forwarded to MCUboot via boot_request_upgrade_multi() when
	  CONFIG_MCUBOOT_IMG_MANAGER is enabled, and otherwise return
	  -ENOSYS.

if ATM_VENDOR_DFU

module = ATM_VENDOR_DFU
module-str = atm_vendor_dfu
source "subsys/logging/Kconfig.template.log_config"

endif # ATM_VENDOR_DFU
```

## lib/atvv/Kconfig
```kconfig
# Copyright (c) Atmosic 2026
#
# SPDX-License-Identifier: LicenseRef-Atmosic

config ATM_ATVV
	bool "Android TV Voice (ATVV) GATT service library"
	depends on BT && BT_PERIPHERAL
	default n
	help
	  Enable the Atmosic ATVV library, which registers a static GATT
	  service implementing the Android TV Voice (Voice over BLE) profile.
	  Provides atvv_init(), atvv_send_audio_frame(), atvv_send_ctl(),
	  atvv_send_caps_resp(), atvv_send_audio_start(), atvv_send_audio_stop(),
	  atvv_send_mic_open_error(), and atvv_send_audio_sync().
	  See the ATVV_SPEC_VERSION choice to select the wire-format spec
	  version to implement.

if ATM_ATVV

config ATVV_LOG_LEVEL
	int "ATVV log level"
	default 3
	range 0 4

choice ATVV_SPEC_VERSION
	prompt "ATVV protocol spec version"
	default ATVV_SPEC_V1_0
	help
	  Selects which "Google Voice over BLE" spec version's wire format
	  is implemented.

config ATVV_SPEC_V0_4
	bool "Voice over BLE [Remote control specs] v0.4e"

config ATVV_SPEC_V1_0
	bool "Google Voice over BLE spec 1.0"

endchoice

endif # ATM_ATVV
```

## lib/audio_codec/Kconfig
```kconfig
# Copyright (c) Atmosic 2026
#
# SPDX-License-Identifier: LicenseRef-Atmosic

config AUDIO_ADPCM_ENC
	bool "IMA ADPCM encoder"
	default n
	help
	  Enable the Atmosic IMA ADPCM 4-bit encoder library.
	  Provides adpcm_reset(), adpcm_encode_sample(), adpcm_get_index(),
	  and adpcm_encode_buf().
```

## lib/dtm_2wire/Kconfig
```kconfig
# Copyright (c) 2025-2026 Atmosic
#
# SPDX-License-Identifier: LicenseRef-Atmosic

menuconfig DTM_2WIRE
	bool "DTM 2-wire Direct Test Mode support"
	depends on BT
	help
	  Enable DTM 2-wire Direct Test Mode support. This provides
	  a lightweight 2-wire UART interface for Bluetooth LE radio
	  testing using the DTM protocol specified in Bluetooth Core
	  Specification Volume 6, Part F.

if DTM_2WIRE

module = DTM_2WIRE
module-str = DTM-2-wire
source "subsys/logging/Kconfig.template.log_config"

config DTM_2WIRE_E2E
    bool "Implement full end-to-end DTM processing"
    default y
    help
      The application can disable this option to utilize a minimum
      set of manager and HCI bridge software interfaces to process
      DTM messages.

config DTM_2WIRE_USER_DATA_LEN_PROPS
    bool "Use user provided data len properties"
    default n
    help
      The application can set this to use static default properties.
      This is useful where a link layer may not implement the
      HCI_LE_READ_MAX_DATA_LEN opcode.

choice DTM_2WIRE_RX_TESTING
    prompt "RX Testing support"
    default DTM_2WIRE_RX_TESTING_ENABLED
    help
      Select how the library handles DTM Receiver Test commands.

config DTM_2WIRE_RX_TESTING_ENABLED
    bool "Enabled"
    help
      Full RX testing. The library forwards the Receiver Test command
      to the controller via HCI and reports the actual packet count on
      test end. Use in applications where the BLE controller RX path
      is available.

config DTM_2WIRE_RX_TESTING_DISABLED
    bool "Disabled"
    help
      No RX testing. Receiver Test commands are rejected. Use in
      transmit-only applications.

config DTM_2WIRE_RX_TESTING_SIMULATED
    bool "Simulated"
    help
      Simulated RX testing. The library accepts Receiver Test commands
      and returns success, but never issues an HCI command to the
      controller. When the test ends, the library always reports
      0 packets received. Use when the controller does not support RX
      but the test host expects RX commands to succeed.

endchoice

config DTM_2WIRE_EXT
    bool "Support extended PHY"
    default y
    help
      Support for extended testing can be disabled and fall back
      to legacy 1M PHY.

config DTM_2WIRE_RESET_RX_DC_CAL
    bool "Trigger RX DC offset calibration on DTM reset complete"
    depends on ATM_ATLC
    select ATM_RADIO_HAL_MGR
    select ATM_RADIO_CAL_DEMAND
    help
      When enabled, a one-shot RX DC offset calibration is triggered when a DTM
      reset command completes successfully (DTM_CTRL_RESET). A vendor-specific
      DTM setup control command (DTM_CTRL_BYPASS_RX_DC_CAL, ctrl=0x3F) is
      provided to bypass this behaviour.

if DTM_2WIRE_USER_DATA_LEN_PROPS

# See:  Vol 6, Part B, section 4.5.10

config DTM_2WIRE_USER_DATA_LEN_MAX_TX_OCTETS
    int "Max TX Octets"
    default 27

config DTM_2WIRE_USER_DATA_LEN_MAX_TX_TIME
    int "Max TX Time"
    default 328

config DTM_2WIRE_USER_DATA_LEN_MAX_RX_OCTETS
    int "Max RX Octets"
    default 27

config DTM_2WIRE_USER_DATA_LEN_MAX_RX_TIME
    int "Max RX Time"
    default 328

endif # DTM_2WIRE_USER_DATA_LEN_PROPS

endif # DTM_2WIRE
```
