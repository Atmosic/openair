## lib/gfp_crypto/Kconfig
```kconfig
# Copyright (c) 2025-2026 Atmosic
#
# SPDX-License-Identifier: LicenseRef-Atmosic

config ATM_GFP_CRYPTO
	bool "Atmosic Google Fast Pair crypto implementation"
	select ENTROPY_ATM_TRNG
	select ENTROPY_GENERATOR
	select MBEDTLS
	select MBEDTLS_PSA_CRYPTO_C
	# PSA crypto for AES ECB operations
	select PSA_WANT_ALG_ECB_NO_PADDING
	select PSA_WANT_KEY_TYPE_AES
	# PSA crypto for SHA256 and HMAC-SHA256 operations
	select PSA_WANT_ALG_SHA_256
	select PSA_WANT_ALG_HMAC
	select PSA_WANT_KEY_TYPE_HMAC
	help
	  Enable Atmosic Google Fast Pair crypto implementation.
	  - Uses PSA crypto APIs for AES, SHA256, and HMAC operations
	  - ECP operations use uECC directly

if ATM_GFP_CRYPTO

choice ATM_GFP_CRYPTO_ECP_INTERFACE
	prompt "Select ECP interface"
	default ATM_GFP_DIRECT_UECC_INTERFACE
	help
	  Select the ECP interface to be used for elliptic curve operations.

config ATM_GFP_DIRECT_UECC_INTERFACE
	bool "Use uECC library directly for ECP operations"
	select ATM_UECC
	select ATM_UECC_VLI_API
	select ATM_UECC_SUPPORTS_SECP160R1
	select ATM_UECC_SUPPORTS_SECP256R1
	help
	  This option allows the ECP module to call uECC API directly for secp160r1
	  and secp256r1 curve support. This is the recommended option for better
	  performance and smaller code size.

endchoice

module = GFP_CRYPTO
module-str = gfp_crypto
source "${ZEPHYR_BASE}/subsys/logging/Kconfig.template.log_config"

endif # ATM_GFP_CRYPTO
```

## lib/hogp/Kconfig
```kconfig
# Copyright (c) Atmosic 2026
#
# SPDX-License-Identifier: LicenseRef-Atmosic

config ATM_HOGP
	bool "HID over GATT Profile (HOGP) library"
	depends on BT && BT_PERIPHERAL
	default n
	help
	  Enable the Atmosic HOGP library, which registers a static GATT
	  HID service with keyboard INPUT, LED OUTPUT, and Consumer Control
	  INPUT reports.  Provides hogp_init(), hogp_send_kbd_report(), and
	  hogp_send_consumer_report().

if ATM_HOGP

config HOGP_LOG_LEVEL
	int "HOGP log level"
	default 3
	range 0 4

endif # ATM_HOGP
```

## lib/micro-ecc/Kconfig
```kconfig
# Copyright (c) 2024 Atmosic
#
# SPDX-License-Identifier: Apache-2.0

config ATM_UECC
	bool "Optimized ECC library"
	default y if ATM_UECC_PSA

config ATM_UECC_PSA
	bool "uECC-backed PSA ECC driver"
	depends on PSA_WANT_ALG_ECDSA
	depends on !USERSPACE
	help
	  Route mbedtls_psa_ecdsa_sign_hash(),
	  mbedtls_psa_ecdsa_verify_hash() and
	  mbedtls_psa_key_agreement_ecdh() through the uECC software
	  implementation for the curves uECC supports (secp192r1 / secp224r1 /
	  secp256r1 / secp256k1). All other curves and deterministic ECDSA
	  sign fall through to the Mbed TLS software path via linker --wrap
	  (__real_mbedtls_psa_*).

	  mbedtls_psa_ecp_generate_key() is intentionally not wrapped: the
	  software path only generates the random scalar (no point arithmetic)
	  because PSA stores ECC key pairs as the bare scalar and defers
	  Q = d*G to the next psa_export_public_key() / key-agreement call,
	  whereas uECC_make_key() always computes Q -- so wrapping keygen
	  would do an unnecessary scalar mult that the software load path
	  would then repeat at use time.

	  Note: uECC is a portable, hand-tuned C library, not a hardware
	  accelerator -- this option enables the optimized software ECC path
	  through PSA, not any Atmosic ECC peripheral.

	  Code-size note: in this default (with-fallback) mode the link still
	  pulls in the Mbed TLS PSA software ECC backend (which transitively
	  pulls in mbedtls bignum / ecp) so the __real_* fallback can run.
	  See ATM_UECC_PSA_NO_FALLBACK for a smaller variant suitable for the
	  bootloader.

config ATM_UECC_PSA_NO_FALLBACK
	bool "Omit Mbed TLS software ECC fallback (smaller image)"
	depends on ATM_UECC_PSA
	help
	  Compile the PSA wrapper without any reference to
	  __real_mbedtls_psa_ecdsa_sign_hash / ..._verify_hash /
	  ..._key_agreement_ecdh. Unsupported curves, deterministic ECDSA
	  on sign, and ECC-key-pair verify (which uECC cannot service
	  directly) return PSA_ERROR_NOT_SUPPORTED instead of falling
	  through to software.

	  Because the wrapper is the sole caller of the built-in PSA ECDSA
	  entry points and --wrap redirects every other reference to
	  __wrap_*, dropping the __real_* calls makes the original
	  mbedtls_psa_ecdsa_* objects (and their bignum / ecp dependencies)
	  unreferenced, so the linker drops them. This recovers the code-size
	  win that the legacy MBEDTLS_ECP_ALT path (ecp_alt.c, removed in
	  Mbed TLS 4.x) used to provide for MCUboot.

	  This option additionally redirects mbedtls_psa_ecp_import_key()
	  through a uECC-shaped stub that validates the PSA key encoding
	  (uncompressed SEC1 for public, raw scalar for key pair) and copies
	  it into storage. The on-curve check that the software import path
	  performs is skipped: a malformed public key is caught at verify
	  time as PSA_ERROR_INVALID_SIGNATURE.

	  Enable this only in images that are committed to "uECC-supported
	  curves only" -- typically the MCUboot bootloader, which signs/
	  verifies with secp256r1.

if ATM_UECC

config ATM_UECC_VLI_API
	bool "Enable uECC VLI API"
	help
	  This option enables the uECC VLI API .

if ATM_UECC_VLI_API

config ATM_UECC_SUPPORTS_SECP160R1
	bool "Support secp160r1"
	help
	  To enable support secp160r1 curve

config ATM_UECC_SUPPORTS_SECP192R1
	bool "Support secp192r1"
	help
	  To enable support secp192r1 curve

config ATM_UECC_SUPPORTS_SECP224R1
	bool "Support secp224r1"
	help
	  To enable support secp224r1 curve

config ATM_UECC_SUPPORTS_SECP256R1
	bool "Support secp256r1"
	help
	  To enable support secp256r1 curve

config ATM_UECC_SUPPORTS_SECP256K1
	bool "Support secp256k1"
	help
	  To enable support secp256k1 curve

config ATM_UECC_SUPPORT_COMPRESSED_POINT
	bool "Support compressed point"
	help
	  To enable support compressed point

config ATM_UECC_SUPPORT_POINT_ADD
	bool "Support point addition"
	help
	  To enable support point addition

endif # ATM_UECC_VLI_API

endif # ATM_UECC
```

## lib/ranging_oob_de/Kconfig
```kconfig
# Copyright (c) 2025 Atmosic
#
# SPDX-License-Identifier: Apache-2.0

# Ranging Capability Out-of-Band Data Element Library Configuration

config RANGING_OOB_DE
	bool "Ranging Capability Out-of-Band Data Element Library"
	help
	  Enable the Ranging Capability Out-of-Band (OOB) Data Element library.
	  This library provides APIs for creating, parsing, and validating
	  ranging capability data elements used in Fast Pair Find My Device
	  Network and other ranging applications.

if RANGING_OOB_DE

config RANGING_OOB_DE_TYPE_BLE_CS_CONFIG_SEC_TYPE
	bool "Include security type in BLE CS configuration"
	help
	  Include security type in BLE CS configuration data element.
	  This is required for Fast Pair Find My Device Network.

config RANGING_OOB_DE_TECH_TRANS_TYPE
	hex "Ranging OOB DE Technology Transition Type"
	default 0x01
	range 0x0 0x1
	help
	  Select the technology transition type of the Ranging OOB DE responder.
	  0x00 - Break-before-make is supported.
	  0x01 - Make-before-break is supported. The responder is capable of
	         ranging with multiple technologies concurrently.

config RANGING_OOB_DE_DEV_TYPE
	hex "Ranging OOB DE Device Type"
	default 0x03
	help
	  Select the device type of the Ranging OOB DE responder.
	  0x00 - Unknown
	  0x01 - Phone
	  0x02 - Tablet
	  0x03 - Tag
	  0x04 - Wearable
	  0x05 - Hearable
	  0xFF - RFU

endif # RANGING_OOB_DE
```

## lib/sec_assert/Kconfig
```kconfig
# Copyright (c) 2026 Atmosic
#
# SPDX-License-Identifier: LicenseRef-Atmosic

config ATM_SEC_ASSERT_TEST
	bool "Enable sec_assert for testing"
	depends on ZTEST
	help
	  Enables testing options for this driver.

if ATM_SEC_ASSERT_TEST

config ATM_SEC_ASSERT_COVERAGE_RETURN
	bool "Return from sec_assert instead of halting under gcov coverage"
	depends on COVERAGE
	help
	  When enabled, sec_assert() returns to its caller instead of halting.
	  This is only intended for coverage testing.

endif
```

## lib/sec_service/Kconfig
```kconfig
# Copyright (c) 2025-2026 Atmosic
#
# SPDX-License-Identifier: LicenseRef-Atmosic

config ATM_VERIFY_ATMWSTK
	bool "Verify the fixed ATMWSTK image integrity at runtime"
	depends on USE_FIXED_ATMWSTK
	select ATM_SHA2
	help
	  Enable ATMWSTK stack verification API.

config ATM_PROT
	bool "Enable Atmosic platform protections"
	select ATM_NV_MEM_FLASH_PROT if DT_HAS_ATMOSIC_SEC_NV_MEM_FLASH_PROT_ENABLED

if ATM_PROT

config ATM_PROT_DISABLE_SHUB
	bool "Disable Sensor Hub"

config ATM_PROT_DISABLE_ROM_PATCH
	bool "Disable ROM PATCH controller"

config ATM_PROT_DISABLE_OTP
	bool "Disable OTP controller"

config ATM_PROT_RP_BOOT_ROM
	bool "Read protect the boot ROM"

config ATM_PROT_WP_ATMWSTK
	bool "Write protect the ATMWSTK image, if used"

config ATM_PROT_RP_MCUBOOT
	bool "Read protect the MCUBOOT image, if used"

endif

config ATM_PROT_AUTO
	bool "Auto enable platform protections"
	default y if ATM_NO_SPE
	depends on !ARM_FIRMWARE_HAS_SECURE_ENTRY_FUNCS
	select ATM_PROT
	select ATM_PROT_WP_ATMWSTK
	select ATM_PROT_RP_MCUBOOT
	select ATM_PROT_RP_BOOT_ROM
	select ATM_PROT_DISABLE_OTP
	select ATM_PROT_DISABLE_ROM_PATCH
	select ATM_PROT_DISABLE_SHUB
	help
	  This option will protect the platform at early bootup in the absence of
	  the SPE. When a SPE in use it will use this protection library to enable
	  protections before enabling the SAU.
```

## modules/hal_atmosic/ATM33xx-5/drivers/brwnout/Kconfig
```kconfig
# Copyright (c) 2024-2026 Atmosic
#
# SPDX-License-Identifier: LicenseRef-Atmosic

config ATM_BROWNOUT
	bool "Enable brownout support"
	depends on !$(dt_nodelabel_has_prop,pmu,batt-type) || \
		$(dt_nodelabel_int_prop,pmu,batt-type) != 2
```

## modules/hal_atmosic/ATM33xx-5/drivers/workarounds/Kconfig
```kconfig
# Copyright (c) 2024-2026 Atmosic
#
# SPDX-License-Identifier: Apache-2.0

config ATM_WORKAROUNDS
	bool "Atmosic Workarounds module"
	default y if ADC
	default y if BT
	default y if ENTROPY_ATM_TRNG
	default y if PM

config ATM_PMU_WORKAROUNDS
	bool "Atmosic PMU workarounds via SPI interface"
	depends on ATM_WORKAROUNDS
	default y
	help
	  Enable support for ATM_TAG_PMU_W journal entries that apply PMU
	  workarounds through the SPI interface (spi_pmuradio_*).  Disable
	  on platforms where the PMU is not accessible via SPI.
```

## modules/hal_atmosic/ATM34xx/drivers/Kconfig
```kconfig
# Copyright (c) 2023-2025 Atmosic
#
# SPDX-License-Identifier: Apache-2.0

rsource "*/Kconfig"
```

## modules/hal_atmosic/ATM34xx/drivers/at_tz_ppc/Kconfig
```kconfig
# Copyright (c) 2024-2026 Atmosic
#
# SPDX-License-Identifier: Apache-2.0

config ATM_TZ_PPC
	bool "Atmosic TrustZone Peripheral Protection Controller module"
	default y if DT_HAS_ATMOSIC_SEC_TZ_ENABLED
	depends on TRUSTED_EXECUTION_SECURE
```
