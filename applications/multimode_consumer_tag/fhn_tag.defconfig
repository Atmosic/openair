## applications/sensor_beacon/tests/testcase.yaml
```yaml
common:
  sysbuild: true
  harness: ztest
  depends_on:
    - i2c
    - lis2dh

tests:
  applications.sensor_beacon.tests.atm:
    tags:
      - sensor_beacon_tests
```

## boards/atmosic/atm33evk/Kconfig.ATMEVK-3325-CM-6
```kconfig
# Copyright (c) 2025-2026 Atmosic
# SPDX-License-Identifier: LicenseRef-Atmosic

config BOARD_ATMEVK_3325_CM_6
	select SOC_ATM33XX_5
```

## boards/atmosic/atm33evk/Kconfig.ATMEVK-3325-QK-6
```kconfig
# Copyright (c) 2021-2026 Atmosic
# SPDX-License-Identifier: LicenseRef-Atmosic

config BOARD_ATMEVK_3325_QK_6
	select SOC_ATM33XX_5
```

## boards/atmosic/atm34evk/ATMEVK-3405-PBV-5_mcuboot_bl_defconfig
```kconfig
CONFIG_BOOT_SIGNATURE_TYPE_ECDSA_P256=y
CONFIG_BOOT_ECDSA_MBEDTLS=y
CONFIG_BOOT_SHA2_ATM=y
CONFIG_BOOT_MAX_IMG_SECTORS_AUTO=n
CONFIG_BOOT_MAX_IMG_SECTORS=512
```

## boards/atmosic/atm34evk/Kconfig.ATMEVK-3405-PBV-5
```kconfig
# Copyright (c) 2025-2026 Atmosic
# SPDX-License-Identifier: LicenseRef-Atmosic

config BOARD_ATMEVK_3405_PBV_5
	select SOC_ATM34XX_5
```

## boards/atmosic/atm34evk/Kconfig.ATMEVK-3405-PQK-5
```kconfig
# Copyright (c) 2021-2026 Atmosic
# SPDX-License-Identifier: LicenseRef-Atmosic

config BOARD_ATMEVK_3405_PQK_5
	select SOC_ATM34XX_5
```

## boards/atmosic/atm34evk/board.yml
```yaml
boards:
- name: ATMEVK-3405-PQK-5
  full_name: ATMEVK-3405-PQK-5
  vendor: atmosic
  revision:
    format: custom
    default: normal
    revisions:
    - name: mcuboot
    - name: mcuboot_bl
    - name: normal
  socs:
    - name: ATM34xx-5

- name: ATMEVK-3430e-YQN-5
  full_name: ATMEVK-3430e-YQN-5
  vendor: atmosic
  revision:
    format: custom
    default: normal
    revisions:
    - name: mcuboot
    - name: mcuboot_bl
    - name: normal
  socs:
    - name: ATM34xx-5

- name: ATMEVK-3405-YBV-5
  full_name: ATMEVK-3405-YBV-5
  vendor: atmosic
  revision:
    format: custom
    default: normal
    revisions:
    - name: mcuboot
    - name: mcuboot_bl
    - name: normal
  socs:
    - name: ATM34xx-5

- name: ATMBTCSTAG-3405
  full_name: ATMBTCSTAG-3405
  vendor: atmosic
  revision:
    format: custom
    default: normal
    revisions:
    - name: mcuboot
    - name: mcuboot_bl
    - name: normal
  socs:
    - name: ATM34xx-5

- name: ATMMOD-3405
  full_name: ATMMOD-3405
  vendor: atmosic
  revision:
    format: custom
    default: normal
    revisions:
    - name: mcuboot
    - name: mcuboot_bl
    - name: normal
  socs:
    - name: ATM34xx-5

- name: ATMEVK-3405-WQK-5
  full_name: ATMEVK-3405-WQK-5
  vendor: atmosic
  revision:
    format: custom
    default: normal
    revisions:
    - name: mcuboot
    - name: mcuboot_bl
    - name: normal
  socs:
    - name: ATM34xx-5

- name: ATMEVK-3405-PBV-5
  full_name: ATMEVK-3405-PBV-5
  vendor: atmosic
  revision:
    format: custom
    default: normal
    revisions:
    - name: mcuboot
    - name: mcuboot_bl
    - name: normal
  socs:
    - name: ATM34xx-5
```

## boards/atmosic/atm5evk/ATMEVK-5305-NQK-2_mcuboot_bl_defconfig
```kconfig
CONFIG_BOOT_SIGNATURE_TYPE_ECDSA_P256=y
CONFIG_BOOT_ECDSA_PSA=y
CONFIG_BOOT_SHA2_ATM=y
CONFIG_BOOT_MAX_IMG_SECTORS=512
CONFIG_MULTITHREADING=n
```

## boards/atmosic/atm5evk/Kconfig.ATMEVK-5205-NQK-2
```kconfig
# Copyright (c) 2026 Atmosic
#
# SPDX-License-Identifier: LicenseRef-Atmosic

config BOARD_ATMEVK_5205_NQK_2
	select SOC_ATM5XXX_2
```

## boards/atmosic/atm5evk/Kconfig.ATMEVK-5305-NBV-2
```kconfig
# Copyright (c) 2026 Atmosic
#
# SPDX-License-Identifier: LicenseRef-Atmosic

config BOARD_ATMEVK_5305_NBV_2
	select SOC_ATM5XXX_2
```

## boards/atmosic/atm5evk/Kconfig.ATMEVK-5305e-NQN-2
```kconfig
# Copyright (c) 2024-2026 Atmosic
#
# SPDX-License-Identifier: LicenseRef-Atmosic

config BOARD_ATMEVK_5305E_NQN_2
	select SOC_ATM5XXX_2
```

## boards/atmosic/atm5evk/Kconfig.defconfig
```kconfig
# Copyright (c) 2024-2026 Atmosic
#
# SPDX-License-Identifier: LicenseRef-Atmosic

if SOC_SERIES_ATM5

config ATM_RADIO_HAL_BLE_CS
	default n if BOARD_ATMEVK_5205_NQK_2

config ATM_ENA_LL_FEAT_CS
	default n if BOARD_ATMEVK_5205_NQK_2

config CORTEX_M_SYSTICK
	bool
	default y

config RUNTIME_NMI
	bool
	default y

config USE_DT_CODE_PARTITION
	bool
	default y

# Enable MPU
config ARM_MPU
	bool
	default y

# Enable hardware stack protection
config HW_STACK_PROTECTION
	bool
	default y

# Enable TrustZone-M
config ARM_TRUSTZONE_M
	bool
	default y

config TRUSTED_EXECUTION_SECURE
	bool
	default y
	depends on !$(dt_nodelabel_bool_prop,sec_tz,ns_app)

config TRUSTED_EXECUTION_NONSECURE
	bool
	default y
	depends on $(dt_nodelabel_bool_prop,sec_tz,ns_app)

config ARM_SECURE_BUSFAULT_HARDFAULT_NMI
	default y if TRUSTED_EXECUTION_SECURE

# enable uart driver
config SERIAL
	bool
	default y

# enable console
config CONSOLE
	bool
	default y

config UART_CONSOLE
	bool
	default y

# GPIOs
config GPIO
	bool
	default y if !MCUBOOT

# Watchdog
config WATCHDOG
	bool
	default y if DT_HAS_ARM_CMSDK_WATCHDOG_ENABLED || DT_HAS_ATMOSIC_CMSDK_WATCHDOG_ENABLED

config ATM_RF_DELAY_ONE_EIGHTH_NS
	int
	default 0

config ROM_START_OFFSET
	default 0 if MERGE_SPE_NSPE && BOOTLOADER_MCUBOOT
	default 0x1000 if BOOTLOADER_MCUBOOT

config BUILD_OUTPUT_HEX
	default y

if PM

config IDLE_STACK_SIZE
	int
	default 2048 if COVERAGE_GCOV
	default 1024

endif # PM

config ATM_NO_SPE
	bool
	help
	  Application will operate a single secure image without the SPE. This promptless
	  setting is selected by ATM_NO_TZ option which implies that no SPE will be used.

config ATM_NO_TZ
	bool
	default y
	select ATM_NO_SPE
	depends on !DT_HAS_ATMOSIC_SEC_TZ_ENABLED
	depends on !MCUBOOT
	depends on !TRUSTED_EXECUTION_NONSECURE
	help
	  This setting is configured through a device tree configuration to
	  remove both the SPE partition as well as the use of Trustzone application
	  isolation features. This configuration runs the single application as a
	  secure image without the Atmosic sample SPE. TrustZone protection mechanisms
	  on the platform will not be enabled and Trustzone will be minimally initialized.

DT_CHOSEN_ATM_APP_FLASH_XIP := zephyr,atm-app-flash-xip

config ATM_APP_FLASH_XIP
	bool
	default "$(dt_chosen_enabled,$(DT_CHOSEN_ATM_APP_FLASH_XIP))"

# All ATM5 chips contain a stacked flash in the package, and all apps run out
# of this flash. We need the driver to power down the flash
config FLASH
	bool
	default y if PM

# note: MCUMGR_GRP_IMG_UPDATABLE_IMAGE_NUMBER defaults to UPDATEABLE_IMAGE_NUMBER
config UPDATEABLE_IMAGE_NUMBER
	int
	default 1 if IMG_MANAGER || MCUBOOT

if TRUSTED_EXECUTION_NONSECURE

config SPE_PATH
	string "Path to SPE build directory"

config ATM_ARM_FIRMWARE_USES_SECURE_ENTRY_FUNCS
	bool "ATM Non-Secure Firmware uses Secure Entry functions"
	default y if SPE_PATH != ""
	help
	  Option as ARM_FIRMWARE_USES_SECURE_ENTRY_FUNCS.

config ATM_ARM_ENTRY_VENEERS_LIB_NAME
	string "ATM Entry Veneers symbol file"
	depends on SPE_PATH != ""
	default "libentryveneers.a"
	help
	  Library file as ARM_ENTRY_VENEERS_LIB_NAME.

config MERGE_SPE_NSPE
	bool
	depends on SPE_PATH != ""
	default y if BOOTLOADER_MCUBOOT
	help
	  Option to merge SPE and NSPE to a single image. This config must
	  be set if building with MCUboot as the merged image is signed.

config MCUBOOT_EXTRA_IMGTOOL_ARGS
	# Need to override header-size for image tool to the SPE header allocation
	default "--header-size=0x1000" if MERGE_SPE_NSPE

endif # TRUSTED_EXECUTION_NONSECURE

config HEAP_MEM_POOL_ADD_SIZE_BOARD
	int "Board-level heap memory pool size"
	default 512
	help
	  Base heap memory pool size required by the board for general operations.
	  This is combined with subsystem-specific heap requirements to form the
	  final HEAP_MEM_POOL_SIZE.

if BT

# Controller provides random numbers via HCI_LE_RAND; host-side PRNG not needed.
# Disabling avoids redundant HMAC-based PRNG in host and reduces memory footprint.
config BT_HOST_CRYPTO_PRNG
	default n

config ENTROPY_GENERATOR
	default y

config BT_HCI_ACL_FLOW_CONTROL
	default n

config BT_ISO_TX_BUF_COUNT
	default 4 if ATMWSTK_FULL || BT_ISO

endif # BT

if SERIAL

config UART_ATM
	default y

config UART_INTERRUPT_DRIVEN
	default y

endif # SERIAL

if BATTERY_UPD

choice BATTERY_TYPE
	prompt "Battery type"
	default BATTERY_TYPE_COIN

config BATTERY_TYPE_COIN
	bool "Battery is coin"

config BATTERY_TYPE_HSC_LIION
	bool "Battery is hsc liion"
endchoice

endif # BATTERY_UPD

endif # SOC_SERIES_ATM5
```

## boards/atmosic/atm5evk/board.yml
```yaml
boards:
- name: ATMEVK-5205-NQK-2
  full_name: ATMEVK-5205-NQK-2
  vendor: atmosic
  revision:
    format: custom
    default: normal
    revisions:
    - name: mcuboot
    - name: mcuboot_bl
    - name: normal
  socs:
    - name: ATM5xxx-2

- name: ATMEVK-5305-NBV-2
  full_name: ATMEVK-5305-NBV-2
  vendor: atmosic
  revision:
    format: custom
    default: normal
    revisions:
    - name: mcuboot
    - name: mcuboot_bl
    - name: normal
  socs:
    - name: ATM5xxx-2

- name: ATMEVK-5305-NQK-2
  full_name: ATMEVK-5305-NQK-2
  vendor: atmosic
  revision:
    format: custom
    default: normal
    revisions:
    - name: mcuboot
    - name: mcuboot_bl
    - name: normal
  socs:
    - name: ATM5xxx-2

- name: ATMEVK-5305e-NQN-2
  full_name: ATMEVK-5305e-NQN-2
  vendor: atmosic
  revision:
    format: custom
    default: normal
    revisions:
    - name: mcuboot
    - name: mcuboot_bl
    - name: normal
  socs:
    - name: ATM5xxx-2
```

## boards/atmosic/atm5evk/rev-2/board.yml
```yaml
boards:
- extend: ATMEVK-5205-NQK-2
- extend: ATMEVK-5305-NBV-2
- extend: ATMEVK-5305-NQK-2
- extend: ATMEVK-5305e-NQN-2
```

## boards/shields/atm5_peripheral_board/Kconfig.shield
```kconfig
# SPDX-License-Identifier: LicenseRef-Atmosic
#
# Copyright (c) 2026 Atmosic

config SHIELD_atm5_PERIPHERAL_BOARD_I2C_I2S
	def_bool $(shields_list_contains,atm5_peripheral_board_i2c_i2s)

config SHIELD_atm5_PERIPHERAL_BOARD_MIKRO_BUS
	def_bool $(shields_list_contains,atm5_peripheral_board_mikro_bus)

config SHIELD_atm5_PERIPHERAL_BOARD_SPI
	def_bool $(shields_list_contains,atm5_peripheral_board_spi)
```

## boards/shields/mikroe_buzz_2_click/Kconfig.defconfig
```kconfig
# Copyright (c) 2025-2026 Atmosic
# SPDX-License-Identifier: LicenseRef-Atmosic

if SHIELD_MIKROE_BUZZ_2_CLICK

config PWM
	default y

config ATM_BUZZER
	default y

endif # SHIELD_MIKROE_BUZZ_2_CLICK
```

## boards/shields/mikroe_buzz_2_click/Kconfig.shield
```kconfig
# Copyright (c) 2025-2026 Atmosic
# SPDX-License-Identifier: LicenseRef-Atmosic

config SHIELD_MIKROE_BUZZ_2_CLICK
	def_bool $(shields_list_contains,mikroe_buzz_2_click)
```

## boards/shields/mikroe_pir_click/Kconfig.defconfig
```kconfig
# Copyright (c) 2025-2026 Atmosic
# SPDX-License-Identifier: LicenseRef-Atmosic

if SHIELD_MIKROE_PIR_CLICK

config ADC
	default y

config I2C
	default y

config SENSOR
	default y

config MCP3221
	default y

endif # SHIELD_MIKROE_PIR_CLICK
```
