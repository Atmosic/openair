## CMakeLists.txt
```
# Copyright (c) 2025-2026 Atmosic
#
# SPDX-License-Identifier: LicenseRef-Atmosic

cmake_minimum_required(VERSION 3.20.0)
find_package(Zephyr REQUIRED HINTS $ENV{ZEPHYR_BASE})
project(ras_rrsp_reflector)

include_directories(
  src
)

target_sources(app PRIVATE
  src/main.c
  src/rrsp_batt.c
  src/rrsp_buttons.c
  src/rrsp_buzzer.c
  src/rrsp_led.c
  src/rrsp_mmi.c
)
```

## Kconfig
```
# Copyright (c) 2025-2026 Atmosic
#
# SPDX-License-Identifier: LicenseRef-Atmosic

source "Kconfig.zephyr"

config BTN_ON_OFF
	bool "Power on/off device with Button"
	select HWINFO

config BTN_BATT_REPORT
	bool "Trigger Battery report with Button"
	select ADC
	depends on BTN_ON_OFF && BATT_MODEL_COIN

config RRSP_ADV_TIMEOUT_CS
	int "Advertising timeout time(cs)"
	range 0 360000
	default 0

config RRSP_SUBRATE_TEST
	bool "Enable LE connection subrating test"
	select BT_SUBRATING
	help
	  Request new subrating parameters after the CS default settings are
	  configured and register a callback for subrate changed events.

config BTN_FACTORY_RESET
	bool "Factory reset with long press button for 10s in power on state"
	help
	  Long press button for 10 secs to trigger factory reset in power on
	  state. Pressing 2 secs would trigger power off key first and keep
	  pressing until 10 secs would trigger factory reset then enter off state.

config RRSP_LED_IND
	bool "Enable LED indication for state and button"
	select LED
	help
	  Power on: Green LED blinks 3 times
	  Power off: Red LED blinks 3 times
	  Pairing mode: Green blink -> Red blink every 5 secs
	  Operation mode: Green LED blinks every 20 secs
	  CS operation mode: Green LED blinks every 1 sec
	  Battery Status:
	    >3.0V 5 GREEN blinks
	    >2.9V 4 GREEN blinks
	    >2.8V 3 GREEN blinks
	    >2.6V 2 GREEN blinks
	    <= 2.6V single GREEN blink

config BTN_FAKE_CS_DATA
	bool "Fake CS data with button"
	select RAS_PTS_FAKE_CS_DATA
	help
	  Press button in connected state to generate fake CS data

config BTN_FORCE_DISABLE_CS
	bool "Force disable/revert CS function with button"
	help
	  Press button in connected state to force disable or revert the CS
	  function. This option is not supported when CONFIG_BTN_ON_OFF is
	  enabled.
	  In RRSP_MMI_STATE_CS_PROC_EN, the CS procedure is disabled first, then
	  the CS configuration is removed after the procedure disable complete
	  event, and the reflector role is disabled after the configuration
	  removed event. In RRSP_MMI_STATE_CS_SETUP_CMP, the CS configuration is
	  removed directly, then the reflector role is disabled after the
	  configuration removed event. In RRSP_MMI_STATE_CONNECTED, the CS
	  reflector role is reverted (re-enabled) by setting default settings
	  with reflector role enabled.

config RRSP_BUZZER_IND
	bool "Enable Buzzer indication"
	select ATM_BUZZER
	select ATM_BUZZER_TIMEOUT

module = RRSP
module-str = rrsp
source "subsys/logging/Kconfig.template.log_config"

module = RRSP_MMI
module-str = rrsp_mmi
source "subsys/logging/Kconfig.template.log_config"

module = RRSP_BTN
module-str = rrsp_btn
source "subsys/logging/Kconfig.template.log_config"

module = RRSP_BAT
module-str = rrsp_bat
source "subsys/logging/Kconfig.template.log_config"

module = RRSP_LED
module-str = rrsp_led
source "subsys/logging/Kconfig.template.log_config"

module = RRSP_BUZZER
module-str = rrsp_buzzer
source "subsys/logging/Kconfig.template.log_config"
```

## sample.yaml
```
sample:
  name: Bluetooth Responder of RAP and Channel sounding reflector
  description: Demonstrates the RAP(Ranging Profile) GATT Service
common:
  sysbuild: true
  harness: console
  harness_config:
    type: one_line
    regex:
      - "adv_entry"
  tags:
    - atm_test_with_spe
    - bluetooth
    - channel_sounding
  # app.overlay drives &button1, so it only compiles on a board declaring a
  # second user button.
  depends_on:
    - button1
    - channel_sounding
tests:
  applications.ras_rrsp_reflector.atm:
    tags:
      - openair_release
  applications.ras_rrsp_reflector.atm.mcuboot:
    tags:
      - mcuboot
    extra_args:
      - SB_CONFIG_BOOTLOADER_MCUBOOT=y
      - SB_CONFIG_BOOT_SIGNATURE_TYPE_ECDSA_P256=y
      - SB_CONFIG_MCUBOOT_MODE_SWAP_USING_OFFSET=y
  applications.ras_rrsp_reflector.atm.mcuboot.legacy_scratch:
    tags:
      - mcuboot
      - legacy
    extra_args:
      - SB_CONFIG_BOOTLOADER_MCUBOOT=y
      - SB_CONFIG_BOOT_SIGNATURE_TYPE_ECDSA_P256=y
      - SB_CONFIG_MCUBOOT_MODE_SWAP_SCRATCH=y
      - SB_ATM_DTS_EXTRA_CPPFLAGS="-DATM_MCUBOOT_SWAP_WITH_OFFSET=0"
  applications.ras_rrsp_reflector.atm.mcuboot.ota:
    tags:
      - mcuboot
    extra_args:
      - SB_CONFIG_BOOTLOADER_MCUBOOT=y
      - SB_CONFIG_BOOT_SIGNATURE_TYPE_ECDSA_P256=y
      - SB_CONFIG_MCUBOOT_MODE_SWAP_USING_OFFSET=y
      - EXTRA_CONF_FILE=basic_ota_bt.conf
  applications.ras_rrsp_reflector.atm.mcuboot.ota.legacy_scratch:
    tags:
      - mcuboot
      - legacy
    extra_args:
      - SB_CONFIG_BOOTLOADER_MCUBOOT=y
      - SB_CONFIG_BOOT_SIGNATURE_TYPE_ECDSA_P256=y
      - SB_CONFIG_MCUBOOT_MODE_SWAP_SCRATCH=y
      - SB_ATM_DTS_EXTRA_CPPFLAGS="-DATM_MCUBOOT_SWAP_WITH_OFFSET=0"
      - EXTRA_CONF_FILE=basic_ota_bt.conf
  applications.ras_rrsp_reflector.atm.mcuboot.flash_xip:
    tags:
      - mcuboot
      - flash_xip
    depends_on:
      - flash
      - rram
      - xip
    extra_args:
      - SB_CONFIG_BOOTLOADER_MCUBOOT=y
      - SB_CONFIG_BOOT_SIGNATURE_TYPE_ECDSA_P256=y
      - SB_CONFIG_MCUBOOT_MODE_SWAP_USING_OFFSET=y
      - SB_ATM_DTS_EXTRA_CPPFLAGS="-DATM_APP_FLASH_XIP"
      - mcuboot_CONFIG_UPDATEABLE_IMAGE_NUMBER=2
  applications.ras_rrsp_reflector.atm.mcuboot.flash_xip.legacy_scratch:
    tags:
      - mcuboot
      - flash_xip
      - legacy
    depends_on:
      - flash
      - rram
      - xip
    extra_args:
      - SB_CONFIG_BOOTLOADER_MCUBOOT=y
      - SB_CONFIG_BOOT_SIGNATURE_TYPE_ECDSA_P256=y
      - SB_CONFIG_MCUBOOT_MODE_SWAP_SCRATCH=y
      - SB_ATM_DTS_EXTRA_CPPFLAGS="-DATM_APP_FLASH_XIP;-DATM_MCUBOOT_SWAP_WITH_OFFSET=0"
      - mcuboot_CONFIG_UPDATEABLE_IMAGE_NUMBER=2
  applications.ras_rrsp_reflector.atm.mcuboot.flash_xip.overwrite:
    tags:
      - mcuboot
      - flash_xip
      - overwrite
    depends_on:
      - flash
      - rram
      - xip
    extra_args:
      - SB_CONFIG_BOOTLOADER_MCUBOOT=y
      - SB_CONFIG_BOOT_SIGNATURE_TYPE_ECDSA_P256=y
      - SB_CONFIG_MCUBOOT_MODE_OVERWRITE_ONLY=y
      - SB_ATM_DTS_EXTRA_CPPFLAGS="-DATM_APP_FLASH_XIP;-DATM_MCUBOOT_SCRATCH_SIZE=0"
      - mcuboot_CONFIG_UPDATEABLE_IMAGE_NUMBER=2
      - mcuboot_CONFIG_MCUBOOT_VERIFY_IMG_ADDRESS=n
  applications.ras_rrsp_reflector.atm.two_dev:
    tags:
      - two_dev
    extra_args:
      - EXTRA_DTC_OVERLAY_FILE=no_button.overlay
    extra_configs:
      - CONFIG_BT_LOG_SNIFFER_INFO=y
    harness_config:
      type: one_line
      regex:
        - "CS procedure50 done:0x0"
  applications.ras_rrsp_reflector.atm.ipt:
    tags:
      - openair_release
    extra_configs:
      - CONFIG_ATM_ENA_LL_FEAT_CS_ENH1=y
      - CONFIG_RAS_FILTER_RD=y
  applications.ras_rrsp_reflector.atm.subr:
    extra_configs:
      - CONFIG_RRSP_SUBRATE_TEST=y
  applications.ras_rrsp_reflector.atm.rmv_cs:
    extra_configs:
      - CONFIG_BTN_FORCE_DISABLE_CS=y
```

## prj.conf
```kconfig
# STACK SIZE
CONFIG_MAIN_STACK_SIZE=2048
CONFIG_SYSTEM_WORKQUEUE_STACK_SIZE=2048

# LOG
CONFIG_LOG=y
CONFIG_LOG_BUFFER_SIZE=4096
CONFIG_LOG_PROCESS_TRIGGER_THRESHOLD=3
CONFIG_BT_RAS_LOG_LEVEL_INF=y

# BT
CONFIG_BT=y
CONFIG_BT_EXT_ADV=y
CONFIG_BT_PERIPHERAL=y
CONFIG_BT_SMP=y
CONFIG_BT_PRIVACY=y
CONFIG_BT_GAP_AUTO_UPDATE_CONN_PARAMS=n
CONFIG_BT_ATT_TX_COUNT=4
CONFIG_BT_CHANNEL_SOUNDING=y
# Reduce to save memory. default would be BT_BUF_ACL_TX_COUNT
CONFIG_BT_L2CAP_TX_BUF_COUNT=2
# Enable PHY update indication and CONFIG_BT_AUTO_PHY_UPDATE would be disabled
CONFIG_BT_USER_PHY_UPDATE=y

CONFIG_BT_DEVICE_NAME="Atmosic_RRSP"
# BLE_APPEARANCE_GENERIC_TAG
CONFIG_BT_DEVICE_APPEARANCE=512


# SETTINGS
CONFIG_BT_SETTINGS=y
CONFIG_FLASH=y
CONFIG_FLASH_PAGE_LAYOUT=y
CONFIG_FLASH_MAP=y
CONFIG_NVS=y
CONFIG_SETTINGS=y

# BT STKLIB
CONFIG_ATM_ENA_LL_FEAT_PC=y
CONFIG_ATM_ENA_LL_FEAT_CS=y

# RAS
CONFIG_BT_RAS=y

# STACK SENTINEL
CONFIG_STACK_SENTINEL=y

CONFIG_SMF=y
CONFIG_APP_WORK_Q=y
```

## basic_ota_bt.conf
```kconfig
# Copyright (c) 2025-2026 Atmosic
#
# SPDX-License-Identifier: LicenseRef-Atmosic

# Enable MCUmgr with image and OS management command groups
CONFIG_ATM_MCUMGR=y

# Enable MCUmgr Bluetooth transport with encryption (level 2)
CONFIG_MCUMGR_TRANSPORT_BT=y
CONFIG_MCUMGR_TRANSPORT_BT_PERM_RW_ENCRYPT=y
```

## boards/ATMBTCSTAG-3405.conf
```kconfig
# Copyright (c) 2025-2026 Atmosic
#
# SPDX-License-Identifier: LicenseRef-Atmosic

# *** DEPRECATION WARNING - DO NOT MODIFY ***

# Enable Button power on/off
CONFIG_BTN_ON_OFF=y
# Enable Advertising timeout with 180s
CONFIG_RRSP_ADV_TIMEOUT_CS=18000
# Enable Button for battery report
CONFIG_BATT_MODEL_COIN=y
CONFIG_BTN_BATT_REPORT=y
# Enable LED indication
CONFIG_RRSP_LED_IND=y
# Enable Factory reset by pressing button for 10s
CONFIG_BTN_FACTORY_RESET=y
# Enable Buzzer indication
CONFIG_RRSP_BUZZER_IND=y
```

## boards/ATMBTCSTAG-3405_ns.conf
```kconfig
# Copyright (c) 2025 Atmosic
#
# SPDX-License-Identifier: Apache-2.0

# Enable Button power on/off
CONFIG_BTN_ON_OFF=y
#PMU Watch dog would be trigger per 900 sec.
CONFIG_ATM_SOCOFF_DURATION_SEC=900
# Enable Advertising timeout with 60s
CONFIG_RRSP_ADV_TIMEOUT_CS=6000
# Enable Button for battery report
CONFIG_BTN_BATT_REPORT=y
# Enable LED indication
CONFIG_RRSP_LED_IND=y
# Enable Factory reset by pressing button for 10s
CONFIG_BTN_FACTORY_RESET=y
# Enable Buzzer indication
CONFIG_RRSP_BUZZER_IND=y
```

## app.overlay
```dts
/*
 * Copyright (c) 2025-2026 Atmosic
 *
 * SPDX-License-Identifier: LicenseRef-Atmosic
 */

/ {
    aliases {
        sw0 = &button1;
    };
};

&atm_antenna {
	ant-out5-pin = <5>;
	mdm-ant-rx-3to0 = <0x00002000>;
	mdm-ant-tx-3to0 = <0x00002000>;
	mdm-ant-idle = <0x0>;
	status = "okay";
};

&wdog0 {
	status = "okay";
};
```

## no_button.overlay
```dts
/*
 * Copyright (c) 2025-2026 Atmosic
 *
 * SPDX-License-Identifier: LicenseRef-Atmosic
 */

/*
 * Test overlay to disable button1 for testing ras_rrsp_reflector application
 * without button hardware
 */

&button1 {
	status = "disabled";
};
```

## boards/ATMBTCSTAG-3405.overlay
```dts
/* Copyright (c) 2025-2026 Atmosic
 *
 * SPDX-License-Identifier: LicenseRef-Atmosic
 */

&soc_off {
	status = "okay";
};

&cpu0 {
	cpu-power-states = <&idle &sleep &retain &hibernate &soc_off>;
};

&wdog0 {
	status = "okay";
};
```

## boards/ATMBTCSTAG-3405_ns.overlay
```dts
/*
 * Copyright (c) 2025 Atmosic
 *
 * SPDX-License-Identifier: Apache-2.0
 */

&cpu0 {
	cpu-power-states = <&idle &sleep &retain &hibernate &soc_off>;
};
```

## boards/ATMEVK-3405-YBV-5_ns.overlay
```dts
/*
 * Copyright (c) 2025 Atmosic
 *
 * SPDX-License-Identifier: Apache-2.0
 */

/ {
	aliases {
		sw0 = &button1;
	};
};

&atm_antenna {
	ant-out5-pin = <5>;
	mdm-ant-rx-3to0 = <0x00002000>;
	mdm-ant-tx-3to0 = <0x00002000>;
	mdm-ant-idle = <0x0>;
	status = "okay";
};
```

## boards/ATMEVK-3430e-YQN-5_ns.overlay
```dts
/*
 * Copyright (c) 2025 Atmosic
 *
 * SPDX-License-Identifier: Apache-2.0
 */

/ {
    aliases {
        sw0 = &button1;
    };
};

&atm_antenna {
	ant-out5-pin = <5>;
	mdm-ant-rx-3to0 = <0x00002000>;
	mdm-ant-tx-3to0 = <0x00002000>;
	mdm-ant-idle = <0x0>;
	status = "okay";
};
```

## src/main.c
```c
/*
 * Copyright (c) 2025-2026 Atmosic
 *
 * SPDX-License-Identifier: LicenseRef-Atmosic
 */

#include <zephyr/kernel.h>
#include <zephyr/drivers/watchdog.h>
#include <zephyr/logging/log.h>
#include <zephyr/pm/pm.h>
#include "rrsp_buttons.h"
#include "rrsp_mmi.h"

LOG_MODULE_REGISTER(rrsp, CONFIG_RRSP_LOG_LEVEL);

#define SLEEP_TIME        K_SECONDS(3)
#define WDT_MIN_WINDOW_MS 0
#define WDT_MAX_WINDOW_MS 5000

struct device const *wdog_dev = DEVICE_DT_GET(DT_ALIAS(watchdog0));
static int wdt_channel_id;

#ifdef CONFIG_PM
static void wdog_poke(enum pm_state state)
{
	wdt_feed(wdog_dev, wdt_channel_id);
}

static struct pm_notifier notifier = {
	.state_entry = wdog_poke,
	.state_exit = wdog_poke,
};
#endif

int main(void)
{
	struct wdt_timeout_cfg wdt_config = {
		.flags = WDT_FLAG_RESET_SOC,
		.window.min = WDT_MIN_WINDOW_MS,
		.window.max = WDT_MAX_WINDOW_MS,
		.callback = NULL,
	};

	wdt_channel_id = wdt_install_timeout(wdog_dev, &wdt_config);
	if (wdt_channel_id < 0) {
		LOG_ERR("Watchdog install error: %d", wdt_channel_id);
		return 1;
	}

	int ret = wdt_setup(wdog_dev, 0);
	if (ret < 0) {
		LOG_ERR("Watchdog setup error: %d", ret);
		return 1;
	}

	if (!rrsp_buttons_init()) {
#ifdef CONFIG_BTN_ON_OFF
		LOG_INF("skip power on");
		rrsp_mmi_unlock_sleep();
		return 1;
#endif
	}

#ifdef CONFIG_PM
	pm_notifier_register(&notifier);
#else
	while (true) {
		k_sleep(SLEEP_TIME);
		wdt_feed(wdog_dev, wdt_channel_id);
	}
#endif

	return 0;
}
```

## src/rrsp_batt.c
```c
/*
 * Copyright (c) 2025-2026 Atmosic
 *
 * SPDX-License-Identifier: LicenseRef-Atmosic
 */

#include <zephyr/kernel.h>
#include <zephyr/logging/log.h>
#include "rrsp_batt.h"

LOG_MODULE_REGISTER(rrsp_bat, CONFIG_RRSP_BAT_LOG_LEVEL);

static int32_t last_batt_mv = 3000;

#ifdef CONFIG_BATT_MODEL
#include <zephyr/init.h>
#include "batt_model.h"
static void rrsp_batt_cb(uint16_t lvl_bp, int32_t mvolt)
{
	last_batt_mv = mvolt;
	LOG_DBG("update last_battery_vol to %d (lvl: %u%%)", last_batt_mv, lvl_bp / 100);
}

static int rrsp_batt_init(void)
{
	batt_model()->init(NULL);
	return 0;
}

SYS_INIT(rrsp_batt_init, POST_KERNEL, CONFIG_APPLICATION_INIT_PRIORITY);
#endif // CONFIG_BATT_MODEL

int32_t rrsp_batt_status_get(void)
{
#ifdef CONFIG_BATT_MODEL
	batt_model()->sample(rrsp_batt_cb);
#endif
	return last_batt_mv;
}
```

## src/rrsp_batt.h
```c
/*
 * Copyright (c) 2025-2026 Atmosic
 *
 * SPDX-License-Identifier: LicenseRef-Atmosic
 */

#pragma once

#ifdef __cplusplus
extern "C" {
#endif

/**
 * @brief battery status get
 *
 * @return battery status in mVolt
 */
int32_t rrsp_batt_status_get(void);

#ifdef __cplusplus
}
#endif

///@}
```

## src/rrsp_buttons.c
```c
/*
 * Copyright (c) 2025-2026 Atmosic
 *
 * SPDX-License-Identifier: LicenseRef-Atmosic
 */

#include <zephyr/kernel.h>
#include <zephyr/logging/log.h>
#include <zephyr/drivers/gpio.h>
#include <zephyr/bluetooth/bluetooth.h>
#ifdef CONFIG_BTN_ON_OFF
#include <zephyr/pm/pm.h>
#include <zephyr/pm/policy.h>
#include <zephyr/drivers/hwinfo.h>
#include "compiler.h"
#include "power.h"
#endif
#include "rrsp_mmi.h"
#include "app_work_q.h"
#ifdef CONFIG_BTN_BATT_REPORT
#include "rrsp_batt.h"
#endif
#ifdef CONFIG_RRSP_LED_IND
#include "rrsp_led.h"
#endif
#ifdef CONFIG_BTN_FAKE_CS_DATA
#include "ras.h"
#endif
#ifdef CONFIG_RRSP_BUZZER_IND
#include "rrsp_buzzer.h"
#endif

LOG_MODULE_REGISTER(rrsp_btn, CONFIG_RRSP_BTN_LOG_LEVEL);

#define SW0_NODE DT_ALIAS(sw0)
#if DT_NODE_HAS_STATUS_OKAY(SW0_NODE)
static const struct gpio_dt_spec rrsp_btn0 = GPIO_DT_SPEC_GET(SW0_NODE, gpios);
#else
static const struct gpio_dt_spec rrsp_btn0 = {0};
#endif
static struct gpio_callback rrsp_button_cb;
static struct k_work rrsp_button_work;

#if !defined(CONFIG_BTN_ON_OFF) || defined(CONFIG_BTN_FACTORY_RESET)
static void rrsp_button_factory_reset_handler(void)
{
	LOG_INF("unpair button");
	bt_unpair(BT_ID_DEFAULT, BT_ADDR_LE_ANY);
}
#endif

#ifdef CONFIG_BTN_ON_OFF
#define BTN_LONG_PRESS_MS 2000
static struct k_work_delayable rrsp_button_longpress_work;
static int64_t hit_time;
static uint32_t hit_mask;
static bool btn_lock;
#ifdef CONFIG_BTN_BATT_REPORT
#define BTN_CTS_TAP_MS     3000
#define BTN_BATT_TAP_TIMES 5
static struct k_work_delayable rrsp_button_cts_tap_timeout_work;
static uint8_t cts_press;

static void rrsp_button_cts_tap_timeout_handler(struct k_work *work)
{
	LOG_INF("CTS Tap timeout Triggered:%d", cts_press);
	cts_press = 0;
}

static void rrsp_button_batt_rpt_handler(void)
{
	int32_t batt_mv = rrsp_batt_status_get();
	cts_press = 0;
	LOG_INF("Key:Battery report:%d", batt_mv);

#ifdef CONFIG_RRSP_LED_IND

#define BATT_VOL_MV_THRESH1 3000
#define BATT_VOL_MV_THRESH2 2900
#define BATT_VOL_MV_THRESH3 2800
#define BATT_VOL_MV_THRESH4 2600

	int32_t batt_thresh[] = {BATT_VOL_MV_THRESH1, BATT_VOL_MV_THRESH2, BATT_VOL_MV_THRESH3,
				 BATT_VOL_MV_THRESH4};

	for (uint8_t i = 0; i < ARRAY_SIZE(batt_thresh); i++) {
		if (batt_mv > batt_thresh[i]) {
			rrsp_led_update((RRSP_LED_PAT_EVT_BAT_LVL + i), true);
			return;
		}
	}
	rrsp_led_update(RRSP_LED_PAT_EVT_BAT1, true);
#endif
}
#endif // CONFIG_BTN_BATT_REPORT

#ifdef CONFIG_BTN_FACTORY_RESET
#define BTN_LONG_LONG_PRESS_MS 10000
static struct k_work_delayable rrsp_button_longlongpress_work;

static void rrsp_button_longlongpress_handler(struct k_work *work)
{
	if (rrsp_mmi_get_state() == RRSP_MMI_STATE_OFF) {
#ifdef CONFIG_RRSP_BUZZER_IND
#define RRSP_FACTORY_RESET_BEEP_TIME_MS 500
		rrsp_buzzer_beep(RRSP_FACTORY_RESET_BEEP_TIME_MS);
#endif
		rrsp_button_factory_reset_handler();
		return;
	} else {
		LOG_ERR("Unexpected longlong press");
	}
}
#endif

static void rrsp_button_poweron_handler(void)
{
	LOG_INF("Key:Power on");
#ifdef CONFIG_RRSP_LED_IND
	rrsp_led_update(RRSP_LED_PAT_EVT_PWRON, true);
#endif
	rrsp_mmi_init();
}

static void rrsp_button_poweroff_handler(void)
{
	LOG_INF("Key:Power off - wait release");
#ifdef CONFIG_RRSP_LED_IND
	rrsp_led_update(RRSP_LED_PAT_EVT_PWROFF, true);
#endif
	rrsp_mmi_off();
}

static void rrsp_button_longpress_handler(struct k_work *work)
{
	if (rrsp_mmi_get_state() == RRSP_MMI_STATE_IDX_MAX) {
		rrsp_button_poweron_handler();
	} else {
		rrsp_button_poweroff_handler();
	}
}

static void rrsp_button_lock_sleep(bool lock)
{
	LOG_DBG("button lock:%d", lock);

	if (btn_lock == lock) {
		return;
	}
	if (lock) {
		pm_policy_state_lock_get(PM_STATE_SOFT_OFF, PM_ALL_SUBSTATES);
	} else {
		pm_policy_state_lock_put(PM_STATE_SOFT_OFF, PM_ALL_SUBSTATES);
	}
	btn_lock = lock;
}

static bool rrsp_button_check_boot_reason_button(void)
{
	uint32_t reset_cause;
	int rc;

	rc = hwinfo_get_reset_cause(&reset_cause);
	LOG_INF("rc: %d reset_cause: %#x", rc, reset_cause);

	if (!rc && (reset_cause & (RESET_POR | RESET_LOW_POWER_WAKE))) {
		return true;
	}

	return false;
}

static bool rrsp_button_check_boot_reason_ota(void)
{
	uint32_t reset_cause;
	int rc;

	rc = hwinfo_get_reset_cause(&reset_cause);

	if (!rc && (reset_cause & RESET_HARDWARE)) {
		return true;
	}

	return false;
}
#endif // CONFIG_BTN_ON_OFF

static void rrsp_button_work_handler(struct k_work *work)
{
#ifdef CONFIG_BTN_ON_OFF
	// Release detect
	if (!hit_mask) {
		if (hit_time < BTN_LONG_PRESS_MS) {
			LOG_DBG("Short Tap");
			if (rrsp_mmi_get_state() == RRSP_MMI_STATE_IDX_MAX) {
				LOG_DBG("OFF: Button press less than 2s");
				rrsp_mmi_unlock_sleep();
				return;
			}
			if (rrsp_mmi_get_state() == RRSP_MMI_STATE_OFF) {
				LOG_WRN("Invalid Tap Key in off state");
				return;
			}
#ifdef CONFIG_BTN_BATT_REPORT
			if (!cts_press) {
				// First tap
				atm_work_reschedule_for_app_work_q(
					&rrsp_button_cts_tap_timeout_work, K_MSEC(BTN_CTS_TAP_MS));
			}
			cts_press += 1;
			if (cts_press == BTN_BATT_TAP_TIMES) {
				k_work_cancel_delayable(&rrsp_button_cts_tap_timeout_work);
				rrsp_button_batt_rpt_handler();
			}
#endif
		} else {
			LOG_DBG("Long Press Release");
			if (rrsp_mmi_get_state() == RRSP_MMI_STATE_OFF) {
				LOG_DBG("OFF: key released");
			}
#ifdef CONFIG_BTN_BATT_REPORT
			k_work_cancel_delayable(&rrsp_button_cts_tap_timeout_work);
			cts_press = 0;
#endif
		}
	}
#else // CONFIG_BTN_ON_OFF
	if (gpio_pin_get_dt(&rrsp_btn0)) {
#ifdef CONFIG_BTN_FAKE_CS_DATA
#define FAKE_CS_DATA_RANGECOUNTER 0
		if (rrsp_mmi_get_state() == RRSP_MMI_STATE_CONNECTED) {
			LOG_DBG("Fake CS data:%u", FAKE_CS_DATA_RANGECOUNTER);
			ras_fake_cs_data(FAKE_CS_DATA_RANGECOUNTER);
			return;
		}
#endif
#ifdef CONFIG_BTN_FORCE_DISABLE_CS
		if (rrsp_mmi_get_state() >= RRSP_MMI_STATE_CONNECTED) {
			LOG_INF("Force disable/revert CS");
			rrsp_mmi_force_cs_off();
			return;
		}
#endif
		rrsp_button_factory_reset_handler();
	}
#endif // CONFIG_BTN_ON_OFF
}

static void rrsp_buttons_pressed(const struct device *dev, struct gpio_callback *cb, uint32_t pins)
{
#ifdef CONFIG_BTN_ON_OFF
	if (gpio_pin_get_dt(&rrsp_btn0)) {
		hit_time = k_uptime_get();
		hit_mask |= pins;
		k_work_reschedule(&rrsp_button_longpress_work, K_MSEC(BTN_LONG_PRESS_MS));
#ifdef CONFIG_BTN_FACTORY_RESET
		k_work_reschedule(&rrsp_button_longlongpress_work, K_MSEC(BTN_LONG_LONG_PRESS_MS));
#endif
		LOG_DBG("Button Pressed");
		rrsp_button_lock_sleep(true);
	} else {
		k_work_cancel_delayable(&rrsp_button_longpress_work);
#ifdef CONFIG_BTN_FACTORY_RESET
		k_work_cancel_delayable(&rrsp_button_longlongpress_work);
#endif
		hit_time = k_uptime_delta(&hit_time);
		hit_mask &= (~pins);
		LOG_DBG("Button Released");
		rrsp_button_lock_sleep(false);
	}
#endif // CONFIG_BTN_ON_OFF
	atm_work_submit_to_app_work_q(&rrsp_button_work);
}

static bool rrsp_buttons_configure_irq(const struct gpio_dt_spec btn)
{
	if (!gpio_is_ready_dt(&btn)) {
		LOG_ERR("button device is not ready");
		return false;
	}

	gpio_init_callback(&rrsp_button_cb, rrsp_buttons_pressed, BIT(btn.pin));
	gpio_add_callback(btn.port, &rrsp_button_cb);
	LOG_INF("Set up button at %s pin %u", btn.port->name, btn.pin);
	int err = gpio_pin_configure_dt(&btn, GPIO_INPUT);
	if (err) {
		LOG_ERR("Failed to configure %s pin %u err:%d", btn.port->name, btn.pin, err);
		return false;
	}
#ifdef CONFIG_BTN_ON_OFF
	k_work_init_delayable(&rrsp_button_longpress_work, rrsp_button_longpress_handler);
	atm_socoff_wakeup_gpio_set(true);
#ifdef CONFIG_BTN_BATT_REPORT
	k_work_init_delayable(&rrsp_button_cts_tap_timeout_work,
			      rrsp_button_cts_tap_timeout_handler);
#endif
#ifdef CONFIG_BTN_FACTORY_RESET
	k_work_init_delayable(&rrsp_button_longlongpress_work, rrsp_button_longlongpress_handler);
#endif
	if (!rrsp_button_check_boot_reason_button()) {
		if (rrsp_button_check_boot_reason_ota()) {
			LOG_INF("Power on: Boot with CPU reset for OTA");
			rrsp_mmi_init();
			return true;
		}
		LOG_INF("skip power on (boot type)");
		return false;
	}

	if (!gpio_pin_get_dt(&btn)) {
		LOG_INF("Button is not pressed");
		return false;
	}

	hit_time = k_uptime_get();
	hit_mask = BIT(btn.pin);
	rrsp_button_lock_sleep(true);
	k_work_reschedule(&rrsp_button_longpress_work, K_MSEC(BTN_LONG_PRESS_MS));
#endif // CONFIG_BTN_ON_OFF

	err = gpio_pin_interrupt_configure_dt(&btn, GPIO_INT_EDGE_BOTH);
	if (err) {
		LOG_ERR("Failed to configure interrupt on %s pin %u err:%d", btn.port->name,
			btn.pin, err);
		return false;
	}

	return true;
}

bool rrsp_buttons_init(void)
{
	bool sts = true;

	k_work_init(&rrsp_button_work, rrsp_button_work_handler);

	if (!rrsp_buttons_configure_irq(rrsp_btn0)) {
		sts = false;
	}
#ifndef CONFIG_BTN_ON_OFF
	rrsp_mmi_init();
#endif
	return sts;
}
```

## src/rrsp_buttons.h
```c
/*
 * Copyright (c) 2025-2026 Atmosic
 *
 * SPDX-License-Identifier: LicenseRef-Atmosic
 */

#pragma once

/**
 * @brief Initialize button settings for rrsp application
 *
 * This function initializes the buttons for rrsp application.
 *
 * @return button initial status
 */
bool rrsp_buttons_init(void);
```

## src/rrsp_buzzer.c
```c
/*
 * Copyright (c) 2025-2026 Atmosic
 *
 * SPDX-License-Identifier: LicenseRef-Atmosic
 */

#include <zephyr/init.h>
#include <zephyr/kernel.h>
#include <zephyr/device.h>
#include <zephyr/logging/log.h>
#include "rrsp_buzzer.h"

LOG_MODULE_REGISTER(rrsp_buzzer, CONFIG_RRSP_BUZZER_LOG_LEVEL);

#ifdef CONFIG_ATM_BUZZER
#include <zephyr/drivers/pwm.h>
#include <zephyr/pm/pm.h>
#include <zephyr/pm/policy.h>
#include "atm_buzzer.h"

#define BUZZER_NODE DT_NODELABEL(pwm_buzzer0)
BUILD_ASSERT(DT_NODE_EXISTS(BUZZER_NODE), "BUZZER_NODE does not exist in the Device Tree!");

static bool buzzer_lock;

static void rrsp_buzzer_lock_sleep(bool lock)
{
	LOG_DBG("buzzer lock:%d", lock);

	if (buzzer_lock == lock) {
		return;
	}

	if (lock) {
		pm_policy_state_lock_get(PM_STATE_SOFT_OFF, PM_ALL_SUBSTATES);
	} else {
		pm_policy_state_lock_put(PM_STATE_SOFT_OFF, PM_ALL_SUBSTATES);
	}
	buzzer_lock = lock;
}

static void rrsp_buzzer_beep_end(const struct device *dev)
{
	LOG_DBG("buzzer end");
	rrsp_buzzer_lock_sleep(false);
}

static int rrsp_buzzer_init(void)
{
	const struct device *buzzer = DEVICE_DT_GET(BUZZER_NODE);

	if (!device_is_ready(buzzer)) {
		LOG_ERR("Buzzer device not ready");
		return -ENODEV;
	}

	/* Set stop callback */
	atm_buzzer_set_stop_callback(buzzer, rrsp_buzzer_beep_end);

	LOG_DBG("buzzer initialized");
	return 0;
}
SYS_INIT(rrsp_buzzer_init, POST_KERNEL, CONFIG_APPLICATION_INIT_PRIORITY);
#endif

void rrsp_buzzer_beep(uint32_t duration_ms)
{
	LOG_INF("buzzer beep duration_ms:%d", duration_ms);
	if (!duration_ms) {
		return;
	}
#ifdef CONFIG_ATM_BUZZER
#define RRSP_BUZZER_FREQ_HZ    1000
#define RRSP_BUZZER_DUTY_CYCLE 50

	const struct device *buzzer = DEVICE_DT_GET(BUZZER_NODE);

	if (atm_buzzer_beep_time(buzzer, RRSP_BUZZER_FREQ_HZ, RRSP_BUZZER_DUTY_CYCLE,
				 duration_ms)) {
		LOG_ERR("Set buzzer failed");
		return;
	}
	rrsp_buzzer_lock_sleep(true);
#endif
}
```

## src/rrsp_buzzer.h
```c
/*
 * Copyright (c) 2025-2026 Atmosic
 *
 * SPDX-License-Identifier: LicenseRef-Atmosic
 */

#pragma once

#ifdef __cplusplus
extern "C" {
#endif

/**
 * @brief enable buzzer beep
 * @param[in] duration_ms total beep time
 */
void rrsp_buzzer_beep(uint32_t duration_ms);

#ifdef __cplusplus
}
#endif
```

## src/rrsp_led.c
```c
/*
 * Copyright (c) 2025-2026 Atmosic
 *
 * SPDX-License-Identifier: LicenseRef-Atmosic
 */

#include <zephyr/logging/log.h>
#ifdef CONFIG_LED
#include <zephyr/device.h>
#include <zephyr/drivers/led.h>
#include <zephyr/pm/pm.h>
#include <zephyr/pm/policy.h>
#include "app_work_q.h"
#endif
#include "rrsp_led.h"

LOG_MODULE_REGISTER(rrsp_led, CONFIG_RRSP_LED_LOG_LEVEL);

#ifdef CONFIG_LED
typedef enum rrsp_led_index_e {
	RRSP_LED_IDX_STS_GREEN,
	RRSP_LED_IDX_STS_RED,
	RRSP_LED_IDX_BAT_GREEN,

	RRSP_LED_IDX_MAX
} rrsp_led_index_t;

#define RRSP_LED_MAX_SEQ 4
typedef struct rrsp_led_pattern_s {
	uint8_t led_mask;
	uint8_t valid_seq;
	// 0: infinite
	uint8_t repeat_times;
	uint8_t active_led[RRSP_LED_MAX_SEQ];
	uint16_t dur_ms[RRSP_LED_MAX_SEQ];
} rrsp_led_pattern_t;

typedef enum rrsp_led_work_e {
	RRSP_LED_WORK_EVT,
	RRSP_LED_WORK_BG,

	RRSP_LED_WORK_MAX
} rrsp_led_work_t;

#define LED_MASK(led_idx) (1 << led_idx)
static const rrsp_led_pattern_t rrsp_led_pattern[RRSP_LED_PAT_MAX] = {
	{LED_MASK(RRSP_LED_IDX_STS_GREEN),
	 2,
	 3,
	 {LED_MASK(RRSP_LED_IDX_STS_GREEN), 0, 0, 0},
	 {500, 500, 0, 0}},
	{LED_MASK(RRSP_LED_IDX_STS_RED),
	 2,
	 3,
	 {LED_MASK(RRSP_LED_IDX_STS_RED), 0, 0, 0},
	 {500, 500, 0, 0}},
	{LED_MASK(RRSP_LED_IDX_BAT_GREEN),
	 2,
	 5,
	 {LED_MASK(RRSP_LED_IDX_BAT_GREEN), 0, 0, 0},
	 {500, 500, 0, 0}},
	{LED_MASK(RRSP_LED_IDX_BAT_GREEN),
	 2,
	 4,
	 {LED_MASK(RRSP_LED_IDX_BAT_GREEN), 0, 0, 0},
	 {500, 500, 0, 0}},
	{LED_MASK(RRSP_LED_IDX_BAT_GREEN),
	 2,
	 3,
	 {LED_MASK(RRSP_LED_IDX_BAT_GREEN), 0, 0, 0},
	 {500, 500, 0, 0}},
	{LED_MASK(RRSP_LED_IDX_BAT_GREEN),
	 2,
	 2,
	 {LED_MASK(RRSP_LED_IDX_BAT_GREEN), 0, 0, 0},
	 {500, 500, 0, 0}},
	{LED_MASK(RRSP_LED_IDX_BAT_GREEN),
	 2,
	 1,
	 {LED_MASK(RRSP_LED_IDX_BAT_GREEN), 0, 0, 0},
	 {500, 500, 0, 0}},
	{(LED_MASK(RRSP_LED_IDX_STS_GREEN) | LED_MASK(RRSP_LED_IDX_STS_RED)),
	 3,
	 0,
	 {LED_MASK(RRSP_LED_IDX_STS_GREEN), LED_MASK(RRSP_LED_IDX_STS_RED), 0, 0},
	 {500, 500, 5000, 0}},
	{LED_MASK(RRSP_LED_IDX_STS_GREEN),
	 2,
	 0,
	 {LED_MASK(RRSP_LED_IDX_STS_GREEN), 0, 0, 0},
	 {500, 20000, 0, 0}},
	{LED_MASK(RRSP_LED_IDX_STS_GREEN),
	 2,
	 0,
	 {LED_MASK(RRSP_LED_IDX_STS_GREEN), 0, 0, 0},
	 {500, 1000, 0, 0}},
};

static struct rrsp_led_wrok_info {
	struct k_work_delayable work;
	uint8_t active_pattern;
	uint8_t repeat;
	uint8_t next_seq;
} rrsp_led_work[RRSP_LED_WORK_MAX];

static const struct device *const rrsp_led = DEVICE_DT_GET_ONE(gpio_leds);
static bool led_lock;
/* Protects led_lock and the check→PM-call→update sequence.
 * rrsp_led_lock_sleep is called from multiple thread contexts:
 * BT callbacks, system work queue, and app work queue.
 */
K_MUTEX_DEFINE(led_lock_mutex);
static bool rrsp_led_lock_sleep(bool lock)
{
	LOG_DBG("led lock:%d", lock);

	k_mutex_lock(&led_lock_mutex, K_FOREVER);

	if (led_lock == lock) {
		k_mutex_unlock(&led_lock_mutex);
		return true;
	}
	if (lock) {
		// Check the event
		if (rrsp_led_work[RRSP_LED_WORK_EVT].active_pattern == RRSP_LED_PAT_INVALID &&
		    rrsp_led_work[RRSP_LED_WORK_BG].active_pattern == RRSP_LED_PAT_INVALID) {
			LOG_ERR("Unexpected lock:%u' %u",
				rrsp_led_work[RRSP_LED_WORK_EVT].active_pattern,
				rrsp_led_work[RRSP_LED_WORK_BG].active_pattern);
			k_mutex_unlock(&led_lock_mutex);
			return false;
		}
		pm_policy_state_lock_get(PM_STATE_SOFT_OFF, PM_ALL_SUBSTATES);
	} else {
		// Check the event
		if (rrsp_led_work[RRSP_LED_WORK_EVT].active_pattern != RRSP_LED_PAT_INVALID ||
		    rrsp_led_work[RRSP_LED_WORK_BG].active_pattern != RRSP_LED_PAT_INVALID) {
			LOG_INF("Wait unlock:%u' %u",
				rrsp_led_work[RRSP_LED_WORK_EVT].active_pattern,
				rrsp_led_work[RRSP_LED_WORK_BG].active_pattern);
			k_mutex_unlock(&led_lock_mutex);
			return false;
		}
		pm_policy_state_lock_put(PM_STATE_SOFT_OFF, PM_ALL_SUBSTATES);
	}

	led_lock = lock;
	k_mutex_unlock(&led_lock_mutex);
	return true;
}

static rrsp_led_work_t rrsp_led_get_workidx_by_pattern(rrsp_led_pattern_idx_t pattern)
{
	// Check LED pattern work according LED pattern
	if (pattern >= RRSP_LED_PAT_MAX) {
		LOG_ERR("Unexpected LED pattern-%u", pattern);
		return RRSP_LED_WORK_MAX;
	}
	if (pattern < RRSP_LED_PAT_MODE) {
		return RRSP_LED_WORK_EVT;
	}
	return RRSP_LED_WORK_BG;
}

static void rrsp_led_start_pattern(rrsp_led_pattern_idx_t pattern)
{
	uint8_t work_idx = rrsp_led_get_workidx_by_pattern(pattern);
	if (work_idx >= RRSP_LED_WORK_MAX) {
		return;
	}

	// Check the work is available or not
	if (rrsp_led_work[work_idx].active_pattern != RRSP_LED_PAT_INVALID) {
		LOG_ERR("Previous LED pattern:%u still active.",
			rrsp_led_work[work_idx].active_pattern);
		return;
	}

	rrsp_led_work[work_idx].active_pattern = pattern;
	rrsp_led_work[work_idx].repeat = 0;
	rrsp_led_work[work_idx].next_seq = 0;

	uint16_t delay_ms = 0;
	if (work_idx == RRSP_LED_WORK_BG &&
	    (rrsp_led_work[RRSP_LED_WORK_EVT].active_pattern != RRSP_LED_PAT_INVALID)) {
		// Check the LED pattern conflict. If yes, delay BG event
		uint8_t evt_pat = rrsp_led_work[RRSP_LED_WORK_EVT].active_pattern;
		if (rrsp_led_pattern[pattern].led_mask & rrsp_led_pattern[evt_pat].led_mask) {
			for (uint8_t seq = 0; seq < rrsp_led_pattern[evt_pat].valid_seq; seq++) {
				delay_ms += rrsp_led_pattern[evt_pat].dur_ms[seq];
			}
			delay_ms = delay_ms * rrsp_led_pattern[evt_pat].repeat_times;
			LOG_WRN("LED pattern conflict");
		}
	}

	atm_work_reschedule_for_app_work_q(&rrsp_led_work[work_idx].work, K_MSEC(delay_ms));
	// lock soc off
	rrsp_led_lock_sleep(true);
}

static void rrsp_led_cancel_pattern(rrsp_led_pattern_idx_t pattern)
{
	uint8_t work_idx = rrsp_led_get_workidx_by_pattern(pattern);
	if (work_idx >= RRSP_LED_WORK_MAX) {
		return;
	}

	// Check the work is available or not
	if (rrsp_led_work[work_idx].active_pattern != pattern) {
		LOG_ERR("The LED pattern-%u is not working, %u", pattern,
			rrsp_led_work[work_idx].active_pattern);
		return;
	}

	k_work_cancel_delayable(&rrsp_led_work[work_idx].work);
	rrsp_led_work[work_idx].active_pattern = RRSP_LED_PAT_INVALID;

	// turn off the related LED
	if (work_idx == RRSP_LED_WORK_BG) {
		const rrsp_led_pattern_t *curr_ptn = &rrsp_led_pattern[pattern];
		uint8_t evt_led_mask = 0;

		if (rrsp_led_work[RRSP_LED_WORK_EVT].active_pattern != RRSP_LED_PAT_INVALID) {
			evt_led_mask =
				rrsp_led_pattern[rrsp_led_work[RRSP_LED_WORK_EVT].active_pattern]
					.led_mask;
		}

		// Set LED
		for (uint8_t idx = 0; idx < RRSP_LED_IDX_MAX; idx++) {
			if (!(curr_ptn->led_mask & LED_MASK(idx)) ||
			    (evt_led_mask & LED_MASK(idx))) {
				continue;
			}
			led_off(rrsp_led, idx);
		}
	}
	// unlock soc off
	rrsp_led_lock_sleep(false);
}

static void rrsp_led_pattern_cmp(rrsp_led_pattern_idx_t pattern)
{
	LOG_DBG("Completed LED pattern-%u", pattern);

	uint8_t work_idx = rrsp_led_get_workidx_by_pattern(pattern);
	if (work_idx >= RRSP_LED_WORK_MAX) {
		return;
	}

	// Check the work is available or not
	if (rrsp_led_work[work_idx].active_pattern != pattern) {
		LOG_ERR("The LED pattern-%u is not active, %u", pattern,
			rrsp_led_work[work_idx].active_pattern);
		return;
	}

	rrsp_led_work[work_idx].active_pattern = RRSP_LED_PAT_INVALID;
	// Unlock soc off
	rrsp_led_lock_sleep(false);
}

static void rrsp_led_handler(struct k_work *work)
{
	struct k_work_delayable *d_work = k_work_delayable_from_work(work);
	struct rrsp_led_wrok_info *info = CONTAINER_OF(d_work, struct rrsp_led_wrok_info, work);

	if (info->active_pattern >= RRSP_LED_PAT_MAX) {
		LOG_ERR("Unexpected LED pattern-%u", info->active_pattern);
		info->active_pattern = RRSP_LED_PAT_INVALID;
	} else if (info->next_seq >= rrsp_led_pattern[info->active_pattern].valid_seq) {
		LOG_ERR("Unexpected Sequence-%u", info->active_pattern);
		info->active_pattern = RRSP_LED_PAT_INVALID;
	} else if (rrsp_led_pattern[info->active_pattern].repeat_times &&
		   (info->repeat >= rrsp_led_pattern[info->active_pattern].repeat_times)) {
		LOG_ERR("Unexpected repeat-%u", info->repeat);
		info->active_pattern = RRSP_LED_PAT_INVALID;
	}

	if (info->active_pattern == RRSP_LED_PAT_INVALID) {
		// Unlock soc off
		rrsp_led_lock_sleep(false);
		return;
	}

	const rrsp_led_pattern_t *curr_ptn = &rrsp_led_pattern[info->active_pattern];
	// Set LED
	for (uint8_t idx = 0; idx < RRSP_LED_IDX_MAX; idx++) {
		if (!(curr_ptn->led_mask & LED_MASK(idx))) {
			continue;
		}

		if (curr_ptn->active_led[info->next_seq] & LED_MASK(idx)) {
			// Set led on
			led_on(rrsp_led, idx);
		} else {
			// Set led off
			led_off(rrsp_led, idx);
		}
	}

	// Check the pattern finished
	if ((info->next_seq + 1) == curr_ptn->valid_seq) {
		info->repeat += 1;
		if (curr_ptn->repeat_times && (info->repeat == curr_ptn->repeat_times)) {
			// LED complete
			rrsp_led_pattern_cmp(info->active_pattern);
			return;
		}
	}
	// Set timer for next sequence
	atm_work_reschedule_for_app_work_q(d_work, K_MSEC(curr_ptn->dur_ms[info->next_seq]));
	info->next_seq += 1;

	if (info->next_seq == curr_ptn->valid_seq) {
		info->next_seq = 0;
	}
}

static int rrsp_led_init(void)
{
	if (!device_is_ready(rrsp_led)) {
		LOG_ERR("LED device is not ready\n");
		return -ENXIO;
	}

	k_work_init_delayable(&rrsp_led_work[RRSP_LED_WORK_EVT].work, rrsp_led_handler);
	k_work_init_delayable(&rrsp_led_work[RRSP_LED_WORK_BG].work, rrsp_led_handler);
	rrsp_led_work[RRSP_LED_WORK_EVT].active_pattern = RRSP_LED_PAT_INVALID;
	rrsp_led_work[RRSP_LED_WORK_BG].active_pattern = RRSP_LED_PAT_INVALID;

	return 0;
}

SYS_INIT(rrsp_led_init, POST_KERNEL, CONFIG_APPLICATION_INIT_PRIORITY);

void rrsp_led_cancel_all_bg(void)
{
	if (rrsp_led_work[RRSP_LED_WORK_BG].active_pattern == RRSP_LED_PAT_INVALID) {
		return;
	}
	LOG_WRN("Active LED pat:%u", rrsp_led_work[RRSP_LED_WORK_BG].active_pattern);
	k_work_cancel_delayable(&rrsp_led_work[RRSP_LED_WORK_BG].work);
	rrsp_led_work[RRSP_LED_WORK_BG].active_pattern = RRSP_LED_PAT_INVALID;
	// unlock soc off
	rrsp_led_lock_sleep(false);
}
#endif

void rrsp_led_update(rrsp_led_pattern_idx_t pattern, bool enable)
{
	LOG_INF("%s LED %u", enable ? "Enable" : "Disable", pattern);
#ifdef CONFIG_LED
	if (!device_is_ready(rrsp_led)) {
		LOG_ERR("LED device is not ready\n");
		return;
	}
	if (enable) {
		rrsp_led_start_pattern(pattern);
	} else {
		rrsp_led_cancel_pattern(pattern);
	}
#endif
}
```

## src/rrsp_led.h
```c
/*
 * Copyright (c) 2025-2026 Atmosic
 *
 * SPDX-License-Identifier: LicenseRef-Atmosic
 */

#pragma once

#ifdef __cplusplus
extern "C" {
#endif

typedef enum rrsp_led_pattern_idx_e {
	RRSP_LED_PAT_EVT_PWRON,
	RRSP_LED_PAT_EVT_PWROFF,
	RRSP_LED_PAT_EVT_BAT_LVL,
	RRSP_LED_PAT_EVT_BAT5 = RRSP_LED_PAT_EVT_BAT_LVL,
	RRSP_LED_PAT_EVT_BAT4,
	RRSP_LED_PAT_EVT_BAT3,
	RRSP_LED_PAT_EVT_BAT2,
	RRSP_LED_PAT_EVT_BAT1,
	RRSP_LED_PAT_MODE,
	RRSP_LED_PAT_MODE_PAIR = RRSP_LED_PAT_MODE,
	RRSP_LED_PAT_MODE_OPR,
	RRSP_LED_PAT_MODE_CS,

	RRSP_LED_PAT_MAX,
	RRSP_LED_PAT_INVALID = 0xFF,
} rrsp_led_pattern_idx_t;

/**
 * @brief Update LED with specific pattern
 * @param[in] pattern led pattern
 * @param[in] enable enable or cancel
 */
void rrsp_led_update(rrsp_led_pattern_idx_t pattern, bool enable);

#ifdef CONFIG_LED
/**
 * @brief Update LED with specific pattern
 *
 * This function cancels the work for background led (pattern for mode)
 */
void rrsp_led_cancel_all_bg(void);
#endif

#ifdef __cplusplus
}
#endif

///@}
```

## src/rrsp_mmi.h
```c
/*
 * Copyright (c) 2025-2026 Atmosic
 *
 * SPDX-License-Identifier: LicenseRef-Atmosic
 */

#pragma once

/// rrsp MMI states
typedef enum rrsp_mmi_state_e {
	RRSP_MMI_STATE_INIT,
	RRSP_MMI_STATE_ADV,
	RRSP_MMI_STATE_CONNECTED,
	RRSP_MMI_STATE_CS_SETUP_CMP,
	RRSP_MMI_STATE_CS_PROC_EN,
	RRSP_MMI_STATE_OFF,

	RRSP_MMI_STATE_IDX_MAX
} rrsp_mmi_state_t;

/// rrsp MMI events
typedef enum rrsp_mmi_evt_e {
	RRSP_MMI_EVT_BT_READY,
	RRSP_MMI_EVT_BT_CONN,
	RRSP_MMI_EVT_BT_DISC,
	RRSP_MMI_EVT_CS_CFG_CREATED,
	RRSP_MMI_EVT_CS_SEC_EN,
	RRSP_MMI_EVT_CS_PROC_EN,
	RRSP_MMI_EVT_CS_PROC_DIS,
	RRSP_MMI_EVT_CS_CFG_RM,
	RRSP_MMI_EVT_CS_FORCE_OFF,
	RRSP_MMI_EVT_PWR_OFF,
	RRSP_MMI_EVT_ADV_OFF,

	RRSP_MMI_EVT_INVALID,
} rrsp_mmi_evt_t;

/**
 * @brief Initialize MMI states for rrsp application
 *
 * This function initializes the state for rrsp application.
 *
 */
void rrsp_mmi_init(void);

/**
 * @brief Get the MMI states of rrsp application
 *
 * @return current MMI state of rrsp application
 */
rrsp_mmi_state_t rrsp_mmi_get_state(void);

/**
 * @brief Power off for rrsp application
 *
 * This function power off the state for rrsp application.
 *
 */
void rrsp_mmi_off(void);

#ifdef CONFIG_BTN_FORCE_DISABLE_CS
/**
 * @brief Force disable or revert CS function for rrsp application
 *
 * This function triggers the state machine to disable or revert the CS
 * function. The sequence depends on the current state:
 * - RRSP_MMI_STATE_CS_PROC_EN: disable CS procedure first, wait for procedure
 *   disable complete event, then remove the CS configuration and wait for the
 *   configuration removed event, finally disable the reflector role.
 * - RRSP_MMI_STATE_CS_SETUP_CMP: remove the CS configuration directly, wait for
 *   the configuration removed event, then disable the reflector role.
 * - RRSP_MMI_STATE_CONNECTED: revert the CS reflector role by setting default
 *   settings with reflector role enabled.
 */
void rrsp_mmi_force_cs_off(void);
#endif

#ifdef CONFIG_BTN_ON_OFF
/**
 * @brief Register PM notification for application off check
 *
 * This function register PM notification
 */
// void rrsp_mmi_pm_register(void);
void rrsp_mmi_off_thread_init(void);

/**
 * @brief Unlock sleep to enter soft off state
 *
 * This function unlock the soft off to enter sleep state
 */
void rrsp_mmi_unlock_sleep(void);
#endif
```
