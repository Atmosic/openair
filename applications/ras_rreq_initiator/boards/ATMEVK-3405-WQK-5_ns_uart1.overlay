/*
 * Copyright (c) 2025 Atmosic
 *
 * SPDX-License-Identifier: Apache-2.0
 */

/ {
	aliases {
		sw1 = &button1;
	};

	chosen {
		zephyr,console = &uart1;
		zephyr,shell-uart = &uart1;
	};
};

&atm_antenna {
	status = "okay";
	ant-out5-pin = <5>;
	mdm-ant-rx-3to0 = <0x00002000>;
	mdm-ant-tx-3to0 = <0x00002000>;
	mdm-ant-idle = <0x0>;
};
